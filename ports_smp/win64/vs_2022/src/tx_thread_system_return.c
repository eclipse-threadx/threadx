/***************************************************************************
 * Copyright (C) 2026 Eclipse ThreadX contributors
 *
 * This program and the accompanying materials are made available under the
 * terms of the MIT License which is available at
 * https://opensource.org/licenses/MIT.
 *
 * AI Disclosure: This file was largely AI-generated by Codex (gpt 5.4).
 * The AI-generated portions may be considered public domain (CC0-1.0)
 * and not subject to the project's licence. The human contributor has
 * reviewed and verified that the code is correct.
 *
 * SPDX-License-Identifier: MIT and CC0-1.0
 **************************************************************************/

// Some portions generated by Codex (gpt 5.5).

#define TX_SOURCE_CODE
#define TX_THREAD_SMP_SOURCE_CODE

#include "tx_api.h"
#include "tx_thread.h"
#include "tx_timer.h"

VOID  _tx_thread_system_return(VOID)
{
TX_THREAD   *temp_thread_ptr;
UINT        temp_thread_state;
UINT        core;
DWORD       thread_id;

    _tx_win32_critical_section_obtain(&_tx_win32_critical_section);

    core =       _tx_thread_smp_core_get();
    thread_id =  GetCurrentThreadId();

    _tx_win32_debug_entry_insert("SYSTEM_RETURN", __FILE__, __LINE__);

    temp_thread_ptr =  _tx_thread_current_ptr[core];

    if ((_tx_win32_threadx_thread != 0) &&
        ((temp_thread_ptr == TX_NULL) || (temp_thread_ptr -> tx_thread_win32_thread_id != thread_id)))
    {
        _tx_win32_critical_section_release_all(&_tx_win32_critical_section);
        ExitThread(0);
    }

    if (_tx_timer_time_slice[core] != 0U)
    {
        temp_thread_ptr -> tx_thread_time_slice =  _tx_timer_time_slice[core];
        _tx_timer_time_slice[core] =  0U;
    }

    temp_thread_state =   temp_thread_ptr -> tx_thread_state;
    temp_thread_ptr -> tx_thread_win32_suspension_type =  2U;
    _tx_thread_current_ptr[core] =  TX_NULL;
    _tx_win32_virtual_cores[core].tx_thread_smp_core_mapping_thread_handle = NULL;
    _tx_win32_virtual_cores[core].tx_thread_smp_core_mapping_thread_id =     0U;
    _tx_win32_virtual_cores[core].tx_thread_smp_core_mapping_thread =        TX_NULL;

    _tx_win32_debug_entry_insert("SYSTEM_RETURN-release_sem", __FILE__, __LINE__);

    if (temp_thread_ptr != _tx_thread_smp_protection.tx_thread_smp_protect_thread)
    {
        _tx_win32_system_error++;
    }

    _tx_thread_smp_protection.tx_thread_smp_protect_count =      0U;
    _tx_thread_smp_protection.tx_thread_smp_protect_core =       0xFFFFFFFFUL;
    _tx_thread_smp_protection.tx_thread_smp_protect_thread =     TX_NULL;
    _tx_thread_smp_protection.tx_thread_smp_protect_in_force =   TX_FALSE;
    _tx_thread_smp_protection.tx_thread_smp_protect_thread_id =  0U;

    temp_thread_ptr -> tx_thread_smp_core_control =  1U;
    _tx_win32_global_int_disabled_flag =  TX_FALSE;
    _tx_thread_preempt_disable =          0U;

    MemoryBarrier();
    if (SetEvent(_tx_win32_scheduler_event) == 0)
    {
        _tx_win32_system_error++;
    }

    _tx_win32_critical_section_release_all(&_tx_win32_critical_section);

    if (temp_thread_state == TX_TERMINATED)
    {
        ExitThread(0);
    }

    _tx_win32_wait_for_thread_run(temp_thread_ptr);
#ifdef TX_WIN32_PROFILE_ENABLE
    _tx_win32_profile_mark_run_wake(temp_thread_ptr);
#endif
    _tx_win32_current_virtual_core =  temp_thread_ptr -> tx_thread_win32_virtual_core;
#ifdef TX_WIN32_PROFILE_ENABLE
    _tx_win32_profile_mark_start_ack(temp_thread_ptr);
#endif
    _tx_win32_thread_start_ack_signal(temp_thread_ptr);

    _tx_win32_critical_section_obtain(&_tx_win32_critical_section);

    _tx_win32_debug_entry_insert("SYSTEM_RETURN-wake_up", __FILE__, __LINE__);

    core =  _tx_thread_smp_core_get();
    temp_thread_ptr =  _tx_thread_current_ptr[core];

    if ((_tx_win32_threadx_thread != 0) &&
        ((temp_thread_ptr == TX_NULL) || (temp_thread_ptr -> tx_thread_win32_thread_id != thread_id)))
    {
        _tx_win32_critical_section_release_all(&_tx_win32_critical_section);
        ExitThread(0);
    }

    _tx_win32_debug_entry_insert("SYSTEM_RETURN-finish", __FILE__, __LINE__);
    _tx_win32_critical_section_release_all(&_tx_win32_critical_section);
}
