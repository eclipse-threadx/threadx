/***************************************************************************
 * Copyright (C) 2026 Eclipse ThreadX contributors
 *
 * This program and the accompanying materials are made available under the
 * terms of the MIT License which is available at
 * https://opensource.org/licenses/MIT.
 *
 * AI Disclosure: This file was largely AI-generated by Codex (gpt 5.4).
 * The AI-generated portions may be considered public domain (CC0-1.0)
 * and not subject to the project's licence. The human contributor has
 * reviewed and verified that the code is correct.
 *
 * SPDX-License-Identifier: MIT and CC0-1.0
 **************************************************************************/

// Some portions generated by Codex (gpt 5.4).

#define TX_SOURCE_CODE
#define TX_THREAD_SMP_SOURCE_CODE

#include "tx_api.h"
#include "tx_thread.h"
#include "tx_timer.h"

VOID  _tx_thread_context_save(VOID)
{
TX_THREAD   *thread_ptr;
UINT        interrupt_posture;

    interrupt_posture =  _tx_thread_smp_protect();
    if (interrupt_posture != TX_FALSE)
    {
        _tx_win32_system_error++;
    }

    _tx_win32_debug_entry_insert("CONTEXT_SAVE", __FILE__, __LINE__);

    thread_ptr =  _tx_thread_current_ptr[0];

    if ((thread_ptr != TX_NULL) && (_tx_thread_system_state[0] == 0UL))
    {
        if (thread_ptr -> tx_thread_win32_mutex_access == TX_FALSE)
        {
            _tx_win32_thread_suspend(thread_ptr -> tx_thread_win32_thread_handle);
            _tx_win32_debug_entry_insert("CONTEXT_SAVE-suspend_thread", __FILE__, __LINE__);
        }
    }

    _tx_thread_system_state[0]++;
}
