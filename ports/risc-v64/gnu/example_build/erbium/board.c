/***************************************************************************
 * Copyright (c) 2026 Eclipse ThreadX contributors
 *
 * This program and the accompanying materials are made available under the
 * terms of the MIT License which is available at
 * https://opensource.org/licenses/MIT.
 *
 * AI Disclosure: This file was largely AI-generated by Claude Code (Opus 5.5).
 * The AI-generated portions may be considered public domain (CC0-1.0)
 * and not subject to the project's licence. The human contributor has
 * reviewed and verified that the code is correct.
 *
 * SPDX-License-Identifier: MIT and CC0-1.0
 **************************************************************************/

#include "plic.h"
#include "hwtimer.h"
#include "uart.h"
#include <stdint.h>
#include <stddef.h>

/* The example links without a C library; ThreadX needs memset.  */
void *memset(void *des, int c, size_t n)
{
    unsigned char *target = des;

    for (size_t i = 0; i < n; i++)
        target[i] = (unsigned char)c;
    return des;
}

int board_init(void)
{
    int ret;

    ret = plic_init();
    if (ret)
        return ret;

    ret = uart_init();
    if (ret)
        return ret;

    ret = hwtimer_init();
    if (ret)
        return ret;

    return 0;
}
