/***************************************************************************
 * Copyright (C) 2026 Eclipse ThreadX contributors
 *
 * This program and the accompanying materials are made available under the
 * terms of the MIT License which is available at
 * https://opensource.org/licenses/MIT.
 *
 * AI Disclosure: This file was largely AI-generated by Copilot (Sonnet 4.6).
 * The AI-generated portions may be considered public domain (CC0-1.0)
 * and not subject to the project's licence. The human contributor has
 * reviewed and verified that the code is correct.
 *
 * SPDX-License-Identifier: MIT and CC0-1.0
 **************************************************************************/

#include <stdint.h>

#include "pulp_mem_map.h"
#include "io.h"
#include "gpio.h"

/* APB SOC CTRL pad-mux interface (apb_soc_ctrl v1.0.0):
 * Each IO pad has a dedicated 32-bit register at base + 0x400 + pad_index*4.
 *   PWDATA[1:0] = mux function (0=sys, 1=perio, 2=apbio/GPIO, 3=fpgaio)
 *   PWDATA[13:8] = pad config (drive/pull, optional)
 *
 * FUNC_C (2) routes the pad to the GPIO (apbio) controller.
 * For the standard GPIO pins: io_pad = gpio_pin + GPIO_IO_PAD_OFFSET (=7).
 * Verified in pad_control.sv: apbio[N] ↔ io_pad[N+7] when pad_mux[N+7]==2. */
#define APB_SOC_PADMUX_BASE     0x400U
#define PINMUX_FUNC_C           2U
#define GPIO_IO_PAD_OFFSET      7U

static void gpio_pinmux_set_func_c(uint32_t pin_mask)
{
    for (uint32_t gpio_pin = 0U; gpio_pin < 32U; gpio_pin++)
    {
        if ((pin_mask & (1UL << gpio_pin)) == 0U)
        {
            continue;
        }
        uint32_t io_pad  = gpio_pin + GPIO_IO_PAD_OFFSET;
        uintptr_t reg    = PULP_APB_SOC_CTRL_ADDR + APB_SOC_PADMUX_BASE
                           + io_pad * 4U;
        writew(PINMUX_FUNC_C, reg);
    }
}

/* Iterate over every set bit in pin_mask and call writew(pin_number, addr).
 * The apb_gpiov2 SETGPIO/CLRGPIO/TOGGPIO/SETDIR registers are all
 * pin-indexed: the written word encodes a pin number, not a bitmask. */
static void gpio_foreach_pin(uint32_t pin_mask, uintptr_t reg_addr, uint32_t extra_bits)
{
    for (uint32_t pin = 0U; pin < 32U; pin++)
    {
        if ((pin_mask & (1UL << pin)) != 0U)
        {
            writew(pin | extra_bits, reg_addr);
        }
    }
}

void gpio_init(void)
{
    /* GPIO clocking is handled by platform boot code on CORE-V MCU. */
}

void gpio_set_output(uint32_t pin_mask)
{
    /* Route physical pads to the GPIO controller via the pad-mux (FUNC_C). */
    gpio_pinmux_set_func_c(pin_mask);

    /* Configure each pin as push-pull output via SETDIR. */
    gpio_foreach_pin(pin_mask,
                     (uintptr_t)(PULP_GPIO_ADDR + GPIO_SETDIR_OFFSET),
                     GPIO_DIR_OUTPUT);
}

void gpio_toggle(uint32_t pin_mask)
{
    gpio_foreach_pin(pin_mask,
                     (uintptr_t)(PULP_GPIO_ADDR + GPIO_TOGGPIO_OFFSET),
                     0U);
}

void gpio_set(uint32_t pin_mask)
{
    gpio_foreach_pin(pin_mask,
                     (uintptr_t)(PULP_GPIO_ADDR + GPIO_SETGPIO_OFFSET),
                     0U);
}

void gpio_clear(uint32_t pin_mask)
{
    gpio_foreach_pin(pin_mask,
                     (uintptr_t)(PULP_GPIO_ADDR + GPIO_CLRGPIO_OFFSET),
                     0U);
}

void gpio_setpinmux(uint8_t io_pad, uint8_t mux)
{
    uintptr_t reg = PULP_APB_SOC_CTRL_ADDR + APB_SOC_PADMUX_BASE
                    + (uintptr_t)io_pad * 4U;
    writew((uint32_t)mux & 0x3U, reg);
}

uint8_t gpio_getpinmux(uint8_t io_pad)
{
    uintptr_t reg = PULP_APB_SOC_CTRL_ADDR + APB_SOC_PADMUX_BASE
                    + (uintptr_t)io_pad * 4U;
    return (uint8_t)(readw(reg) & 0x3U);
}

void gpio_pin_set_dir(uint8_t pin, uint8_t dir)
{
    uint32_t val = (uint32_t)pin;
    if (dir != 0U)
    {
        val |= GPIO_DIR_OUTPUT;
    }
    writew(val, (uintptr_t)(PULP_GPIO_ADDR + GPIO_SETDIR_OFFSET));
}

uint32_t gpio_pin_read_status(uint8_t pin)
{
    writew((uint32_t)pin, (uintptr_t)(PULP_GPIO_ADDR + GPIO_SETSEL_OFFSET));
    return readw((uintptr_t)(PULP_GPIO_ADDR + GPIO_RDSTAT_OFFSET));
}
