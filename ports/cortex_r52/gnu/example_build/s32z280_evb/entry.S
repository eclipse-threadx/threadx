@/***************************************************************************
@ * Copyright (c) 2026 Eclipse ThreadX contributors
@ *
@ * This program and the accompanying materials are made available under the
@ * terms of the MIT License which is available at
@ * https://opensource.org/licenses/MIT.
@ *
@ * AI Disclosure: This file was largely AI-generated by Claude Code (Opus 5).
@ * The AI-generated portions may be considered public domain (CC0-1.0)
@ * and not subject to the project's licence. The human contributor has
@ * reviewed and verified that the code is correct.
@ *
@ * SPDX-License-Identifier: MIT and CC0-1.0
@ **************************************************************************/
@ Some portions generated by Claude Code (Opus 5).
@
@/**************************************************************************/
@/*                                                                        */
@/*  BOARD SUPPORT                                          RELEASE        */
@/*                                                                        */
@/*    entry.S                                          Cortex-R52/GNU     */
@/*                                                           6.5.2        */
@/*  AUTHOR                                                                */
@/*                                                                        */
@/*    Frédéric Desbiens, Eclipse Foundation                               */
@/*                                                                        */
@/*  DESCRIPTION                                                           */
@/*                                                                        */
@/*    Reset path for the NXP S32Z280-594EVB, RTU0 core 0: EL2 setup, the  */
@/*    drop to EL1, stacks, .bss and the call into bsp_main.               */
@/*                                                                        */
@/*    Two things differ from the Armv8-R AEM FVP entry path and both are  */
@/*    silicon facts rather than choices:                                  */
@/*                                                                        */
@/*    1.  The core resets in THUMB state.  CPSR reads 0x1FA on this board */
@/*        -- Hyp mode with T set -- because the RTU boot instruction is a */
@/*        T32 branch (NXP writes R52_B0_INSTR_T32 to the boot address).   */
@/*        So _start must be T32 and switch to A32 itself.  An A32 entry   */
@/*        executes the first halfword of its own instruction as Thumb and */
@/*        goes anywhere.                                                  */
@/*                                                                        */
@/*    2.  There is no semihosting here, so progress cannot be printed.    */
@/*        Instead each stage records a marker and the identity registers  */
@/*        into .data, where a debugger reads them.  boot_stage says how   */
@/*        far the reset path got; if a fault handler runs it records the  */
@/*        vector, syndrome and return address before parking.  Without    */
@/*        this a fault would be indistinguishable from a hang.            */
@/*                                                                        */
@/*    CNTFRQ is read and recorded rather than written.  The FVP leaves it */
@/*    zero and its BSP programs a known value, but the correct frequency  */
@/*    for this board is not yet established, and writing a wrong one would*/
@/*    silently mis-scale every tick interval derived from it.             */
@/*                                                                        */
@/**************************************************************************/

    .syntax unified

/* HCR (Hyp Configuration Register) bits cleared below.                   */

    .equ    HCR_VM,     (1 << 0)        /* stage-2 MPU enable               */
    .equ    HCR_AMO,    (1 << 3)        /* route aborts to EL2              */
    .equ    HCR_IMO,    (1 << 4)        /* route IRQ to EL2                 */
    .equ    HCR_FMO,    (1 << 5)        /* route FIQ to EL2                 */
    .equ    HCR_TGE,    (1 << 27)       /* trap general exceptions to EL2   */
    .equ    HCR_HCD,    (1 << 29)       /* HVC disable -- must be clear      */

    .equ    HCPTR_TCP,  (3 << 10)       /* trap EL1 access to CP10/CP11     */

/* CPACR grants EL1/EL0 access to CP10 and CP11, the floating-point unit;
   FPEXC.EN then enables floating-point execution itself.                 */

    .equ    CPACR_CP10,       (3 << 20)
    .equ    CPACR_CP11,       (3 << 22)
    .equ    FPEXC_EN,         (1 << 30)

    .equ    CNTHCTL_PL1PCTEN, (1 << 0)
    .equ    CNTHCTL_PL1PCEN,  (1 << 1)

    .equ    ICC_HSRE_SRE,     (1 << 0)
    .equ    ICC_HSRE_ENABLE,  (1 << 3)

/* IMP_PERIPHPREGIONR: peripheral port enables.  Both reset to 0.         */

    .equ    PERIPHP_ENABLE_EL10, (1 << 0)
    .equ    PERIPHP_ENABLE_EL2,  (1 << 1)

/* SCTLR/HSCTLR.TE -- Thumb Exception enable.  Set means exceptions are entered
   in T32 state.  It RESETS SET on this part, and every vector table here is
   A32, so it must be cleared or no handler is reachable.  */

    .equ    SCTLR_TE,   (1 << 30)

/* CPSR mode and mask bits.                                               */

    .equ    MODE_USR,   0x10
    .equ    MODE_FIQ,   0x11
    .equ    MODE_IRQ,   0x12
    .equ    MODE_SVC,   0x13
    .equ    MODE_ABT,   0x17
    .equ    MODE_UND,   0x1B
    .equ    MODE_SYS,   0x1F
    .equ    PSR_F,      0x40
    .equ    PSR_I,      0x80
    .equ    PSR_A,      0x100

/* System counter frequency; see where it is programmed below.            */

    .equ    SYSTEM_COUNTER_HZ, 8000000

/* Stage markers, recorded in boot_stage.                                 */

    .equ    STAGE_A32,      1           /* switched out of Thumb            */
    .equ    STAGE_EL2_DONE, 2           /* EL2 configured                   */
    .equ    STAGE_EL1,      3           /* running at EL1                   */
    .equ    STAGE_MAIN,     4           /* about to enter bsp_main          */
    .equ    STAGE_RETURNED, 5           /* bsp_main returned (unexpected)   */
    .equ    STAGE_FAULT,    0xFF        /* a fault handler ran              */

@/**************************************************************************/
@/*  Observation area.  In .data so the debugger's load initialises it and */
@/*  a store needs no stack.                                               */
@/**************************************************************************/

    .section .data
    .align  2

    .global boot_stage
boot_stage:     .word   0
    .global cpsr_at_el2
cpsr_at_el2:    .word   0
    .global cpsr_at_el1
cpsr_at_el1:    .word   0
    .global cntfrq_at_el2
cntfrq_at_el2:  .word   0
    .global hmpuir_at_el2
hmpuir_at_el2:  .word   0
    .global probe_stage
probe_stage:    .word   0
    .global fault_expected
fault_expected: .word   0
    .global fault_taken
fault_taken:    .word   0
    .global fault_expected_pabt
fault_expected_pabt: .word 0
    .global abort_return
abort_return:   .word   0
    .global fault_vector
fault_vector:   .word   0
    .global fault_syndrome
fault_syndrome: .word   0
    .global fault_address
fault_address:  .word   0

@/**************************************************************************/
@/*  EL2 (Hyp) vector table.  32-byte aligned for HVBAR.                   */
@/*                                                                        */
@/*  Offsets 0x04-0x10 are exceptions taken FROM Hyp mode.  Everything     */
@/*  routed to EL2 from EL1 or EL0 arrives at 0x14 instead and is decoded  */
@/*  from HSR.EC -- the single funnel that partitioning work will use.     */
@/**************************************************************************/

    .section .vectors_el2, "ax"
    .align  5
    .arm
    .global el2_vectors
el2_vectors:
    b       fault_el2_reset                 /* 0x00                         */
    b       fault_el2_undef                 /* 0x04                         */
    b       fault_el2_svc                   /* 0x08                         */
    b       fault_el2_pabt                  /* 0x0C                         */
    b       fault_el2_dabt                  /* 0x10                         */
    b       fault_el2_hyp                   /* 0x14  from EL1/EL0           */
    b       fault_el2_irq                   /* 0x18                         */
    b       fault_el2_fiq                   /* 0x1C                         */

@/**************************************************************************/
@/*  EL1 vector table.                                                     */
@/**************************************************************************/

    .section .vectors_el1, "ax"
    .align  5
    .arm
    .global el1_vectors
el1_vectors:
    b       fault_el1_reset                 /* 0x00                         */
    b       fault_el1_undef                 /* 0x04                         */
    b       fault_el1_svc                   /* 0x08                         */
    b       fault_el1_pabt                  /* 0x0C                         */
    b       fault_el1_dabt                  /* 0x10                         */
    b       fault_el1_reserved              /* 0x14                         */
    b       el1_irq_entry                   /* 0x18  IRQ                    */
    b       el1_fiq_entry                   /* 0x1C  FIQ                    */

@/**************************************************************************/
@/*  _start -- reset entry.  Entered in THUMB state, Hyp mode (EL2).       */
@/**************************************************************************/

    .section .text.boot, "ax"
    .thumb
    .align  1
    .global _start
    .type   _start, %function
_start:
    /* Leave Thumb before anything else.  start_a32 is an A32 symbol, so the
       linker clears bit 0 of its address and BX switches state.  */

    ldr     r0, =start_a32
    bx      r0

    .arm
    .align  2
    .type   start_a32, %function
start_a32:
    ldr     r0, =boot_stage
    mov     r1, #STAGE_A32
    str     r1, [r0]

    /* Hyp stack, before anything can be pushed at EL2.  */

    ldr     sp, =__hyp_stack_top

    /* Install the EL2 vector table.  */

    ldr     r0, =el2_vectors
    mcr     p15, 4, r0, c12, c0, 0          /* HVBAR                        */
    isb

    /* Keep exceptions and interrupts routed to EL1 and the stage-2 MPU off.
       HCR_HCD is cleared explicitly so HVC works from EL1 rather than
       depending on its reset value.  */

    mrc     p15, 4, r0, c1, c1, 0           /* HCR                          */
    ldr     r1, =(HCR_TGE | HCR_AMO | HCR_IMO | HCR_FMO | HCR_VM | HCR_HCD)
    bic     r0, r0, r1
    mcr     p15, 4, r0, c1, c1, 0
    isb

    /* TCM: program the bases and enable all three banks, here at EL2.
     *
     * This is at EL2 deliberately.  Writing ENABLEEL10 from EL1 works, but
     * ENABLEEL2 is silently ignored there -- measured, on both BTCM and CTCM:
     * the base took and bit 0 took while bit 1 stayed clear.  The TRM does not
     * say so outright, but EL1 being unable to change what EL2 can see is the
     * sensible reading, and doing the whole job at EL2 avoids the question.
     *
     * ATCM boots enabled at address 0 because CFGTCMBOOTx is tied high here, so
     * this also moves it off zero, which makes a null-pointer write fault rather
     * than quietly land in tightly-coupled memory.  Each base must be
     * size-aligned (TRM r1p3 6.2); 64KB at 0x30000000 and 16KB at 0x30100000
     * and 0x30200000 satisfy that.
     *
     * SIZE and WAITSTATES are read-only descriptions of the hardware, so the
     * values written here keep the bits the banks already report: ATCM 64KB with
     * one wait state, BTCM 16KB with none, CTCM 16KB with one.
     *
     * Nothing may READ the TCMs after this until they have been written, because
     * ECC is enabled on this part and the check bits are not initialised by the
     * core (TRM 6.2.2).  bsp_main preloads them.
     */

    ldr     r0, =(0x30000000 | (0x07 << 2) | (1 << 8) | (1 << 1) | (1 << 0))
    mcr     p15, 0, r0, c9, c1, 0           /* IMP_ATCMREGIONR              */

    /* BTCM as well.  16 KB at zero wait states, where ATCM has one, so it is the
     * faster bank for data -- which is what it is wanted for here.  The claim
     * that a second bank costs the data cache was withdrawn; see the note below.
     * Preloaded by bsp_main before any read, as ECC requires, and BTCM accepts
     * 32-bit stores where ATCM needs 64-bit (TRM 6.2.2).
     */
    ldr     r0, =(0x30100000 | (0x05 << 2) | (0 << 8) | (1 << 1) | (1 << 0))
    mcr     p15, 0, r0, c9, c1, 1           /* IMP_BTCMREGIONR              */
    isb

    /* Preload the whole bank.  ECC is enabled on this part, so a TCM location
     * must be written before it can be read (TRM 6.2.2), and this has to happen
     * before any C runs: the demo images place thread stacks here and do not run
     * bsp_boot.c, which is where the ATCM preload lives.  32-bit stores are
     * sufficient for BTCM where ATCM needs 64-bit.
     */

    ldr     r1, =0x30100000
    ldr     r2, =0x00004000
    mov     r3, #0

3:  str     r3, [r1], #4
    subs    r2, r2, #4
    bgt     3b

    dsb     sy
    /* BTCM and CTCM are not enabled, because nothing in this example uses them.
     * That is the whole reason, and it is worth stating plainly because the
     * reason given here previously was wrong.
     *
     * This comment used to claim that enabling a second bank removed all
     * measurable data-cache benefit, and it listed five configurations to prove
     * it: ATCM alone showing a 24% cache gain, and four combinations involving a
     * second bank showing none.  It concluded that the trigger was not a
     * particular bank, not the bank's address and not the ECC preload, but
     * enabling a second bank at all.  It cited the Cortex-R52 and S32Z2 errata as
     * not covering it, and offered a shared RAM pool between the LLC and the TCMs
     * as an explanation.  A defect report went to NXP on that basis.
     *
     * All of it was an artifact of the benchmark that produced the numbers.  That
     * benchmark was bimodal with respect to where its loop fell inside a 64-byte
     * cache line, reporting either 24% or nothing at all for identical silicon,
     * and every one of those five configurations was an edit to this file, so
     * every one shifted the code that followed and flipped the mode.  Adding two
     * nop instructions here reproduces the "second bank" result exactly, to the
     * digit.  The report to NXP has been withdrawn.
     *
     * Measured again with a benchmark that sweeps four loop alignments and
     * reports the distribution, ATCM alone and ATCM plus CTCM are
     * indistinguishable:
     *
     *   loop offset in line      ATCM only      ATCM + CTCM
     *   0                        gain 0         gain 0
     *   16                       gain 0         gain 0
     *   32                       gain 240/1000  gain 240/1000
     *   48                       gain 240/1000  gain 240/1000
     *
     * So enabling a second bank costs nothing measurable.  Enabling one is a
     * single line, and the only prerequisites are the ECC preload before any read
     * (TRM 6.2.2) and an MPU region, both of which tcm.c and mpu.c already
     * handle for ATCM.  They stay off until something needs them.
     */

    isb

    /* Let EL1 reach the FPU: clear HCPTR.TCP10/TCP11.  The R52 always has at
       least a single-precision FPU, so this matters even for a soft-float
       kernel if application code uses it.  */

    mrc     p15, 4, r0, c1, c1, 2           /* HCPTR                        */
    ldr     r1, =HCPTR_TCP
    bic     r0, r0, r1
    mcr     p15, 4, r0, c1, c1, 2
    isb

    /* Record CNTFRQ as found.  Deliberately not written: see the file
       header.  */

    mrc     p15, 0, r0, c14, c0, 0          /* CNTFRQ as found              */
    ldr     r1, =cntfrq_at_el2
    str     r0, [r1]

    /* Program CNTFRQ.  It is writable only at the highest implemented
       exception level, so it must happen here rather than in bsp_main.
       CNTFRQ is a software-declared constant: nothing derives it from the
       hardware, and it reads zero out of reset on this silicon exactly as it
       does on the FVP.  Any code computing a tick interval from it would
       divide by zero.

       8 MHz is not a guess.  The counter was measured against host wall-clock
       time at 8.0227 MHz over a 32-second interval, and the clock tree agrees:
       RTU.GPR CFG_CNTDV reads 4, so the divider is (4+1) = 5, and the board's
       FXOSC is 40 MHz -- itself confirmed independently by the LINFlexD baud
       divisors the BootROM left behind.  40 / 5 = 8.  */

    ldr     r0, =SYSTEM_COUNTER_HZ
    mcr     p15, 0, r0, c14, c0, 0          /* CNTFRQ                       */

    /* HMPUIR is EL2-only, so it has to be read here rather than in bsp_main.
       It gives the EL2 MPU region count, which stage-2 partitioning needs and
       which the EL1 MPUIR does not report.  */

    mrc     p15, 4, r0, c0, c0, 4           /* HMPUIR                       */
    ldr     r1, =hmpuir_at_el2
    str     r0, [r1]

    /* Permit EL1/EL0 use of the physical counter and timer; both reset
       disabled, so an EL1 access to CNTPCT or CNTP_* would otherwise trap.  */

    mrc     p15, 4, r0, c14, c1, 0          /* CNTHCTL                      */
    orr     r0, r0, #(CNTHCTL_PL1PCTEN | CNTHCTL_PL1PCEN)
    mcr     p15, 4, r0, c14, c1, 0
    isb

    /* Permit EL1 to reach the GIC CPU interface through ICC_* system
       registers.  Needs no GIC base address, so it is safe to do here even
       though the distributor address for this part is not yet established.  */

    mrc     p15, 4, r0, c12, c9, 5          /* ICC_HSRE                     */
    orr     r0, r0, #(ICC_HSRE_SRE | ICC_HSRE_ENABLE)
    mcr     p15, 4, r0, c12, c9, 5
    isb

    /* Clear HSCTLR.TE so EL2 exceptions are entered in A32, matching the EL2
       vector table.  See the EL1 equivalent below for why this matters.  */

    mrc     p15, 4, r0, c1, c0, 0           /* HSCTLR                       */
    bic     r0, r0, #SCTLR_TE
    mcr     p15, 4, r0, c1, c0, 0
    isb

    /* Open the low-latency peripheral port.
       IMP_PERIPHPREGIONR (Cortex-R52 TRM r1p3, 3.3.80) describes a region at
       0x76000000 of 4 MB on this part -- the RTU peripheral space -- with
       separate enables for EL2 and EL1/0 that BOTH RESET TO ZERO.  Until they
       are set, any access in that window stalls the core: no abort, no fault
       handler, no exception at all, and the debug connection drops with it.
       Nothing in the SoC reference manual mentions this; it cost a run before
       the TRM identified it.  Written here because EL1 writes to this register
       trap to EL2 when HACTLR.PERIPHPREGIONR is clear.  */

    mrc     p15, 0, r0, c15, c0, 0          /* IMP_PERIPHPREGIONR           */
    orr     r0, r0, #(PERIPHP_ENABLE_EL2 | PERIPHP_ENABLE_EL10)
    mcr     p15, 0, r0, c15, c0, 0
    isb

    /* Record CPSR while still at EL2: mode bits should read 0x1A (Hyp).  */

    mrs     r0, cpsr
    ldr     r1, =cpsr_at_el2
    str     r0, [r1]

    ldr     r0, =boot_stage
    mov     r1, #STAGE_EL2_DONE
    str     r1, [r0]

    /* Drop to EL1 (Supervisor), interrupts still masked.  */

    ldr     r0, =el1_entry
    msr     ELR_hyp, r0
#ifdef TX_ENABLE_FIQ_SUPPORT

    /* FIQ left unmasked, IRQ still masked.  tx_thread_stack_build only clears a
     * thread's F bit when the library was built with FIQ support and nothing
     * else ever clears it, so leaving PSR_F set here would mask FIQ until the
     * first thread ran and an FIQ raised from bsp_main would silently do
     * nothing.
     */

    ldr     r0, =(PSR_A | PSR_I | MODE_SVC)
#else
    ldr     r0, =(PSR_A | PSR_I | PSR_F | MODE_SVC)
#endif
    msr     SPSR_hyp, r0
    isb
    eret

@/**************************************************************************/
@/*  el1_entry -- first instruction at EL1.                                */
@/**************************************************************************/

    .align  2
    .type   el1_entry, %function
el1_entry:
    ldr     r0, =boot_stage
    mov     r1, #STAGE_EL1
    str     r1, [r0]

    /* EL1 vector table.  */

    ldr     r0, =el1_vectors
    mcr     p15, 0, r0, c12, c0, 0          /* VBAR                         */
    isb

#ifdef __ARM_FP

    /* Enable the floating-point unit for EL1.
     *
     * Two gates must be opened and both reset closed:
     *   CPACR   grants EL1/EL0 access to CP10/CP11.  It reads 0 out of reset,
     *           so the first floating-point instruction would otherwise raise
     *           an Undefined Instruction exception.
     *   FPEXC   .EN enables floating-point execution itself.
     * EL2 has already cleared HCPTR.TCP10/TCP11 above, so neither traps to EL2.
     *
     * This is the BSP's job, not the kernel's.  tx_thread_vfp_enable() only sets
     * the per-thread flag that makes the context switch save and restore
     * floating-point state; it does not turn the hardware on.  Without the code
     * below, a VFP build faults on the first context switch that touches a
     * D-register -- and on this silicon that fault was invisible until
     * SCTLR.TE was cleared, which is the trap described further down.
     *
     * Guarded by __ARM_FP, which the compiler defines exactly when the build can
     * emit floating-point instructions.  In a soft-float build "vmsr fpexc" is
     * not assemblable for this target at all.
     */

    mrc     p15, 0, r0, c1, c0, 2           /* CPACR                        */
    orr     r0, r0, #(CPACR_CP10 | CPACR_CP11)
    mcr     p15, 0, r0, c1, c0, 2
    isb

    mov     r0, #FPEXC_EN
    vmsr    fpexc, r0
    isb

#endif

    /* Clear SCTLR.TE.  This is not cosmetic and it cost a long detour.
       *
       * TE resets SET on this silicon -- SCTLR reads 0x70C50838, bit 30 high --
       * which makes the core enter every exception in T32 state.  All the vector
       * tables here are A32.  So an exception would branch into the table, decode
       * the A32 branch as Thumb, land mid-instruction at a misaligned address and
       * take an undefined-instruction exception, which then did the same thing
       * again.  No handler ever ran.
       *
       * The consequence was worse than a crash: every fault became invisible.
       * boot_stage stayed at its last value, fault_vector stayed zero, and the
       * core sat at el1_vectors+4 -- so a data abort from an unmapped peripheral,
       * an abort from a bad MPU map, and a correctly delivered timer interrupt all
       * presented identically, as an unexplained hang with nothing recorded.  Two
       * real bugs were diagnosed through that fog before its cause was found.
       *
       * The Armv8-R AEM FVP resets with TE clear, which is why the same vector
       * tables work there and why this never appeared during the FVP work.  */

    mrc     p15, 0, r0, c1, c0, 0           /* SCTLR                        */
    bic     r0, r0, #SCTLR_TE
    mcr     p15, 0, r0, c1, c0, 0
    isb

    /* One stack per mode: an exception taken inside a handler would
       otherwise reuse the interrupted mode's stack pointer.  */

    mrs     r0, cpsr
    bic     r0, r0, #0x1F

    orr     r1, r0, #MODE_IRQ
    msr     cpsr_c, r1
    ldr     sp, =__irq_stack_top

    orr     r1, r0, #MODE_FIQ
    msr     cpsr_c, r1
    ldr     sp, =__fiq_stack_top

    orr     r1, r0, #MODE_ABT
    msr     cpsr_c, r1
    ldr     sp, =__abt_stack_top

    orr     r1, r0, #MODE_UND
    msr     cpsr_c, r1
    ldr     sp, =__und_stack_top

    orr     r1, r0, #MODE_SYS
    msr     cpsr_c, r1
    ldr     sp, =__sys_stack_top

    orr     r1, r0, #MODE_SVC
    msr     cpsr_c, r1
    ldr     sp, =__svc_stack_top

    /* Zero .bss.  Nothing above this point may rely on a .bss object.  */

    ldr     r0, =__bss_start__
    ldr     r1, =__bss_end__
    mov     r2, #0
bss_loop:
    cmp     r0, r1
    strlo   r2, [r0], #4
    blo     bss_loop

    /* Record CPSR at EL1: mode bits should read 0x13 (Supervisor), which is
       what proves the EL2 to EL1 drop actually happened.  */

    mrs     r0, cpsr
    ldr     r1, =cpsr_at_el1
    str     r0, [r1]

    ldr     r0, =boot_stage
    mov     r1, #STAGE_MAIN
    str     r1, [r0]

    bl      bsp_main

    /* bsp_main is not expected to return.  */

    ldr     r0, =boot_stage
    mov     r1, #STAGE_RETURNED
    str     r1, [r0]
park:
    b       park

@/**************************************************************************/
@/**************************************************************************/
@/*  el1_irq_entry -- IRQ vector, standalone.                              */
@/*                                                                        */
@/*  The FVP example routes IRQ through _tx_thread_context_save and        */
@/*  __tx_irq_processing_return, which this image cannot do: it does not   */
@/*  link ThreadX, deliberately, so that a failure here is a board problem */
@/*  and not a kernel one.  This is the classic A32 form instead.          */
@/*                                                                        */
@/*  lr is adjusted by 4 because an IRQ is taken with lr pointing one      */
@/*  instruction past the one that was interrupted.  The caret on the ldm  */
@/*  restores CPSR from SPSR_irq as it loads pc, which is what returns to  */
@/*  the interrupted mode rather than staying in IRQ mode.                 */
@/**************************************************************************/

    .align  2
    .global el1_irq_entry
    .type   el1_irq_entry, %function
el1_irq_entry:
#ifdef TX_R52_USE_THREADX_IRQ

    /* With the kernel linked, the vector goes straight into
       _tx_thread_context_save, which saves the interrupted context and
       branches back to __tx_irq_processing_return.  A plain B, not BL:
       context save adjusts lr itself to find the point of interrupt.  */

    b       _tx_thread_context_save

    .global __tx_irq_processing_return
__tx_irq_processing_return:
#ifdef TX_ENABLE_IRQ_NESTING

    /* Nested IRQ handling, the same shape as the FVP example, and the ordering
     * matters as much here.  The interrupt is acknowledged in IRQ mode with
     * interrupts still masked, BEFORE nesting starts: reading ICC_IAR1 raises
     * the GIC running priority to this interrupt's own, which masks it and
     * everything of equal or lower priority, and only then is re-enabling IRQ
     * safe.  Start nesting first and the still-pending, still-level-asserted
     * timer is retaken the instant IRQ is enabled, recursing until the IRQ and
     * System stacks are gone -- a hang with no fault to point at.
     *
     * The INTID rides in r4, which survives the mode switch because only SP and
     * LR are banked, and is pushed on the IRQ stack as well so a nested level
     * reusing r4 cannot lose this level's value.  End-of-interrupt waits for
     * IRQ mode with interrupts masked again, so dropping the running priority
     * cannot re-admit this same interrupt.
     */

    bl      gicv3_acknowledge
    mov     r4, r0
    stmdb   sp!, {r4, r5}                   /* r5 keeps 8-byte alignment    */

    bl      _tx_thread_irq_nesting_start
    mov     r0, r4
    bl      board_irq_service
    bl      _tx_thread_irq_nesting_end

    ldmia   sp!, {r4, r5}
    mov     r0, r4
    bl      gicv3_end_of_interrupt
#else
    bl      board_irq_handler
#endif
    b       _tx_thread_context_restore


#else

    /* Standalone: the classic A32 form.  lr is adjusted by 4 because an IRQ
       is taken with lr one instruction past the interrupted one, and the
       caret on the ldm restores CPSR from SPSR_irq as it loads pc.  */

    sub     lr, lr, #4
    stmfd   sp!, {r0-r3, r12, lr}
    bl      board_irq_handler
    ldmfd   sp!, {r0-r3, r12, pc}^

#endif

@/**************************************************************************/
@/*  el1_fiq_entry -- FIQ vector at EL1.                                   */
@/**************************************************************************/

el1_fiq_entry:
#if defined(TX_ENABLE_FIQ_SUPPORT) && defined(TX_R52_USE_THREADX_IRQ)

    /* Both guards are needed.  TX_ENABLE_FIQ_SUPPORT is PUBLIC on the threadx
     * target, so it reaches every image once the library is built with FIQ,
     * including images that link no interrupt controller; referencing the GIC
     * and board symbols below from those breaks the link outright.  That is why
     * the IRQ vector is gated the same way.
     *
     * Group 0 is what the GIC delivers as FIQ, and it has its own acknowledge
     * and end-of-interrupt registers -- the Group 1 pair returns the spurious
     * INTID for a Group 0 interrupt and leaves it pending, which looks like a
     * storm rather than a mistake.  As on the IRQ path, the acknowledge happens
     * before nesting starts, so the running priority masks this interrupt before
     * FIQ is re-enabled.
     */

    b       _tx_thread_fiq_context_save

    .global __tx_fiq_processing_return
__tx_fiq_processing_return:
#ifdef TX_ENABLE_FIQ_NESTING
    bl      gicv3_acknowledge_group0
    mov     r4, r0
    stmdb   sp!, {r4, r5}

    bl      _tx_thread_fiq_nesting_start
    mov     r0, r4
    bl      board_fiq_service
    bl      _tx_thread_fiq_nesting_end

    ldmia   sp!, {r4, r5}
    mov     r0, r4
    bl      gicv3_end_of_interrupt_group0
#else
    bl      board_fiq_handler
#endif
    b       _tx_thread_fiq_context_restore
#else
    b       fault_el1_fiq
#endif

@/**************************************************************************/
@/*  try_execute_data -- branch to a non-executable address on purpose.      */
@/*                                                                        */
@/*  Saves its own return address for the prefetch-abort handler to use,    */
@/*  arms that handler, then branches to the address in r0.  It never       */
@/*  returns by itself: the abort handler returns on its behalf.  Written   */
@/*  in assembly because the return path is not something C can express.   */
@/**************************************************************************/

    .align  2
    .global try_execute_data
    .type   try_execute_data, %function
try_execute_data:
    ldr     r1, =abort_return
    str     lr, [r1]
    ldr     r1, =fault_expected_pabt
    mov     r2, #1
    str     r2, [r1]
    dsb
    isb
    bx      r0                              /* fetch from XN memory: aborts   */

@/*  Fault reporters.  Each records which vector ran, a syndrome and a     */
@/*  faulting address, then parks.  Recording before parking is what makes */
@/*  a fault distinguishable from a hang when there is no console.         */
@/**************************************************************************/

@/*  Each handler loads its syndrome into r0 and a faulting or return      */
@/*  address into r3, then falls into FAULT_TAIL.  The instructions are not*/
@/*  passed as macro arguments: GNU as macro arguments are textual, and    */
@/*  an instruction containing a comma cannot be passed without quoting,   */
@/*  whose handling differs between assembler versions.                    */

    .macro  FAULT_TAIL vecid
    ldr     r1, =fault_vector
    mov     r2, #\vecid
    str     r2, [r1]
    ldr     r1, =fault_syndrome
    str     r0, [r1]
    ldr     r1, =fault_address
    str     r3, [r1]
    ldr     r1, =boot_stage
    mov     r2, #STAGE_FAULT
    str     r2, [r1]
1:  b       1b
    .endm

    .align  2

fault_el2_reset:
    mov     r0, #0
    mov     r3, lr
    FAULT_TAIL 0x20
fault_el2_undef:
    mov     r0, #0
    mov     r3, lr
    FAULT_TAIL 0x24
fault_el2_svc:
    mov     r0, #0
    mov     r3, lr
    FAULT_TAIL 0x28
fault_el2_pabt:
    mrc     p15, 4, r0, c5, c1, 0           /* HSR                          */
    mov     r3, lr
    FAULT_TAIL 0x2C
fault_el2_dabt:
    mrc     p15, 4, r0, c5, c1, 0           /* HSR                          */
    mrc     p15, 4, r3, c6, c0, 0           /* HDFAR                        */
    FAULT_TAIL 0x30
fault_el2_hyp:
    mrc     p15, 4, r0, c5, c2, 0           /* HSR (EC identifies the trap) */
    mrc     p15, 4, r3, c6, c0, 0           /* HDFAR                        */
    FAULT_TAIL 0x34
fault_el2_irq:
    mov     r0, #0
    mov     r3, lr
    FAULT_TAIL 0x38
fault_el2_fiq:
    mov     r0, #0
    mov     r3, lr
    FAULT_TAIL 0x3C

fault_el1_reset:
    mov     r0, #0
    mov     r3, lr
    FAULT_TAIL 0x40
fault_el1_undef:
    mov     r0, #0
    mov     r3, lr
    FAULT_TAIL 0x44
fault_el1_svc:
    mov     r0, #0
    mov     r3, lr
    FAULT_TAIL 0x48
fault_el1_pabt:
    /* Recoverable when a test has armed fault_expected_pabt.
       *
       * Recovery differs from the data-abort case in kind, not degree.  There,
       * the faulting instruction is a load or store and skipping it is enough.
       * Here the fault is on the instruction FETCH at the target address, so
       * there is no instruction to skip -- resuming anywhere near the fault
       * just faults again.  So the test saves the address it wants to come back
       * to in abort_return, and this handler returns there on its behalf.  */

    ldr     r0, =fault_expected_pabt
    ldr     r1, [r0]
    cmp     r1, #0
    beq     fault_el1_pabt_fatal

    mov     r1, #0
    str     r1, [r0]                        /* one-shot: disarm              */

    mrc     p15, 0, r2, c5, c0, 1           /* IFSR                          */
    ldr     r0, =fault_syndrome
    str     r2, [r0]
    mrc     p15, 0, r2, c6, c0, 2           /* IFAR                          */
    ldr     r0, =fault_address
    str     r2, [r0]
    ldr     r0, =fault_vector
    mov     r1, #0x4C
    str     r1, [r0]
    ldr     r0, =fault_taken
    ldr     r1, [r0]
    add     r1, r1, #1
    str     r1, [r0]
    dsb

    ldr     lr, =abort_return
    ldr     lr, [lr]
    subs    pc, lr, #0                      /* return to the test, not here   */

fault_el1_pabt_fatal:
    mrc     p15, 0, r0, c5, c0, 1           /* IFSR                         */
    mrc     p15, 0, r3, c6, c0, 2           /* IFAR                         */
    FAULT_TAIL 0x4C
fault_el1_dabt:
    /* Recoverable when a test has armed fault_expected.  The protection map is
       only meaningful if a violation actually faults, so the test provokes one
       deliberately and this path lets it continue: record the syndrome and
       address, count it, then resume at the instruction AFTER the faulting one.
       lr on data-abort entry is faulting_address + 8, so subs pc, lr, #4 skips
       the access rather than retrying it forever.

       Without the flag set, a data abort is still fatal and reported, which is
       what any real bug should get.  */

    ldr     r0, =fault_expected
    ldr     r1, [r0]
    cmp     r1, #0
    beq     fault_el1_dabt_fatal

    mov     r1, #0
    str     r1, [r0]                        /* one-shot: disarm              */

    mrc     p15, 0, r2, c5, c0, 0           /* DFSR                          */
    ldr     r0, =fault_syndrome
    str     r2, [r0]
    mrc     p15, 0, r2, c6, c0, 0           /* DFAR                          */
    ldr     r0, =fault_address
    str     r2, [r0]
    ldr     r0, =fault_vector
    mov     r1, #0x50
    str     r1, [r0]
    ldr     r0, =fault_taken
    ldr     r1, [r0]
    add     r1, r1, #1
    str     r1, [r0]
    dsb
    subs    pc, lr, #4                      /* resume after the access        */

fault_el1_dabt_fatal:
    mrc     p15, 0, r0, c5, c0, 0           /* DFSR                         */
    mrc     p15, 0, r3, c6, c0, 0           /* DFAR                         */
    FAULT_TAIL 0x50
fault_el1_reserved:
    mov     r0, #0
    mov     r3, lr
    FAULT_TAIL 0x54
fault_el1_irq:
    mov     r0, #0
    mov     r3, lr
    FAULT_TAIL 0x58
fault_el1_fiq:
    mov     r0, #0
    mov     r3, lr
    FAULT_TAIL 0x5C
