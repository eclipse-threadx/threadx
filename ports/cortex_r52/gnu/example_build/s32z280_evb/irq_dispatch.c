/***************************************************************************
 * Copyright (c) 2026 Eclipse ThreadX contributors
 *
 * This program and the accompanying materials are made available under the
 * terms of the MIT License which is available at
 * https://opensource.org/licenses/MIT.
 *
 * AI Disclosure: This file was largely AI-generated by Claude Code (Opus 5).
 * The AI-generated portions may be considered public domain (CC0-1.0)
 * and not subject to the project's licence. The human contributor has
 * reviewed and verified that the code is correct.
 *
 * SPDX-License-Identifier: MIT and CC0-1.0
 **************************************************************************/

/**************************************************************************/
/*                                                                        */
/*  BOARD SUPPORT                                          RELEASE        */
/*                                                                        */
/*    irq_dispatch.c                                   Cortex-R52/GNU     */
/*                                                           6.5.2        */
/*  AUTHOR                                                                */
/*                                                                        */
/*    Frederic Desbiens, Eclipse Foundation                               */
/*                                                                        */
/*  DESCRIPTION                                                           */
/*                                                                        */
/*    Interrupt dispatch for the S32Z280-594EVB, standalone.              */
/*                                                                        */
/*    Called from el1_irq_entry in entry.S.  Unlike the FVP example this  */
/*    does not call _tx_timer_interrupt: the image does not link ThreadX, */
/*    so a failure here is a board or GIC problem and not a kernel one.   */
/*    It counts ticks instead, which is what makes the interrupt visible. */
/*                                                                        */
/*    Every count is volatile and read by the debugger as well as printed.*/
/*    An interrupt that never arrives and an interrupt that arrives and is*/
/*    mishandled look identical from the console alone, and the separate  */
/*    spurious and unexpected counters distinguish them.                  */
/*                                                                        */
/**************************************************************************/

#include "gicv3.h"
#include "timer.h"
#include "board.h"
#include "mpu.h"
#ifdef TX_R52_USE_THREADX_IRQ
#include "tx_api.h"

/* ThreadX periodic timer entry point.  Assembly, and internal to the kernel,
   so it is not declared by tx_api.h.  Safe to call from C: it uses only r0-r3
   and returns through lr like an ordinary function.  */

extern void _tx_timer_interrupt(void);
#endif

/* Observable from both the console and a debugger.                       */

volatile unsigned long  board_irq_count;
volatile unsigned long  board_timer_intid;
volatile unsigned long  board_spurious_count;
volatile unsigned long  board_unexpected_intid;
volatile unsigned long  board_first_intid = 0xFFFFFFFFUL;

volatile unsigned long  board_nest_depth;
volatile unsigned long  board_nest_max;
volatile unsigned long  board_sgi_count;
volatile unsigned long  board_sgi_nested_count;
volatile unsigned long  board_nest_provoke;

volatile unsigned long  board_fiq_count;
volatile unsigned long  board_fiq_high_count;
volatile unsigned long  board_fiq_nested_count;
volatile unsigned long  board_fiq_depth;
volatile unsigned long  board_fiq_max_depth;
volatile unsigned long  board_fiq_unexpected;
volatile unsigned long  board_fiq_provoke;
volatile unsigned long  board_priority_bits;
volatile unsigned long  board_timer_priority;
volatile unsigned long  board_sgi_priority;

/* The EL1 physical timer PPI.  30 is the architectural assignment and is what
   the FVP turned out to use, but it was discovered there by enabling the whole
   PPI range and recording whichever INTID arrived in ICC_IAR1 rather than by
   assuming.  board_timer_intid records what actually arrives here, so a wrong
   value shows up as an unexpected INTID rather than as silence.  */

#define TIMER_PPI_INTID         30U

/* Only the top priority bits are implemented; hence a multiple of 8.     */

#define TIMER_PPI_PRIORITY      0xA0U


#ifdef TX_R52_USE_THREADX_IRQ

/**************************************************************************/
/*  board_init -- called from _tx_initialize_low_level.                   */
/*                                                                        */
/*  Order matters.  mpu_init() must run before anything touches the GIC:  */
/*  the distributor is unreachable until its region is mapped Device      */
/*  nGnRnE, and an access before that aborts.  Arming the timer here is   */
/*  safe because interrupts stay masked until _tx_thread_schedule enables */
/*  them, so no tick can arrive before the kernel can service one.        */
/**************************************************************************/

void board_init(void)
{
    (void) mpu_init();
    gicv3_init();
    gicv3_enable_ppi(TIMER_PPI_INTID, TIMER_PPI_PRIORITY);

    /* How many priority bits this GIC keeps decides whether the SGI can preempt
       the timer at all: equal priorities do not preempt, and it is the low bits
       that vanish.  Discovered rather than assumed, because the FVP keeps five
       and real silicon need not agree.  Recorded so the demo can report it, and
       a nesting failure caused by the two priorities colliding is visible
       instead of mysterious.  */

    board_priority_bits = gicv3_priority_bits(BOARD_NEST_SGI_INTID);

    /* Half the timer's value so the SGI outranks it: numerically lower wins.
       With TIMER_PPI_PRIORITY at 0xA0 that is 0x50, which stays distinct even
       if only three priority bits survive truncation.  */

    gicv3_enable_sgi(BOARD_NEST_SGI_INTID, TIMER_PPI_PRIORITY / 2U);

#ifdef TX_ENABLE_FIQ_SUPPORT

    /* Two Group 0 SGIs for the FIQ path.  Group 0 is what the GIC delivers as
       FIQ; the high one takes a numerically lower priority so it can preempt the
       low one, which is what FIQ nesting means.  Both sit above the timer so the
       IRQ and FIQ paths do not interfere.  */

    gicv3_enable_sgi_group0(BOARD_FIQ_LOW_INTID,  0x40U);
    gicv3_enable_sgi_group0(BOARD_FIQ_HIGH_INTID, 0x20U);
#endif

    /* The priorities as the GIC will actually compare them.  Only the top
       board_priority_bits survive; the low ones read back as zero, so two values
       that differ only there would collapse together and never preempt.  Recorded
       here because this is where the constants live.  */

    {
        unsigned long keep = (board_priority_bits >= 8UL)
                                 ? 0xFFUL
                                 : ((0xFFUL << (8UL - board_priority_bits)) & 0xFFUL);

        board_timer_priority = (unsigned long) TIMER_PPI_PRIORITY & keep;
        board_sgi_priority   = ((unsigned long) TIMER_PPI_PRIORITY / 2UL) & keep;
    }

    /* One tick every 10 ms at the measured 8 MHz counter rate.  */

    timer_start_oneshot_irq(timer_read_cntfrq() / 100U);
}

#endif


/**************************************************************************/
/*  board_irq_service -- service an already-acknowledged INTID.            */
/*                                                                        */
/*  Split out so the nesting path in entry.S can acknowledge in IRQ mode   */
/*  before nesting starts.  Does not acknowledge and does not EOI.         */
/**************************************************************************/

/**************************************************************************/
/*  Handler execution time, and where the handler's instructions live.    */
/*                                                                        */
/*  TX_R52_ATCM_ISR places the service routine in ATCM.  ATCM runs at full */
/*  core speed with one wait state; .text lives in RTU code RAM, which runs */
/*  at half the core frequency (S32Z2 RM 6.3.6).  ATCM also has no cache to */
/*  miss, which is the property that matters for a determinism argument.    */
/*                                                                        */
/*  Measured in cycles from the PMU counter, not CNTPCT: at 8 MHz CNTPCT    */
/*  cannot resolve a handler body, let alone the variation in one.          */
/*                                                                        */
/*  The timing wrapper below stays in .text in both configurations, so its  */
/*  own cost appears in every sample and cancels when the two are compared. */
/*  Only the body moves.  What matters in the result is the spread: a warm  */
/*  instruction cache can match ATCM on the mean and cannot match it on the */
/*  worst case.                                                            */
/**************************************************************************/

#define BOARD_LATENCY_SAMPLES   64U

unsigned int board_service_cycles[BOARD_LATENCY_SAMPLES];
unsigned int board_service_count;

#ifdef TX_R52_ATCM_ISR
#define BOARD_ISR_SECTION   __attribute__((section(".atcm_text")))
#else
#define BOARD_ISR_SECTION
#endif

static inline __attribute__((always_inline))
void board_irq_service_impl(unsigned long intid);




/* Aligned for the same reason as cache_workload: this body is timed, and
   without a fixed alignment the figure moves with unrelated code changes
   elsewhere in the image.  */

/* Four placements of one implementation.  The logic below is inlined into each
   of the four wrappers further down, each 64-byte aligned and then displaced by
   a different offset within the line, and the measurement rotates through them.

   A single placement is not measurable.  The cache benchmark in this file's
   sibling turned out to be bimodal with respect to exactly this, reporting 24%
   or 0% for identical silicon depending on where a loop fell in a line, and it
   invalidated a handler comparison and a defect report to NXP before anyone
   noticed.  Pinning one alignment does not fix that, it just chooses a mode.  */

static inline __attribute__((always_inline))
void board_irq_service_impl(unsigned long intid)
{
    if (intid == GICV3_SPURIOUS_INTID)
    {
        /* Nothing was actually pending.  Must not be acknowledged with an
           end-of-interrupt write, so return without one.  */

        board_spurious_count++;
        return;
    }

    /* After the spurious check, so a spurious entry does not read as nesting.
       Reaches 2 only if a second interrupt is taken while this one is still on
       the stack, which cannot happen without TX_ENABLE_IRQ_NESTING.  */

    board_nest_depth++;
    if (board_nest_depth > board_nest_max)
    {
        board_nest_max = board_nest_depth;
    }

    if (board_first_intid == 0xFFFFFFFFUL)
    {
        board_first_intid = intid;      /* whatever actually arrived */
    }

    if (intid == (unsigned long) TIMER_PPI_INTID)
    {
        board_timer_intid = intid;
        board_irq_count++;

        /* Re-arm first.  The generic timer output is level-sensitive, so until
           the compare is moved forward the condition stays asserted and the
           interrupt would be taken again immediately on return.  */

        timer_start_oneshot_irq(timer_read_cntfrq() / 100U);

        /* Provoke nesting, if this image asked for it.  Only useful because
           _tx_thread_irq_nesting_start has already re-enabled IRQ; the bounded
           spin gives the GIC time to deliver the higher-priority SGI before this
           handler returns, so the nesting is deterministic rather than a race we
           hope wins.  The bound matters: with nesting compiled out the SGI can
           never arrive here and this must not become a hang.  */

        if (board_nest_provoke != 0UL)
        {
            unsigned long seen = board_sgi_count;
            unsigned long guard;

            gicv3_send_sgi(BOARD_NEST_SGI_INTID);

            for (guard = 0UL; guard < 100000UL; guard++)
            {
                if (board_sgi_count != seen)
                {
                    break;
                }
            }
        }

#ifdef TX_R52_USE_THREADX_IRQ
        /* Drive the kernel's time base.  Called after the re-arm so the next
           interval is already running while the kernel does its bookkeeping.  */

        _tx_timer_interrupt();
#endif
    }
    else if (intid == (unsigned long) BOARD_NEST_SGI_INTID)
    {
        board_sgi_count++;

        if (board_nest_depth > 1UL)
        {
            board_sgi_nested_count++;
        }
    }
    else
    {
        board_unexpected_intid = intid;
    }

    board_nest_depth--;
}


/* The four placements.  pad nops shift the inlined body within its line.  */

#define MAKE_ISR_BODY(name, pad)                                              \
__attribute__((aligned(64), noinline))                                        \
static BOARD_ISR_SECTION void name(unsigned long intid)                       \
{                                                                             \
    __asm__ volatile(".rept " #pad "\n\tnop\n\t.endr");                       \
    board_irq_service_impl(intid);                                            \
}

MAKE_ISR_BODY(board_irq_body_a, 0)
MAKE_ISR_BODY(board_irq_body_b, 4)
MAKE_ISR_BODY(board_irq_body_c, 8)
MAKE_ISR_BODY(board_irq_body_d, 12)

#define BOARD_ISR_PLACEMENTS    4U
#define BOARD_SAMPLES_EACH      (BOARD_LATENCY_SAMPLES / BOARD_ISR_PLACEMENTS)

static void (*const board_irq_bodies[BOARD_ISR_PLACEMENTS])(unsigned long) =
{
    board_irq_body_a,       /* body at line offset 0  */
    board_irq_body_b,       /* body at line offset 16 */
    board_irq_body_c,       /* body at line offset 32 */
    board_irq_body_d        /* body at line offset 48 */
};


void board_irq_service(unsigned long intid)
{
    unsigned int before;
    unsigned int after;

    /* A block of samples per placement, so each alignment is measured under the
       same conditions rather than interleaved with the others.  */

    {
        unsigned int slot = board_service_count / BOARD_SAMPLES_EACH;

        if (slot >= BOARD_ISR_PLACEMENTS)
        {
            slot = BOARD_ISR_PLACEMENTS - 1U;
        }

        before = timer_read_cycles();
        board_irq_bodies[slot](intid);
        after  = timer_read_cycles();
    }

    if (board_service_count < BOARD_LATENCY_SAMPLES)
    {
        board_service_cycles[board_service_count] = after - before;
        board_service_count++;
    }
}


/**************************************************************************/
/*  board_irq_handler -- the non-nesting entry point.                      */
/*                                                                        */
/*  Acknowledges, services and ends the interrupt in IRQ mode with          */
/*  interrupts masked, which is what every image built without              */
/*  TX_ENABLE_IRQ_NESTING did before this split.                           */
/**************************************************************************/

void board_irq_handler(void)
{
    unsigned long intid = gicv3_acknowledge();

    board_irq_service(intid);

    if (intid != GICV3_SPURIOUS_INTID)
    {
        gicv3_end_of_interrupt(intid);
    }
}


#ifdef TX_ENABLE_FIQ_SUPPORT
/**************************************************************************/
/*  board_fiq_service -- service an already-acknowledged Group 0 INTID.     */
/*                                                                        */
/*  The FIQ counterpart of board_irq_service, and split for the same        */
/*  reason: the acknowledge has to happen before nesting starts.  Does not  */
/*  acknowledge and does not EOI.                                         */
/**************************************************************************/

void board_fiq_service(unsigned long intid)
{
    if (intid == GICV3_SPURIOUS_INTID)
    {
        return;
    }

    board_fiq_depth++;
    if (board_fiq_depth > board_fiq_max_depth)
    {
        board_fiq_max_depth = board_fiq_depth;
    }

    if (intid == (unsigned long) BOARD_FIQ_LOW_INTID)
    {
        board_fiq_count++;

        /* Provoke the nested FIQ from inside this handler.  Only reachable
           because _tx_thread_fiq_nesting_start has re-enabled FIQ; the bounded
           spin lets the GIC deliver the higher-priority Group 0 SGI before this
           handler returns.  Bounded, because with nesting compiled out the
           second FIQ cannot arrive and this must not hang.  */

        if (board_fiq_provoke != 0UL)
        {
            unsigned long seen = board_fiq_high_count;
            unsigned long guard;

            gicv3_send_sgi_group0(BOARD_FIQ_HIGH_INTID);

            for (guard = 0UL; guard < 100000UL; guard++)
            {
                if (board_fiq_high_count != seen)
                {
                    break;
                }
            }
        }
    }
    else if (intid == (unsigned long) BOARD_FIQ_HIGH_INTID)
    {
        board_fiq_high_count++;

        /* Depth above 1 means this FIQ arrived inside another FIQ handler.  */

        if (board_fiq_depth > 1UL)
        {
            board_fiq_nested_count++;
        }
    }
    else
    {
        board_fiq_unexpected = intid;
    }

    board_fiq_depth--;
}


/**************************************************************************/
/*  board_fiq_handler -- the non-nesting FIQ entry point.                  */
/**************************************************************************/

void board_fiq_handler(void)
{
    unsigned long intid = gicv3_acknowledge_group0();

    board_fiq_service(intid);

    if (intid != GICV3_SPURIOUS_INTID)
    {
        gicv3_end_of_interrupt_group0(intid);
    }
}
#endif
