/***************************************************************************
 * Copyright (c) 2026 Eclipse ThreadX contributors
 *
 * This program and the accompanying materials are made available under the
 * terms of the MIT License which is available at
 * https://opensource.org/licenses/MIT.
 *
 * AI Disclosure: This file was largely AI-generated by Claude Code (Opus 5).
 * The AI-generated portions may be considered public domain (CC0-1.0)
 * and not subject to the project's licence. The human contributor has
 * reviewed and verified that the code is correct.
 *
 * SPDX-License-Identifier: MIT and CC0-1.0
 **************************************************************************/

/**************************************************************************/
/*                                                                        */
/*  BOARD SUPPORT                                          RELEASE        */
/*                                                                        */
/*    demo_fiq_s32z280.c                               Cortex-R52/GNU     */
/*                                                           6.5.2        */
/*  AUTHOR                                                                */
/*                                                                        */
/*    Frederic Desbiens, Eclipse Foundation                               */
/*                                                                        */
/*  DESCRIPTION                                                           */
/*                                                                        */
/*    Nested FIQ handling: _tx_thread_fiq_nesting_start and                */
/*    _tx_thread_fiq_nesting_end, the last pair in this port that nothing  */
/*    had ever called.                                                    */
/*                                                                        */
/*    The FVP established that the Group 0 chain works and what breaks it.  */
/*    What it cannot show is whether a real GIC-600 routes Group 0 to FIQ   */
/*    the same way, which is the point of running this here.                */
/*                                                                        */
/*    FIQ needs more of the GIC than IRQ does.  With a single security     */
/*    state the controller delivers Group 0 as FIQ and Group 1 as IRQ, so  */
/*    an interrupt only arrives as an FIQ if it has been moved into Group  */
/*    0, the distributor and CPU interface both have Group 0 enabled, and  */
/*    it is acknowledged through the Group 0 registers.  Group 1's         */
/*    acknowledge returns the spurious INTID for a Group 0 interrupt and   */
/*    leaves it pending, which presents as a storm rather than an error.   */
/*                                                                        */
/*    FIQ nesting means an FIQ taken while an FIQ handler is running, so   */
/*    one source cannot demonstrate it.  Two Group 0 SGIs are used, the    */
/*    second at a numerically lower priority so it can preempt the first,  */
/*    and the first's handler raises it.                                   */
/*                                                                        */
/*  WHAT EACH CHECK IS FOR                                                */
/*                                                                        */
/*    F1  an FIQ arrives at all.  Separate on purpose: it covers the whole */
/*        Group 0 chain -- IGRPEN0, the ICC_SGI0R encoding, IAR0 and       */
/*        EOIR0, the EL1 FIQ vector, and F being unmasked.  If F1 fails    */
/*        the fault is in one of those and not in the nesting routines.    */
/*    F2  an FIQ arrived while another FIQ handler was active, depth 2.    */
/*    F3  the depth returned to zero, so the pairing unwound.              */
/*    F4  the IRQ path is undisturbed: the tick still advances.            */
/*    F5  threads still run, so FIQ context save and restore survived      */
/*        being re-entered.                                               */
/*    F6  no unexpected Group 0 INTID arrived.                             */
/*                                                                        */
/**************************************************************************/

#include "tx_api.h"
#include "board.h"
#include "linflexd.h"
#include "gicv3.h"

#define DEMO_STACK_SIZE     2048

static TX_THREAD    thread_check;
static TX_THREAD    thread_spin;

static ULONG        thread_check_stack[DEMO_STACK_SIZE / sizeof(ULONG)];
static ULONG        thread_spin_stack[DEMO_STACK_SIZE / sizeof(ULONG)];

static volatile ULONG   spin_runs;


/* Breakpoint target for tools/read_identity.gdb.  Not static and not empty so an
   optimising build cannot discard it.  */

void bsp_done(void)
{
    __asm volatile ("nop");
}


static UINT report(const char *label_ptr, UINT passed)
{
    linflexd_puts(label_ptr);
    linflexd_puts((passed != 0U) ? "PASS\n" : "FAIL\n");
    return (passed != 0U) ? 0U : 1U;
}


static void report_hex(const char *label_ptr, unsigned long value)
{
    linflexd_puts(label_ptr);
    linflexd_puts("0x");
    linflexd_put_hex32((unsigned int) value);
    linflexd_putc('\n');
}


static void thread_spin_entry(ULONG thread_input)
{
    (void) thread_input;

    for (;;)
    {
        spin_runs++;
    }
}


static void thread_check_entry(ULONG thread_input)
{
    UINT    failures = 0U;
    ULONG   fiq_before;
    ULONG   ticks_start;
    ULONG   ticks_end;
    ULONG   spin_before;

    (void) thread_input;

    /* F1: the whole Group 0 chain, before nesting is involved.  */

    linflexd_puts("raising a Group 0 SGI from thread context\n");

    fiq_before = board_fiq_count;
    gicv3_send_sgi_group0(BOARD_FIQ_LOW_INTID);
    tx_thread_sleep(2);

    report_hex("FIQ count = ", board_fiq_count);

    failures += report("F1 FIQ delivered and dispatched            ",
                       (board_fiq_count > fiq_before) ? 1U : 0U);

    if (board_fiq_count == fiq_before)
    {
        /* Everything below needs an FIQ to arrive, so repeating the failure
           five more times would only bury the cause.  */

        linflexd_puts("no FIQ arrived; the nesting checks would only\n"
                     "        restate that, so they are skipped.\n");
        linflexd_puts("FAIL nested FIQ handling\n");
        linflexd_puts("=== fiq demo complete ===\n");
        bsp_done();
        for (;;)
        {
            tx_thread_sleep(100UL);
        }
    }

    /* F2 onwards: let the low-priority FIQ handler raise the high one.  */

    linflexd_puts("enabling nested provocation in the FIQ handler\n");

    board_fiq_provoke = 1UL;
    ticks_start = tx_time_get();
    spin_before = spin_runs;

    {
        ULONG i;

        for (i = 0UL; i < 20UL; i++)
        {
            gicv3_send_sgi_group0(BOARD_FIQ_LOW_INTID);
            tx_thread_sleep(2);
        }
    }

    ticks_end = tx_time_get();
    board_fiq_provoke = 0UL;

    report_hex("low-priority FIQ count  = ", board_fiq_count);
    report_hex("high-priority FIQ count = ", board_fiq_high_count);
    report_hex("nested FIQ count        = ", board_fiq_nested_count);
    report_hex("max FIQ depth           = ", board_fiq_max_depth);
    report_hex("FIQ depth now           = ", board_fiq_depth);

    failures += report("F2 FIQ nested inside an FIQ handler        ",
                       ((board_fiq_nested_count > 0UL) &&
                        (board_fiq_max_depth >= 2UL)) ? 1U : 0U);

    failures += report("F3 FIQ nesting unwound to depth zero       ",
                       (board_fiq_depth == 0UL) ? 1U : 0U);

    failures += report("F4 IRQ tick undisturbed by FIQ work        ",
                       ((ticks_end - ticks_start) >= 30UL) ? 1U : 0U);

    failures += report("F5 lower-priority thread still scheduled   ",
                       (spin_runs > spin_before) ? 1U : 0U);

    report_hex("unexpected Group 0 INTID = ", board_fiq_unexpected);

    failures += report("F6 no unexpected Group 0 INTID             ",
                       (board_fiq_unexpected == 0UL) ? 1U : 0U);

    if (failures == 0U)
    {
        linflexd_puts("PASS nested FIQ handling verified on silicon\n");
    }
    else
    {
        linflexd_puts("FAIL nested FIQ handling\n");
    }

    linflexd_puts("=== fiq demo complete ===\n");

    bsp_done();

    for (;;)
    {
        tx_thread_sleep(100UL);
    }
}


void tx_application_define(void *first_unused_memory)
{
    (void) first_unused_memory;

    (void) tx_thread_create(&thread_check, "fiq check", thread_check_entry,
                            0UL, thread_check_stack, sizeof(thread_check_stack),
                            10U, 10U, TX_NO_TIME_SLICE, TX_AUTO_START);

    (void) tx_thread_create(&thread_spin, "spinner", thread_spin_entry,
                            0UL, thread_spin_stack, sizeof(thread_spin_stack),
                            20U, 20U, TX_NO_TIME_SLICE, TX_AUTO_START);
}


void bsp_main(void)
{
    unsigned int console_status = linflexd_init();

    linflexd_puts("\n=== ThreadX Cortex-R52 :: S32Z280-594EVB nested FIQ ===\n");
    report_hex("console = ", (unsigned long) console_status);
    linflexd_puts("entering kernel\n");

    tx_kernel_enter();

    /* Not reached.  */

    linflexd_puts("FAIL tx_kernel_enter returned\n");

    for (;;)
    {
        __asm volatile ("nop");
    }
}
