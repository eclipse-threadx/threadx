/***************************************************************************
 * Copyright (c) 2026 Eclipse ThreadX contributors
 *
 * This program and the accompanying materials are made available under the
 * terms of the MIT License which is available at
 * https://opensource.org/licenses/MIT.
 *
 * AI Disclosure: This file was largely AI-generated by Claude Code (Opus 5).
 * The AI-generated portions may be considered public domain (CC0-1.0)
 * and not subject to the project's licence. The human contributor has
 * reviewed and verified that the code is correct.
 *
 * SPDX-License-Identifier: MIT and CC0-1.0
 **************************************************************************/

/**************************************************************************/
/*                                                                        */
/*  BOARD SUPPORT                                          RELEASE        */
/*                                                                        */
/*    gicv3.c                                          Cortex-R52/GNU     */
/*                                                           6.5.2        */
/*  AUTHOR                                                                */
/*                                                                        */
/*    Frédéric Desbiens, Eclipse Foundation                               */
/*                                                                        */
/*  DESCRIPTION                                                           */
/*                                                                        */
/*    GICv3 bring-up for Cortex-R52 on the Armv8-R AEM FVP.               */
/*                                                                        */
/*    Model characteristics that shape this code, taken from its own      */
/*    parameters rather than assumed:                                     */
/*                                                                        */
/*      has-two-security-states=0  single security state, so GICD_CTLR.DS */
/*                                 reads 1 and the Group 1 enable is bit 1*/
/*      ARE-fixed-to-one=1         affinity routing cannot be turned off  */
/*      priority-bits=5            only the top 5 priority bits exist, so */
/*                                 priorities must be multiples of 8      */
/*                                                                        */
/*  MISRA C:2012 deviations (justified)                                   */
/*                                                                        */
/*    Directive 4.3 -- the CPU interface is only reachable through CP15   */
/*      system registers, so inline assembly is unavoidable.  Every such  */
/*      access is encapsulated in a one-line accessor below and appears   */
/*      nowhere else.                                                     */
/*    Rule 11.4/11.6 -- casting integer addresses to volatile pointers is */
/*      inherent to memory-mapped device access; confined to REG32.       */
/*                                                                        */
/**************************************************************************/

#include "platform.h"
#include "gicv3.h"

/* Distributor registers.                                                 */

#define GICD_CTLR               0x0000U
#define GICD_CTLR_ENABLE_GRP0   (1UL << 0)
#define GICD_CTLR_ENABLE_GRP1   (1UL << 1)
#define GICD_CTLR_ARE           (1UL << 4)

/* Redistributor RD frame.                                                */

#define GICR_WAKER              0x0014U
#define GICR_WAKER_PROC_SLEEP   (1UL << 1)
#define GICR_WAKER_CHILD_ASLEEP (1UL << 2)

/* Redistributor SGI frame (SGIs and PPIs, INTID 0-31).                   */

#define GICR_IGROUPR0           0x0080U
#define GICR_ISENABLER0         0x0100U
#define GICR_IPRIORITYR         0x0400U
#define GICR_ICFGR1             0x0C04U

#define ICC_PMR_UNMASK_ALL      0xFFUL
#define ICC_SRE_SRE             (1UL << 0)
#define ICC_IGRPEN1_ENABLE      (1UL << 0)

#define PPI_FIRST_INTID         16U


/**************************************************************************/
/*  CPU interface accessors (AArch32 ICC_* system registers).             */
/**************************************************************************/

static unsigned long read_icc_sre(void)
{
    unsigned long value;
    __asm__ volatile("mrc p15, 0, %0, c12, c12, 5" : "=r"(value));
    return value;
}

static void write_icc_sre(unsigned long value)
{
    __asm__ volatile("mcr p15, 0, %0, c12, c12, 5" : : "r"(value) : "memory");
}

static void write_icc_pmr(unsigned long value)
{
    __asm__ volatile("mcr p15, 0, %0, c4, c6, 0" : : "r"(value) : "memory");
}

static void write_icc_bpr1(unsigned long value)
{
    __asm__ volatile("mcr p15, 0, %0, c12, c12, 3" : : "r"(value) : "memory");
}

static void write_icc_igrpen0(unsigned long value)
{
    /* ICC_IGRPEN0 sits at c12, c12, 6, beside IGRPEN1 at opc2 7.  */

    __asm__ volatile("mcr p15, 0, %0, c12, c12, 6" : : "r"(value) : "memory");
}

static void write_icc_bpr0(unsigned long value)
{
    __asm__ volatile("mcr p15, 0, %0, c12, c8, 3" : : "r"(value) : "memory");
}

static void write_icc_igrpen1(unsigned long value)
{
    __asm__ volatile("mcr p15, 0, %0, c12, c12, 7" : : "r"(value) : "memory");
}

static void instruction_barrier(void)
{
    __asm__ volatile("isb" : : : "memory");
}


/**************************************************************************/
/*  gicv3_init                                                            */
/**************************************************************************/

void gicv3_init(void)
{
    unsigned long waker;

    /* Distributor: affinity routing first, then the Group 1 enable.  With a
       single security state Group 1 is bit 1 of GICD_CTLR.  */

    REG32(GICD_BASE + GICD_CTLR) |= GICD_CTLR_ARE;
    REG32(GICD_BASE + GICD_CTLR) |= GICD_CTLR_ENABLE_GRP1;

    /* Group 0 as well, which is what the GIC delivers as FIQ.  Enabling it costs
       nothing while no interrupt is assigned to that group, and images that never
       use FIQ see no change: assignment is per interrupt, in GICR_IGROUPR0.  */

    REG32(GICD_BASE + GICD_CTLR) |= GICD_CTLR_ENABLE_GRP0;

    /* Redistributor: clear ProcessorSleep and wait for the redistributor to
       report that its children are awake, otherwise no interrupt can be
       delivered to this core.  */

    waker = REG32(GICR_RD_BASE + GICR_WAKER);
    waker &= ~GICR_WAKER_PROC_SLEEP;
    REG32(GICR_RD_BASE + GICR_WAKER) = waker;

    while ((REG32(GICR_RD_BASE + GICR_WAKER) & GICR_WAKER_CHILD_ASLEEP) != 0UL)
    {
        /* Wait for the redistributor to wake.  */
    }

    /* CPU interface: system-register access, then unmask all priorities and
       enable Group 1.  EL2 has already permitted EL1 system-register access
       via ICC_HSRE in entry.S.  */

    write_icc_sre(read_icc_sre() | ICC_SRE_SRE);
    instruction_barrier();

    write_icc_pmr(ICC_PMR_UNMASK_ALL);
    write_icc_bpr1(0UL);
    write_icc_igrpen1(ICC_IGRPEN1_ENABLE);

    /* The CPU interface half of Group 0: a Group 0 interrupt reaches the core
       only if both the distributor and this are enabled.  BPR0 at zero gives no
       subpriority grouping, so priority alone decides preemption, which is what
       the FIQ nesting test depends on.  */

    write_icc_bpr0(0UL);
    write_icc_igrpen0(ICC_IGRPEN1_ENABLE);
    instruction_barrier();
}


/**************************************************************************/
/*  gicv3_enable_ppi                                                      */
/**************************************************************************/

void gicv3_enable_ppi(unsigned int intid, unsigned int priority)
{
    unsigned long shift;

    if ((intid < PPI_FIRST_INTID) || (intid > 31U))
    {
        return;
    }

    /* Group 1.  */

    REG32(GICR_SGI_BASE + GICR_IGROUPR0) |= (1UL << intid);

    /* Priority is a byte per INTID.  Only the top 5 bits are implemented on
       this model, so callers pass multiples of 8.  */

    REG32(GICR_SGI_BASE + GICR_IPRIORITYR + (intid & ~3U)) &=
        ~(0xFFUL << ((intid & 3U) * 8U));
    REG32(GICR_SGI_BASE + GICR_IPRIORITYR + (intid & ~3U)) |=
        ((unsigned long) priority & 0xFFUL) << ((intid & 3U) * 8U);

    /* Level-sensitive: two configuration bits per INTID, 00 = level.  The
       generic timer asserts a level, not an edge.  */

    shift = ((unsigned long) intid - PPI_FIRST_INTID) * 2UL;
    REG32(GICR_SGI_BASE + GICR_ICFGR1) &= ~(3UL << shift);

    /* Enable.  */

    REG32(GICR_SGI_BASE + GICR_ISENABLER0) = (1UL << intid);
}


/**************************************************************************/
/*  gicv3_acknowledge                                                     */
/**************************************************************************/

/**************************************************************************/
/*  gicv3_enable_sgi                                                      */
/*                                                                        */
/*  An SGI lives in the same redistributor frame as a PPI, so this is      */
/*  gicv3_enable_ppi without the ICFGR step: INTIDs 0-15 have no           */
/*  configurable edge/level, they are always edge-triggered.               */
/**************************************************************************/

void gicv3_enable_sgi(unsigned int intid, unsigned int priority)
{
    if (intid > 15U)
    {
        return;
    }

    REG32(GICR_SGI_BASE + GICR_IGROUPR0) |= (1UL << intid);

    REG32(GICR_SGI_BASE + GICR_IPRIORITYR + (intid & ~3U)) &=
        ~(0xFFUL << ((intid & 3U) * 8U));
    REG32(GICR_SGI_BASE + GICR_IPRIORITYR + (intid & ~3U)) |=
        ((unsigned long) priority & 0xFFUL) << ((intid & 3U) * 8U);

    REG32(GICR_SGI_BASE + GICR_ISENABLER0) = (1UL << intid);
}


/**************************************************************************/
/*  gicv3_send_sgi                                                        */
/*                                                                        */
/*  ICC_SGI1R is 64-bit, so in AArch32 it is an MCRR rather than an MCR.   */
/*  Fields: INTID in [27:24], TargetList in [15:0], Aff1/2/3 and IRM zero  */
/*  for this single-core configuration, so TargetList = 1 selects core 0.  */
/*                                                                        */
/*  The AArch64 name for this register is S3_0_C12_C11_5, which the        */
/*  Cortex-A72 example uses, but that encoding does not transcribe to the  */
/*  AArch32 64-bit CP15 space.  The CRm here was confirmed by observing    */
/*  that the SGI is actually delivered and acknowledged with the expected  */
/*  INTID rather than by reading it off the A-profile alias.               */
/**************************************************************************/

void gicv3_send_sgi(unsigned int intid)
{
    unsigned long low  = (((unsigned long) intid & 0xFUL) << 24) | 1UL;
    unsigned long high = 0UL;

    __asm volatile ("mcrr p15, 0, %0, %1, c12" :: "r" (low), "r" (high) : "memory");
    instruction_barrier();
}


/**************************************************************************/
/*  gicv3_priority_bits                                                    */
/*                                                                        */
/*  How many priority bits this GIC actually implements, discovered rather  */
/*  than assumed: write 0xFF to a priority byte and see which bits stick.   */
/*  The unimplemented bits are the low ones and they read as zero.          */
/*                                                                        */
/*  This matters for nesting.  Two interrupts only preempt one another if   */
/*  their priorities differ AFTER truncation, so a test that picks values    */
/*  0x20 apart on a GIC keeping four bits is testing nothing.  The FVP      */
/*  keeps five; real silicon need not agree.                               */
/*                                                                        */
/*  Called before the SGI is configured, and it leaves the byte at zero, so */
/*  the caller must set the priority it wants afterwards.                   */
/**************************************************************************/

unsigned int gicv3_priority_bits(unsigned int scratch_intid)
{
    unsigned long shift;
    unsigned long readback;
    unsigned int  bits = 0U;

    if (scratch_intid > 31U)
    {
        return 0U;
    }

    shift = (unsigned long) (scratch_intid & 3U) * 8UL;

    REG32(GICR_SGI_BASE + GICR_IPRIORITYR + (scratch_intid & ~3U)) |=
        (0xFFUL << shift);
    readback = (REG32(GICR_SGI_BASE + GICR_IPRIORITYR + (scratch_intid & ~3U))
                >> shift) & 0xFFUL;
    REG32(GICR_SGI_BASE + GICR_IPRIORITYR + (scratch_intid & ~3U)) &=
        ~(0xFFUL << shift);

    while (readback != 0UL)
    {
        if ((readback & 1UL) != 0UL)
        {
            bits++;
        }
        readback >>= 1;
    }

    return bits;
}


/**************************************************************************/
/*  gicv3_enable_sgi_group0                                                */
/*                                                                        */
/*  As gicv3_enable_sgi, but leaves the interrupt in Group 0 so it arrives  */
/*  as an FIQ.  The group is chosen by clearing the GICR_IGROUPR0 bit; the  */
/*  Group 1 version sets it.                                              */
/**************************************************************************/

void gicv3_enable_sgi_group0(unsigned int intid, unsigned int priority)
{
    if (intid > 15U)
    {
        return;
    }

    REG32(GICR_SGI_BASE + GICR_IGROUPR0) &= ~(1UL << intid);

    REG32(GICR_SGI_BASE + GICR_IPRIORITYR + (intid & ~3U)) &=
        ~(0xFFUL << ((intid & 3U) * 8U));
    REG32(GICR_SGI_BASE + GICR_IPRIORITYR + (intid & ~3U)) |=
        ((unsigned long) priority & 0xFFUL) << ((intid & 3U) * 8U);

    REG32(GICR_SGI_BASE + GICR_ISENABLER0) = (1UL << intid);
}


/**************************************************************************/
/*  gicv3_send_sgi_group0                                                  */
/*                                                                        */
/*  ICC_SGI0R rather than ICC_SGI1R: the two differ only in opc1, 2 against */
/*  0, and each raises the SGI into its own group.  Raising a Group 0       */
/*  interrupt through the Group 1 register does not deliver it as an FIQ.   */
/**************************************************************************/

void gicv3_send_sgi_group0(unsigned int intid)
{
    unsigned long low  = (((unsigned long) intid & 0xFUL) << 24) | 1UL;
    unsigned long high = 0UL;

    __asm volatile ("mcrr p15, 2, %0, %1, c12" :: "r" (low), "r" (high) : "memory");
    instruction_barrier();
}


/**************************************************************************/
/*  gicv3_acknowledge_group0 / gicv3_end_of_interrupt_group0               */
/*                                                                        */
/*  Group 0 has its own pair at c12, c8, where Group 1 uses c12, c12.       */
/*  Acknowledging a Group 0 interrupt through IAR1 returns the spurious     */
/*  INTID and leaves the interrupt pending, which presents as an FIQ storm. */
/**************************************************************************/

unsigned long gicv3_acknowledge_group0(void)
{
    unsigned long intid;

    __asm__ volatile("mrc p15, 0, %0, c12, c8, 0" : "=r"(intid));
    return intid & 0xFFFFFFUL;
}


void gicv3_end_of_interrupt_group0(unsigned long intid)
{
    instruction_barrier();
    __asm__ volatile("mcr p15, 0, %0, c12, c8, 1" : : "r"(intid) : "memory");
}


unsigned long gicv3_acknowledge(void)
{
    unsigned long intid;

    __asm__ volatile("mrc p15, 0, %0, c12, c12, 0" : "=r"(intid));

    return intid;
}


/**************************************************************************/
/*  gicv3_end_of_interrupt                                                */
/**************************************************************************/

void gicv3_end_of_interrupt(unsigned long intid)
{
    __asm__ volatile("mcr p15, 0, %0, c12, c12, 1" : : "r"(intid) : "memory");
}
