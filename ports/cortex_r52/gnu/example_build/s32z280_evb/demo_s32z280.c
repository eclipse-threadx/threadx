/***************************************************************************
 * Copyright (c) 2026 Eclipse ThreadX contributors
 *
 * This program and the accompanying materials are made available under the
 * terms of the MIT License which is available at
 * https://opensource.org/licenses/MIT.
 *
 * AI Disclosure: This file was largely AI-generated by Claude Code (Opus 5).
 * The AI-generated portions may be considered public domain (CC0-1.0)
 * and not subject to the project's licence. The human contributor has
 * reviewed and verified that the code is correct.
 *
 * SPDX-License-Identifier: MIT and CC0-1.0
 **************************************************************************/

/**************************************************************************/
/*                                                                        */
/*  BOARD SUPPORT                                          RELEASE        */
/*                                                                        */
/*    demo_s32z280.c                                   Cortex-R52/GNU     */
/*                                                           6.5.2        */
/*  AUTHOR                                                                */
/*                                                                        */
/*    Frederic Desbiens, Eclipse Foundation                               */
/*                                                                        */
/*  DESCRIPTION                                                           */
/*                                                                        */
/*    ThreadX running on S32Z280 silicon: threads, preemption and the     */
/*    timer tick.                                                         */
/*                                                                        */
/*    The demo judges itself and says why it failed, because a hang and a */
/*    wrong answer are equally likely on first silicon and look the same  */
/*    from a console.  Each check is separate:                            */
/*                                                                        */
/*      ticks     -- the tick advanced, so the GIC delivers the timer PPI */
/*                   and _tx_timer_interrupt is reached                   */
/*      sleeper   -- tx_thread_sleep returned, so tick-driven scheduling  */
/*                   works, not merely the interrupt                      */
/*      spinner   -- the low-priority thread ran, so the sleeper actually */
/*                   yielded the core rather than blocking it             */
/*      preempt   -- the sleeper resumed while the spinner was runnable,  */
/*                   which is preemption rather than cooperative handoff  */
/*                                                                        */
/*    Counting alone would not distinguish these: a demo that only checked*/
/*    that both threads ran would pass with a broken tick if the threads  */
/*    happened to yield to each other.                                    */
/*                                                                        */
/**************************************************************************/

#include "tx_api.h"
#include "linflexd.h"
#include "timer.h"
#include "cache.h"
#include "board.h"

#define DEMO_STACK_SIZE         2048

static TX_THREAD    sleeper_thread;
static TX_THREAD    spinner_thread;
static TX_THREAD    judge_thread;

/* One stack in BTCM, the rest in DRAM0, so a run exercises both and the
   difference is visible if one of them is wrong.

   BTCM is 16 KB at zero wait states and is never cached, whatever the MPU says
   about it.  That is the point for a stack: access cost does not depend on
   whether a line happens to be resident, which is what a determinism argument
   needs.  Measured on this part, uncached BTCM comes within 6.6% of the best
   cached case, where uncached DRAM0 is 22% off it.

   entry.S writes every location in the bank before any C runs, which is
   required before a read because ECC is enabled (TRM 6.2.2).  A stack is read
   before it is written -- the first context restore pops what tx_thread_create
   built -- so that preload is not optional here.  */

__attribute__((section(".btcm_bss"), aligned(8)))
static unsigned char sleeper_stack[DEMO_STACK_SIZE];
static unsigned char spinner_stack[DEMO_STACK_SIZE];
static unsigned char judge_stack[DEMO_STACK_SIZE];

static volatile unsigned long   sleeper_runs;
static volatile unsigned long   spinner_runs;
static volatile unsigned long   preempt_observed;


/* Breakpoint target for tools/read_identity.gdb.  Defined here rather than
   pulled from bsp_boot.c, whose bsp_main would collide with this file's.
   Not static and not empty, so an optimising build cannot discard it.  */

void bsp_done(void)
{
    __asm volatile ("nop");
}


static void report(const char *name, unsigned long value)
{
    linflexd_puts(name);
    linflexd_puts(" = 0x");
    linflexd_put_hex32((unsigned int) value);
    linflexd_putc('\n');
}


/* Highest priority.  Sleeps, so it can only run again if the tick advances
   and the scheduler resumes it.  */

/**************************************************************************/
/*  Context-switch cost, stack in BTCM against stack in DRAM0.            */
/*                                                                        */
/*  Two pairs of equal-priority threads hand control back and forth with  */
/*  tx_thread_relinquish, and the measuring thread of each pair times the  */
/*  round trip.  One pair has both stacks in BTCM, the other in DRAM0.     */
/*                                                                        */
/*  A round trip is two context switches plus the partner's loop, and the  */
/*  partner's code is the same for both pairs, so the difference between   */
/*  the pairs is the memory holding the stacks and nothing else.           */
/*                                                                        */
/*  Both pairs run in one image from one copy of the measuring code, which */
/*  is what makes this comparison safe.  The alignment trap that invalid-  */
/*  ated earlier work here bites when two builds with different layouts    */
/*  are compared; a code shift moves both pairs equally and cancels.       */
/*                                                                        */
/*  Cycles, from the PMU counter: CNTPCT at 8 MHz cannot resolve a context */
/*  switch.  Priorities 2 and 3 put the BTCM pair first and keep both      */
/*  above judge and spinner.  The sleeper at priority 1 still preempts     */
/*  occasionally, which can land in max; min and mean are the robust       */
/*  figures and all three are reported.                                    */
/**************************************************************************/

static void demo_dec(unsigned long value)
{
    char            digits[12];
    unsigned int    n = 0U;

    if (value == 0UL) { linflexd_putc('0'); return; }

    while ((value > 0UL) && (n < 12U))
    {
        digits[n] = (char) ('0' + (value % 10UL));
        value /= 10UL;
        n++;
    }
    while (n > 0U) { n--; linflexd_putc(digits[n]); }
}

#define CTX_SAMPLES     256U
#define CTX_PAIRS       2U

static TX_THREAD    ctx_btcm_a_thread;
static TX_THREAD    ctx_btcm_b_thread;
static TX_THREAD    ctx_dram_a_thread;
static TX_THREAD    ctx_dram_b_thread;

__attribute__((section(".btcm_bss"), aligned(8)))
static unsigned char ctx_btcm_a_stack[DEMO_STACK_SIZE];
__attribute__((section(".btcm_bss"), aligned(8)))
static unsigned char ctx_btcm_b_stack[DEMO_STACK_SIZE];

static unsigned char ctx_dram_a_stack[DEMO_STACK_SIZE];
static unsigned char ctx_dram_b_stack[DEMO_STACK_SIZE];

static volatile unsigned int ctx_done[CTX_PAIRS];
static unsigned int          ctx_lo[CTX_PAIRS];
static unsigned int          ctx_hi[CTX_PAIRS];
static unsigned int          ctx_mean[CTX_PAIRS];
static unsigned int          ctx_over[CTX_PAIRS];

/* A round trip costs about 1400 cycles.  Anything past this is not a context
   switch, it is a switch that got interrupted -- the sleeper at priority 1
   preempts either pair when a tick lands mid-measurement.  Counted rather than
   averaged in, because max is otherwise a report on which pair was unlucky:
   across three runs the maximum appeared in the BTCM pair once and the DRAM0
   pair twice, while min and mean held to the cycle.  */

#define CTX_OUTLIER_CYCLES  2000U

/* Cache state, and why it is forced rather than left to chance.

   With the cache left alone this workload never evicts anything: the DRAM0
   stack stays resident in the 16 KB data cache, every access is a hit, and
   DRAM0 measures beautifully.  That is a true result for an idle system and a
   misleading one for the argument TCM is usually made for, which is about worst
   case when other work has pushed your stack out.

   Loading the partner thread with a cache walk does not work either: the timed
   round trip includes the partner, so the walk dominates every sample.  It was
   tried and discarded, and it put every one of 256 samples past the outlier
   threshold.

   Instead the cache is cleaned and invalidated immediately before each timed
   switch, outside the timed region.  Every switch then runs from a cold cache,
   which is the state a stack in DRAM0 finds itself in after other work has run
   and the state a stack in BTCM is immune to, because an enabled TCM is never
   cached.  Both pairs get the same treatment, so the difference is the memory.  */


/* One copy, used by both pairs.  */

static void ctx_measure_entry(ULONG which)
{
    unsigned int    lo  = 0xFFFFFFFFU;
    unsigned int    hi  = 0U;
    unsigned long   sum = 0UL;
    unsigned int    over = 0U;
    unsigned int    counted = 0U;
    unsigned int    i;

    for (i = 0U; i < CTX_SAMPLES; i++)
    {
        unsigned int before;
        unsigned int after;
        unsigned int delta;

        /* Cold cache for every sample, and clean before invalidate so dirty
           stack lines reach memory rather than being discarded.  Outside the
           timestamps, so its own cost is not in the measurement.  */

        cache_clean_all();
        cache_invalidate_dcache_all();

        before = timer_read_cycles();
        tx_thread_relinquish();
        after  = timer_read_cycles();

        delta = after - before;

        if (delta > CTX_OUTLIER_CYCLES)
        {
            /* Preempted mid-switch.  Excluded from min, max and mean alike: a
               maximum that reports whichever pair a tick landed on is not a
               measurement of anything, and reporting it as jitter was wrong
               once already.  */

            over++;
        }
        else
        {
            if (delta < lo) { lo = delta; }
            if (delta > hi) { hi = delta; }
            sum += (unsigned long) delta;
            counted++;
        }
    }

    ctx_lo[which]   = lo;
    ctx_hi[which]   = hi;
    ctx_mean[which] = (counted > 0U) ? (unsigned int) (sum / counted) : 0U;
    ctx_over[which] = over;

    ctx_done[which] = 1U;               /* releases the partner */
}

static void ctx_partner_entry(ULONG which)
{
    while (ctx_done[which] == 0U)
    {
        tx_thread_relinquish();
    }
}

static void sleeper_entry(ULONG input)
{
    unsigned long spinner_before;

    (void) input;

    for (;;)
    {
        spinner_before = spinner_runs;

        tx_thread_sleep(5UL);           /* 50 ms at a 10 ms tick */

        sleeper_runs++;

        /* If the spinner advanced while this thread slept, and this thread is
           the higher priority of the two, then resuming it took the core away
           from a runnable lower-priority thread.  That is preemption.  */

        if (spinner_runs != spinner_before)
        {
            preempt_observed++;
        }
    }
}


/* Lowest priority.  Never blocks, so it only runs when nothing else can. */

static void spinner_entry(ULONG input)
{
    (void) input;

    for (;;)
    {
        spinner_runs++;
    }
}


/* Middle priority.  Waits, then judges and reports.                      */

static void judge_entry(ULONG input)
{
    ULONG   ticks_start;
    ULONG   ticks_end;
    UINT    failures = 0U;

    (void) input;

    ticks_start = tx_time_get();
    tx_thread_sleep(100UL);             /* about one second */
    ticks_end = tx_time_get();

    linflexd_puts("\n=== ThreadX on S32Z280: results ===\n");

    linflexd_puts("context switch round trip, cycles\n");
    {
        static const char *const where[CTX_PAIRS] = { "stacks in BTCM ",
                                                      "stacks in DRAM0" };
        unsigned int q;

        for (q = 0U; q < CTX_PAIRS; q++)
        {
            linflexd_puts("  ");
            linflexd_puts(where[q]);
            if (ctx_done[q] == 0U)
            {
                linflexd_puts(": did not finish\n");
            }
            else
            {
                linflexd_puts(": min ");
                demo_dec(ctx_lo[q]);
                linflexd_puts("  mean ");
                demo_dec(ctx_mean[q]);
                linflexd_puts("  max ");
                demo_dec(ctx_hi[q]);
                linflexd_puts("  preempted ");
                demo_dec(ctx_over[q]);
                linflexd_puts(" of ");
                demo_dec(CTX_SAMPLES);
                linflexd_puts("\n");
            }
        }
    }
    report("ticks    ", (unsigned long) (ticks_end - ticks_start));
    report("sleeper  ", sleeper_runs);
    report("spinner  ", spinner_runs);
    report("preempt  ", preempt_observed);

    if ((ticks_end - ticks_start) < 50UL)
    {
        linflexd_puts("FAIL tick did not advance as expected\n");
        failures++;
    }

    if (sleeper_runs == 0UL)
    {
        linflexd_puts("FAIL sleeper never resumed\n");
        failures++;
    }

    if (spinner_runs == 0UL)
    {
        linflexd_puts("FAIL spinner never ran\n");
        failures++;
    }

    if (preempt_observed == 0UL)
    {
        linflexd_puts("FAIL no preemption observed\n");
        failures++;
    }

    if (failures == 0U)
    {
        linflexd_puts("PASS threads, tick and preemption all verified\n");
    }

    linflexd_puts("=== demo complete ===\n");

    bsp_done();

    for (;;)
    {
        tx_thread_sleep(100UL);
    }
}


void tx_application_define(void *first_unused_memory)
{
    (void) first_unused_memory;

    linflexd_puts("stacks: sleeper 0x");
    linflexd_put_hex32((unsigned int) (unsigned long) sleeper_stack);
    linflexd_puts(" (BTCM)  spinner 0x");
    linflexd_put_hex32((unsigned int) (unsigned long) spinner_stack);
    linflexd_puts("  judge 0x");
    linflexd_put_hex32((unsigned int) (unsigned long) judge_stack);
    linflexd_puts("\n");

    (void) tx_thread_create(&sleeper_thread, "sleeper", sleeper_entry, 0UL,
                            sleeper_stack, DEMO_STACK_SIZE,
                            1U, 1U, TX_NO_TIME_SLICE, TX_AUTO_START);

    (void) tx_thread_create(&judge_thread, "judge", judge_entry, 0UL,
                            judge_stack, DEMO_STACK_SIZE,
                            10U, 10U, TX_NO_TIME_SLICE, TX_AUTO_START);

    /* The PMU cycle counter has to be started here.  bsp_boot.c starts it for
       the probe image, and this image does not run bsp_boot.c, so without this
       every reading below would be zero -- which would read as a free context
       switch rather than as a dead counter.  */

    timer_cycles_enable();

    /* BTCM pair first at priority 2, DRAM0 pair after it at 3.  */

    (void) tx_thread_create(&ctx_btcm_b_thread, "ctxB btcm", ctx_partner_entry, 0UL,
                            ctx_btcm_b_stack, DEMO_STACK_SIZE,
                            2U, 2U, TX_NO_TIME_SLICE, TX_AUTO_START);
    (void) tx_thread_create(&ctx_btcm_a_thread, "ctxA btcm", ctx_measure_entry, 0UL,
                            ctx_btcm_a_stack, DEMO_STACK_SIZE,
                            2U, 2U, TX_NO_TIME_SLICE, TX_AUTO_START);

    (void) tx_thread_create(&ctx_dram_b_thread, "ctxB dram", ctx_partner_entry, 1UL,
                            ctx_dram_b_stack, DEMO_STACK_SIZE,
                            3U, 3U, TX_NO_TIME_SLICE, TX_AUTO_START);
    (void) tx_thread_create(&ctx_dram_a_thread, "ctxA dram", ctx_measure_entry, 1UL,
                            ctx_dram_a_stack, DEMO_STACK_SIZE,
                            3U, 3U, TX_NO_TIME_SLICE, TX_AUTO_START);

    (void) tx_thread_create(&spinner_thread, "spinner", spinner_entry, 0UL,
                            spinner_stack, DEMO_STACK_SIZE,
                            20U, 20U, TX_NO_TIME_SLICE, TX_AUTO_START);
}


/**************************************************************************/
/*  bsp_main -- entered at EL1 from entry.S; hands over to the kernel.    */
/**************************************************************************/

void bsp_main(void)
{
    unsigned int console_status = linflexd_init();

    linflexd_puts("\n=== ThreadX Cortex-R52 :: S32Z280-594EVB ===\n");
    report("console  ", (unsigned long) console_status);
    linflexd_puts("entering kernel\n");

    tx_kernel_enter();

    /* Not reached.  */

    linflexd_puts("FAIL tx_kernel_enter returned\n");

    for (;;)
    {
        __asm volatile ("nop");
    }
}
