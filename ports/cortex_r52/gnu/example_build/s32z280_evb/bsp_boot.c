/***************************************************************************
 * Copyright (c) 2026 Eclipse ThreadX contributors
 *
 * This program and the accompanying materials are made available under the
 * terms of the MIT License which is available at
 * https://opensource.org/licenses/MIT.
 *
 * AI Disclosure: This file was largely AI-generated by Claude Code (Opus 5).
 * The AI-generated portions may be considered public domain (CC0-1.0)
 * and not subject to the project's licence. The human contributor has
 * reviewed and verified that the code is correct.
 *
 * SPDX-License-Identifier: MIT and CC0-1.0
 **************************************************************************/

/**************************************************************************/
/*                                                                        */
/*  BOARD SUPPORT                                          RELEASE        */
/*                                                                        */
/*    bsp_boot.c                                       Cortex-R52/GNU     */
/*                                                           6.5.2        */
/*  AUTHOR                                                                */
/*                                                                        */
/*    Frédéric Desbiens, Eclipse Foundation                               */
/*                                                                        */
/*  DESCRIPTION                                                           */
/*                                                                        */
/*    First-boot verification for the NXP S32Z280-594EVB.  Records what   */
/*    the core reports about itself into a structure a debugger reads.    */
/*                                                                        */
/*    There is no console on this board yet: LIN9 reaches the host through*/
/*    the daughtercard USB-UART, but its baud rate depends on clock       */
/*    configuration that is not yet established, and a console that prints*/
/*    at the wrong rate produces garbage indistinguishable from a crash.  */
/*    So this milestone reports through memory instead, which cannot be   */
/*    mis-configured.  The console arrives in the next step.              */
/*                                                                        */
/*    Only EL1-accessible registers are read here.  EL2-only ones         */
/*    (HMPUIR, CNTFRQ) are captured by entry.S before the drop to EL1,    */
/*    because reading them at EL1 would trap rather than return a value.  */
/*                                                                        */
/*  MISRA C:2012 deviations (justified)                                   */
/*                                                                        */
/*    Dir 4.3 -- assembly language shall be encapsulated and isolated.    */
/*      Each MRC is wrapped in its own single-statement static function   */
/*      below, which is the encapsulation the directive asks for.  There  */
/*      is no other way to read a coprocessor register from C.            */
/*                                                                        */
/*    Rule 8.4 -- bsp_main is called from assembly and so has no C caller */
/*      to provide a prototype; it is declared in board.h, which entry.S  */
/*      cannot include.                                                   */
/*                                                                        */
/**************************************************************************/

#include "board.h"
#include "platform.h"
#include "linflexd.h"
#include "timer.h"
#include "gic_probe.h"
#include "mpu.h"
#include "gicv3.h"
#include "cache.h"
#include "tcm.h"

/* Captured at EL2 by entry.S, before the drop to EL1.                    */

extern unsigned int  boot_stage;
extern unsigned int  cpsr_at_el2;
extern unsigned int  cpsr_at_el1;
extern unsigned int  cntfrq_at_el2;
extern unsigned int  hmpuir_at_el2;
extern unsigned int  probe_stage;
extern unsigned int  fault_expected;
extern unsigned int  fault_taken;

/* Mirror of the console markers into memory.  The UART has twice gone away at
   the moment a marker mattered -- once when a stalled access took the debug
   connection down with it, once when the USB passthrough detached -- and a
   stalled access records no fault, so boot_stage alone cannot say how far the
   risky sequence got.  This can be read post-mortem without a console.  */

#define MARK(n)     do { probe_stage = (unsigned int)(n); } while (0)

/* Filled in below and read by the debugger.  Not static: the whole point is
   for something outside this translation unit to find it.  */

r52_identity_t  r52_identity;


/* One MRC per function, each isolated, per MISRA Dir 4.3.                */

static unsigned int read_midr(void)
{
    unsigned int value;
    __asm volatile ("mrc p15, 0, %0, c0, c0, 0" : "=r" (value));
    return value;
}

static unsigned int read_mpuir(void)
{
    unsigned int value;
    __asm volatile ("mrc p15, 0, %0, c0, c0, 4" : "=r" (value));
    return value;
}

static unsigned int read_ctr(void)
{
    unsigned int value;
    __asm volatile ("mrc p15, 0, %0, c0, c0, 1" : "=r" (value));
    return value;
}

static unsigned int read_mpidr(void)
{
    unsigned int value;
    __asm volatile ("mrc p15, 0, %0, c0, c0, 5" : "=r" (value));
    return value;
}

static unsigned int read_id_pfr0(void)
{
    unsigned int value;
    __asm volatile ("mrc p15, 0, %0, c0, c1, 0" : "=r" (value));
    return value;
}

static unsigned int read_id_pfr1(void)
{
    unsigned int value;
    __asm volatile ("mrc p15, 0, %0, c0, c1, 1" : "=r" (value));
    return value;
}

static unsigned int read_sctlr(void)
{
    unsigned int value;
    __asm volatile ("mrc p15, 0, %0, c1, c0, 0" : "=r" (value));
    return value;
}


/**************************************************************************/
/*  report -- one "NAME = VALUE" line on the console.                     */
/**************************************************************************/

static void report(const char *name, unsigned int value)
{
    linflexd_puts(name);
    linflexd_puts(" = 0x");
    linflexd_put_hex32(value);
    linflexd_putc('\n');
}


/**************************************************************************/
/*  bsp_done -- breakpoint target, reached once the structure is complete.*/
/*                                                                        */
/*  Deliberately not static and deliberately not inlined: it exists purely*/
/*  so a debugger can break on a symbol.  An optimising build would remove*/
/*  an empty static function, and then the script would have nothing to   */
/*  attach to.                                                            */
/**************************************************************************/

/* Clear CPSR.I so the GIC can deliver to this core.  Interrupts stay masked
   from reset all the way to here on purpose: nothing before this point is
   prepared to service one.  */

static void enable_irq_at_el1(void)
{
    __asm volatile ("cpsie i" ::: "memory");
    __asm volatile ("isb");
}


/* Cache benchmark.
 *
 * Two things have to be right for a cache to show a measurable effect, and the
 * first version of this test got both wrong.  It used a 4 KB static buffer in
 * DRAM0, a full-core-speed bank, and reported a 0.036% difference -- noise --
 * as a pass.  A bank running at core speed leaves a cache almost nothing to
 * save.  DRAM2 runs at half core speed, which is why the buffer lives there.
 *
 *   1. The memory must be slower than the core.  This uses the extended SRAM at
 *      S32Z_DRAM2_BASE, the RTU data bank that runs at half the core
 *      frequency, so caching it has something to show.
 *
 *   2. The working set must fit in the cache and be revisited.  It is sized
 *      from CCSIDR at run time -- half the reported L1 data cache -- rather
 *      than from a guessed constant.  A set larger than the cache would stream
 *      and evict, and would show little benefit even over slow memory.
 *
 * Reported alongside the timings so the numbers can be judged, not just
 * believed.
 */

static unsigned long cache_bench_words;

static void cache_workload(void)
{
    volatile unsigned int  *buffer = (volatile unsigned int *) S32Z_DRAM2_BASE;
    unsigned long           pass;
    unsigned long           i;

    for (pass = 0UL; pass < 32UL; pass++)
    {
        for (i = 0UL; i < cache_bench_words; i++)
        {
            buffer[i] = buffer[i] + i + pass;
        }
    }
}


unsigned int fault_syndrome_value(void)
{
    extern unsigned int fault_syndrome;
    return fault_syndrome;
}


unsigned int fault_address_value(void)
{
    extern unsigned int fault_address;
    return fault_address;
}


unsigned int read_sctlr_after_mpu(void)
{
    return read_sctlr();
}


void bsp_done(void)
{
    __asm volatile ("nop");
}


/**************************************************************************/
/*  bsp_main -- entered at EL1 (Supervisor) from entry.S.  Never returns. */
/**************************************************************************/

void bsp_main(void)
{
    /* Written last, so a debugger that finds the magic knows every other
       field is already valid.  A partially filled structure would otherwise
       be indistinguishable from a complete one.  */

    r52_identity.magic        = 0U;

    r52_identity.midr         = read_midr();
    r52_identity.mpuir        = read_mpuir();
    r52_identity.ctr          = read_ctr();
    r52_identity.mpidr        = read_mpidr();
    r52_identity.id_pfr0      = read_id_pfr0();
    r52_identity.id_pfr1      = read_id_pfr1();
    r52_identity.sctlr_el1    = read_sctlr();

    r52_identity.hmpuir_el2   = hmpuir_at_el2;
    r52_identity.cntfrq_el2   = cntfrq_at_el2;
    r52_identity.cpsr_el2     = cpsr_at_el2;
    r52_identity.cpsr_el1     = cpsr_at_el1;

    /* Derived counts, so the debugger script does not have to know where the
       field sits in each register.  MPUIR reports DREGION in bits [15:8].
       HMPUIR is recorded raw as well, because on this part the count appears
       in bits [7:0] instead and that layout still needs confirming against
       the Armv8-R specification.  */

    r52_identity.mpu_regions_el1 = (r52_identity.mpuir >> 8) & 0xFFU;

    r52_identity.magic        = R52_IDENTITY_MAGIC;

    /* Report over the console as well as through memory.  The memory copy
       stays: it is what proved the boot path before a console existed, and it
       still works if the console itself is misconfigured.  */

    r52_identity.console_status = linflexd_init();
    linflexd_puts("\n=== ThreadX Cortex-R52 :: NXP S32Z280-594EVB ===\n");
    report("MIDR     ", r52_identity.midr);
    report("MPUIR    ", r52_identity.mpuir);
    report("HMPUIR   ", r52_identity.hmpuir_el2);
    report("CTR      ", r52_identity.ctr);
    report("MPIDR    ", r52_identity.mpidr);
    report("ID_PFR0  ", r52_identity.id_pfr0);
    report("ID_PFR1  ", r52_identity.id_pfr1);
    report("SCTLR    ", r52_identity.sctlr_el1);
    report("CNTFRQ   ", r52_identity.cntfrq_el2);
    report("CPSR@EL2 ", r52_identity.cpsr_el2);
    report("CPSR@EL1 ", r52_identity.cpsr_el1);
    linflexd_puts("EL1 MPU regions: ");
    linflexd_put_hex32(r52_identity.mpu_regions_el1);
    linflexd_putc('\n');
    report("CONSOLE  ", r52_identity.console_status);

    /* --- generic timer ----------------------------------------------------
       CNTFRQ is now programmed at EL2 (8 MHz, measured and cross-checked
       against CFG_CNTDV and FXOSC).  Prove the timer end to end: read it back,
       then arm a one-second one-shot and poll for it, bracketed by CNTPCT
       samples.  If the counter and the compare agree, the elapsed count is
       CNTFRQ; if the host also sees one second pass, the rate itself is right
       rather than merely self-consistent.

       Interrupt stays masked -- no GIC yet.  Polling first means a later
       interrupt problem cannot be confused with the timer being wrong.  */

    report("CNTFRQ   ", timer_read_cntfrq());

    {
        unsigned long long before;
        unsigned long long after;
        unsigned int       hz = timer_read_cntfrq();

        /* Sample AFTER the message, not before: at 115200 the line itself is
           about 2 ms, and sampling first puts that inside the measurement.  */

        linflexd_puts("TIMER arming 1s one-shot\n");
        before = timer_read_cntpct();
        timer_start_oneshot(hz);

        while (timer_fired() == 0U)
        {
            /* poll */
        }

        after = timer_read_cntpct();
        timer_stop();

        linflexd_puts("TIMER fired, elapsed counts = 0x");
        linflexd_put_hex32((unsigned int)((after - before) >> 32));
        linflexd_put_hex32((unsigned int)(after - before));
        linflexd_puts("\n");
    }

    /* --- where is the GIC, and is the port to it open? ---------------------
       System-register reads only: a load from the GIC window stalls the core,
       so nothing here touches memory.  */

    report("IMP_CBAR ", gic_read_cbar());
    report("PERIPHPRG", gic_read_periphpregionr());

    /* The peripheral port is now enabled at EL2, so RTU peripheral space
       should be reachable.  Marker first: if this still stalls, the run dies
       here and says so.  */

    linflexd_puts("P1 RTU0.GPR CFG_CNTDV via LLPP\n");
    report("CFG_CNTDV", *(volatile unsigned int *)S32Z_RTU0_GPR_CFG_CNTDV);

    /* --- TCM: what the hardware reports about itself ---------------------
       Reads only.  platform.h has recorded since bring-up that the TCM windows
       fault at reset, and the Cortex-R52 TRM says why: every bit of the region
       registers resets to zero apart from SIZE and WAITSTATES, so the banks sit
       at base 0 with both enables clear.  This confirms that on the part rather
       than trusting it, and cross-checks the reported sizes against the S32Z2
       reference manual, which documents TCMA 64KB, TCMB 16KB and TCMC 16KB.

       Nothing is written here.  Enabling TCM also requires initialising the ECC
       bits before any read (TRM 6.2.2), with ATCM needing 64-bit aligned stores
       where BTCM and CTCM accept 32-bit, so the enable belongs in its own step
       once these values are known.  */

    linflexd_puts("T1 TCM configuration as reported by the core\n");
    {
        static const char *const bank_name[3] = { "ATCM", "BTCM", "CTCM" };
        static const unsigned long expect_bytes[3] = { 0x10000UL, 0x4000UL, 0x4000UL };
        unsigned int i;

        for (i = 0U; i < 3U; i++)
        {
            tcm_bank_t bank;

            tcm_read_bank(i, &bank);

            linflexd_puts(bank_name[i]);
            linflexd_puts(" raw=0x");
            linflexd_put_hex32((unsigned int) bank.raw);
            linflexd_puts(" base=0x");
            linflexd_put_hex32((unsigned int) bank.base);
            linflexd_puts(" size=0x");
            linflexd_put_hex32((unsigned int) bank.size_bytes);
            linflexd_puts(" ws=");
            linflexd_putc((char) ('0' + (char) bank.wait_states));
            linflexd_puts(" en2=");
            linflexd_putc((char) ('0' + (char) bank.enable_el2));
            linflexd_puts(" en10=");
            linflexd_putc((char) ('0' + (char) bank.enable_el10));
            linflexd_puts((bank.size_bytes == expect_bytes[i])
                              ? "  size matches the RM\n"
                              : "  SIZE DISAGREES WITH THE RM\n");
        }

        report("MEMPROTCTLR", (unsigned int) tcm_read_memprotctlr());
        linflexd_puts("ECC implemented = ");
        linflexd_putc((char) ('0' + (char) tcm_ecc_implemented()));
        linflexd_puts(", enabled = ");
        linflexd_putc((char) ('0' + (char) tcm_ecc_enabled()));
        linflexd_putc('\n');
    }

    /* --- TCM: enable, preload, prove ------------------------------------
       Done before the MPU goes on, so a failure here is not confused with a
       missing MPU region.  The preload is not optional: ECC is enabled on this
       part, so a location read before it has been written reports an error, and
       that error would look exactly like an inaccessible TCM.  */

    MARK(0x20);
    linflexd_puts("T2 TCM state as entry.S left it\n");
    {
        static const char *const bank_name[3] = { "ATCM", "BTCM", "CTCM" };
        unsigned int i;
        unsigned int atcm_ok;

        /* Verification only.  Nothing is programmed here: ENABLEEL2 is ignored
           when written from EL1, so TCM setup belongs at EL2 in entry.S, and
           calling tcm_enable() from here would additionally switch on the banks
           entry.S deliberately leaves off.  */

        for (i = 0U; i < 3U; i++)
        {
            tcm_bank_t bank;

            tcm_read_bank(i, &bank);

            linflexd_puts(bank_name[i]);
            linflexd_puts(" base=0x");
            linflexd_put_hex32((unsigned int) bank.base);
            linflexd_puts(" en2=");
            linflexd_putc((char) ('0' + (char) bank.enable_el2));
            linflexd_puts(" en10=");
            linflexd_putc((char) ('0' + (char) bank.enable_el10));
            linflexd_puts((bank.enable_el10 != 0U)
                              ? "  enabled\n"
                              : "  off on purpose, see entry.S\n");
        }

        tcm_read_bank(0U, &(tcm_bank_t){0});
        {
            tcm_bank_t atcm;

            tcm_read_bank(0U, &atcm);
            atcm_ok = ((atcm.base == S32Z_ATCM_BASE) &&
                       (atcm.enable_el2 != 0U) && (atcm.enable_el10 != 0U)) ? 1U : 0U;
        }

        if (atcm_ok != 0U)
        {
            MARK(0x21);
            linflexd_puts("T3 preloading ATCM to establish ECC check bits\n");
            tcm_preload(0U, S32Z_ATCM_BASE, S32Z_ATCM_SIZE);

            MARK(0x22);
            linflexd_puts("T4 write and read back ATCM\n");
            {
                volatile unsigned int *first = (volatile unsigned int *) S32Z_ATCM_BASE;
                volatile unsigned int *last  =
                    (volatile unsigned int *) (S32Z_ATCM_BASE + S32Z_ATCM_SIZE - 4UL);

                *first = 0xA5A5A5A5U;
                *last  = 0x5A5A5A5AU;

                linflexd_puts(((*first == 0xA5A5A5A5U) && (*last == 0x5A5A5A5AU))
                                  ? "ATCM PASS first and last word hold\n"
                                  : "ATCM FAIL readback mismatch\n");
            }
        }
        else
        {
            linflexd_puts("T3 skipped: ATCM is not enabled as expected\n");
        }
    }

    /* --- MPU, then the GIC ------------------------------------------------
       The GIC needs its region mapped Device nGnRnE (Cortex-R52 TRM), which
       needs the MPU on.  Markers around the enable: if the console survives it,
       the UART region is right; if it does not, that is the answer.  */

    MARK(0x10);
    linflexd_puts("M1 enabling MPU\n");
    {
        unsigned int regions = mpu_init();

        MARK(0x11);

    /* Read back what the region programming actually did.  Five regions die on
       the SCTLR.M write while three survive, and the difference is the region
       COUNT rather than the Device attribute -- so the question is whether
       PRSELR/PRBAR/PRLAR programming takes effect at all for indices 3 and 4,
       which nothing has ever exercised: the FVP example this code came from
       only ever programs three regions.  The MPU is not enabled in this build,
       so this cannot stall.  */

    linflexd_puts("R  idx  PRBAR      PRLAR\n");
    {
        unsigned int i;
        for (i = 0U; i < 8U; i++)
        {
            unsigned long prbar = 0UL;
            unsigned long prlar = 0UL;

            mpu_read_region(i, &prbar, &prlar);
            linflexd_puts("R  ");
            linflexd_put_hex32(i);
            linflexd_puts(" ");
            linflexd_put_hex32((unsigned int) prbar);
            linflexd_puts(" ");
            linflexd_put_hex32((unsigned int) prlar);
            linflexd_putc('\n');
        }
    }


        report("MPU rgns ", regions);
        report("SCTLR    ", read_sctlr_after_mpu());
        MARK(0x12);
        linflexd_puts("M2 MPU enabled, console alive\n");

        linflexd_puts("M3 GICD_PIDR2 (was stalling before the MPU)\n");
        MARK(0x13);
        report("GICD_PIDR2", *(volatile unsigned int *)(S32Z_GIC_BASE + 0xFFE8UL));
        MARK(0x14);
        report("GICD_TYPER", *(volatile unsigned int *)(S32Z_GIC_BASE + 0x0004UL));
        MARK(0x15);
        report("GICR_PIDR2", *(volatile unsigned int *)(S32Z_GIC_BASE + 0x10FFE8UL));
        MARK(0x16);
        linflexd_puts("M4 GIC reachable\n");

        /* TCM again, now that the MPU is enforcing.  The TRM requires an MPU
           region per TCM before it can be used, so this is the check that those
           three regions are right -- an enabled TCM with no region faults here
           and nowhere earlier.  */

        MARK(0x23);
        linflexd_puts("T5 ATCM still reachable with the MPU on\n");
        {
            volatile unsigned int *p = (volatile unsigned int *) S32Z_ATCM_BASE;
            tcm_bank_t  atcm;
            unsigned int answers;

            tcm_read_bank(0U, &atcm);

            *p = 0x5A5A0000U;
            answers = (*p == 0x5A5A0000U) ? 1U : 0U;

            /* Both halves matter.  A disabled TCM's range is serviced through
               AXIM, so memory answering there says nothing about the TCM: an
               earlier version of this check reported every bank accessible while
               two of them were disabled.  */

            if ((answers != 0U) && (atcm.enable_el10 != 0U))
            {
                linflexd_puts("ATCM PASS enabled and holding data under MPU\n");
            }
            else if (answers != 0U)
            {
                linflexd_puts("ATCM NOT TCM: address answers but the bank is\n"
                              "     disabled, so this is AXIM behind it\n");
            }
            else
            {
                linflexd_puts("ATCM FAIL address does not answer\n");
            }
        }

        /* --- interrupts -------------------------------------------------
           Bring up the GIC properly, enable the timer PPI, arm a 10 ms
           one-shot and unmask IRQ at EL1.  Then wait and see whether the
           handler runs.  Polling proved the timer counts and fires; this
           proves the interrupt is delivered, which is a different claim.  */

        MARK(0x50);
        /* Copy the handler into ATCM now, and not earlier: T4 and T5 write test
       patterns to the first and last words of the bank, which would land on top
       of this code.  The ECC preload in T3 has already established check bits
       for the whole bank, and the 64-bit stores in the copy maintain them for
       every location it writes.  */

    linflexd_puts("T6 copying .atcm_text into ATCM\n");
    {
        unsigned long copied = tcm_copy_atcm_text();

        report("atcm bytes", (unsigned int) copied);
        if (copied == 0UL)
        {
            linflexd_puts("  nothing placed in ATCM in this image\n");
        }
    }

    timer_cycles_enable();

    linflexd_puts("I1 gicv3_init\n");
        gicv3_init();

        MARK(0x51);
        /* Enable the WHOLE PPI range rather than just 30.  All three counters
           reading zero means nothing reached the CPU interface, and an enabled
           but wrong INTID produces exactly that silence -- so let the hardware
           say which PPI the timer actually drives.  This is how INTID 30 was
           established on the FVP too: assume nothing, record what arrives.  */

        linflexd_puts("I2 enable PPIs 16..31\n");
        {
            unsigned int ppi;
            for (ppi = 16U; ppi <= 31U; ppi++)
            {
                gicv3_enable_ppi(ppi, 0xA0U);
            }
        }

        MARK(0x52);
        linflexd_puts("I3 arm timer, unmask IRQ\n");
        timer_start_oneshot_irq(timer_read_cntfrq() / 100U);   /* 10 ms */
        enable_irq_at_el1();

        MARK(0x53);
        {
            extern unsigned int board_service_count;
            unsigned int spins = 0U;

            /* Wait for ticks.  Bounded: a missing interrupt must report
               itself rather than hang the boot.  */

            /* Wait for a full set of latency samples, not just a few ticks:
               the figure of interest is the worst case, and a handful of
               samples cannot show it.  Still bounded, so a missing interrupt
               reports itself rather than hanging the boot.  */

            while ((board_service_count < 64U) && (spins < 400U))
            {
                timer_spin(200000U);
                spins++;
            }
        }

        MARK(0x54);
        report("IRQ count", (unsigned int) board_irq_count);
        report("timer INTID", (unsigned int) board_timer_intid);
        report("spurious ", (unsigned int) board_spurious_count);
        report("unexpected", (unsigned int) board_unexpected_intid);

        /* Handler body execution time.  Reported as min, max and mean rather
           than mean alone: the spread is the point.  */

        {
            extern unsigned int board_service_cycles[];
            extern unsigned int board_service_count;

            unsigned int i;
            unsigned int lo = 0xFFFFFFFFU;
            unsigned int hi = 0U;
            unsigned long sum = 0UL;
            unsigned int n;

            /* Stop the source and snapshot the count before reading any of it.
               The timer re-arms inside the handler, so samples keep arriving
               otherwise: the first version of this read let the count grow
               between computing the extremes and dividing for the mean, and
               printed a mean below the minimum.  */

            timer_stop();
            n = board_service_count;

            for (i = 0U; i < n; i++)
            {
                unsigned int v = board_service_cycles[i];

                if (v < lo) { lo = v; }
                if (v > hi) { hi = v; }
                sum += (unsigned long) v;
            }

            linflexd_puts("I5 handler body cycles ");
#ifdef TX_R52_ATCM_ISR
            linflexd_puts("(body in ATCM)\n");
#else
            linflexd_puts("(body in code RAM)\n");
#endif
            report("samples  ", n);
            if (n > 0U)
            {
                report("min      ", lo);
                report("max      ", hi);
                report("mean     ", (unsigned int) (sum / n));
                report("spread   ", hi - lo);
            }
        }
        report("first INTID", (unsigned int) board_first_intid);
        linflexd_puts("I4 interrupt test done\n");
    }

    /* --- GIC: not reachable yet, probe deliberately removed ----------------
       The GIC window NXP's memory map gives for this cluster, 0x47800000, is
       unreachable from BOTH paths in the current state.  The debugger cannot
       read any of it, and a load from the core stalls the core outright: the
       run dies at the marker before the access, with no fault recorded and the
       debug connection dropped -- the same signature as RTU0.GPR.

       The Reference Manual contains no GIC base address anywhere, so that
       address rests entirely on NXP's debugger script.  What the manual does
       mention is the R52's "Arm low-latency peripheral port".  On Cortex-R52
       the LLPP is an implementation-defined region that software programs and
       enables; if it is disabled out of reset, or covers a different base,
       accesses to a peripheral in that window stall exactly like this.
       Settling it needs the Cortex-R52 TRM, which documents the region
       registers -- NXP's manual does not.

       The probe is removed rather than left disabled: while it was present the
       image stalled here every run, which costs the timer and console results
       that come before it.  */

    /* --- caches ------------------------------------------------------------
       Enabled last, and measured rather than merely switched on.  Reading
       SCTLR back proves a bit was set; timing the same workload before and
       after proves the caches are actually doing something.  The generic timer
       supplies the clock -- 8 MHz, established earlier -- so the comparison is
       in real units rather than loop counts.  */

    MARK(0x70);
    report("CLIDR    ", (unsigned int) cache_read_clidr());
    report("D line   ", (unsigned int) cache_dcache_line_bytes());
    report("D ways   ", (unsigned int) cache_dcache_ways());
    report("D sets   ", (unsigned int) cache_dcache_sets());
    report("D bytes  ", (unsigned int) cache_dcache_bytes());

    /* Half the data cache, in words: fits comfortably and is revisited every
       pass, which is the case a cache is meant to win.  */

    cache_bench_words = cache_dcache_bytes() / (2UL * sizeof(unsigned int));
    report("bench wds", (unsigned int) cache_bench_words);

    linflexd_puts("C1 timing over DRAM2, the half-speed bank, caches OFF\n");
    {
        unsigned long long before;
        unsigned long long after;
        unsigned long       cold;
        unsigned long       warm;

        before = timer_read_cntpct();
        cache_workload();
        after  = timer_read_cntpct();
        cold   = (unsigned long) (after - before);

        MARK(0x71);
        linflexd_puts("C2 enabling caches\n");
        cache_enable();
        MARK(0x72);
        report("SCTLR    ", read_sctlr_after_mpu());
        report("cachesOn ", cache_enabled());

        before = timer_read_cntpct();
        cache_workload();
        after  = timer_read_cntpct();
        warm   = (unsigned long) (after - before);

        MARK(0x73);
        report("counts off", cold);
        report("counts on ", warm);

        /* Report the two claims separately, because they are separate.
           "Enabled" is what SCTLR says and is checkable.  "Effective" needs a
           measurable speedup, and a criterion of merely warm < cold is
           worthless: the first run of this test showed 609904 against 609686,
           a 0.036% difference that is noise, and printed PASS on it.

           A cache having little to offer here is plausible rather than
           broken.  Both the code and the data this workload touches live in
           full-speed RTU banks, which the core reaches at its own
             clock; the only slower memory on this board is DRAM2 at
             half speed, and DDR, which is not initialised.  */

        if (cache_enabled() == 1U)
        {
            linflexd_puts("C3 PASS caches enabled (SCTLR.C and SCTLR.I set)\n");
        }
        else
        {
            linflexd_puts("C3 FAIL caches did not enable\n");
        }

        if (cold > warm)
        {
            unsigned long gain = ((cold - warm) * 1000UL) / cold;

            report("gain/1000", gain);

            if (gain >= 100UL)
            {
                linflexd_puts("C4 PASS caches measurably faster (>=10%)\n");
            }
            else
            {
                linflexd_puts("C4 speedup below 10% -- see gain/1000 above\n");
            }
        }
        else
        {
            linflexd_puts("C4 no speedup measured\n");
        }

        /* Push the markers and counters out of the write-back cache so a
           debugger reading SRAM sees them.  Without this a post-mortem read
           could report stale values from before the cache was enabled.  */

        cache_clean_all();
        MARK(0x74);
        cache_clean_all();
    }

    /* --- protection test ---------------------------------------------------
       The map claims code is read-only.  Prove it: arm the recoverable abort
       path, write to the code region, and check that a fault was actually
       taken.  Reading SCTLR back or listing the regions would only show what
       was programmed; provoking the violation shows it is enforced.

       This is worth doing now for a second reason: until SCTLR.TE was cleared
       no fault handler could run at all, so no protection claim about this
       board could be checked.  */

    MARK(0x60);
    linflexd_puts("X1 write to read-only code region\n");
    fault_taken = 0U;
    fault_expected = 1U;

    *(volatile unsigned int *)S32Z_CODE_SRAM_BASE = 0xDEADBEEFUL;

    MARK(0x61);
    report("faults   ", fault_taken);
    report("fault DFSR", fault_syndrome_value());
    report("fault addr", fault_address_value());

    if (fault_taken == 1U)
    {
        linflexd_puts("X2 PASS write to code faulted and was recovered\n");
    }
    else
    {
        linflexd_puts("X2 FAIL write to code did NOT fault -- code is writable\n");
    }

    /* --- second protection case: execute from data -------------------------
       The map marks the data region execute-never.  Prove that too: branch
       into it and check a prefetch abort was taken.  Separate from the
       write-to-code case because they exercise different permissions and
       different fault paths -- a map could plausibly enforce one and not the
       other, and DFSR/IFSR come from different registers.  */

    MARK(0x62);
    linflexd_puts("X3 execute from non-executable data region\n");
    fault_taken = 0U;

    try_execute_data(S32Z_DATA_SRAM_BASE);

    MARK(0x63);
    report("faults   ", fault_taken);
    report("fault IFSR", fault_syndrome_value());
    report("fault addr", fault_address_value());

    if (fault_taken == 1U)
    {
        linflexd_puts("X4 PASS execute from data faulted and was recovered\n");
    }
    else
    {
        linflexd_puts("X4 FAIL data region is executable\n");
    }

    /* Deliberate breakpoint target.  The debug script sets a hardware
       breakpoint here, so "the image ran to completion" is something the script
       observes rather than infers from a timeout.  */

    bsp_done();

    /* Park.  The debugger halts the core and reads r52_identity.
       A busy loop rather than WFI: this core's debug behaviour is still being
       characterised, and a core sitting in a low-power state is one more
       variable between "the code ran" and "the debugger sees it".  The nop
       also stops the compiler discarding a side-effect-free infinite loop.  */

    for (;;)
    {
        __asm volatile ("nop");
    }
}
