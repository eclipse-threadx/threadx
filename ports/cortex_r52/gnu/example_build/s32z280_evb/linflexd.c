/***************************************************************************
 * Copyright (c) 2026 Eclipse ThreadX contributors
 *
 * This program and the accompanying materials are made available under the
 * terms of the MIT License which is available at
 * https://opensource.org/licenses/MIT.
 *
 * AI Disclosure: This file was largely AI-generated by Claude Code (Opus 5).
 * The AI-generated portions may be considered public domain (CC0-1.0)
 * and not subject to the project's licence. The human contributor has
 * reviewed and verified that the code is correct.
 *
 * SPDX-License-Identifier: MIT and CC0-1.0
 **************************************************************************/

/**************************************************************************/
/*                                                                        */
/*  BOARD SUPPORT                                          RELEASE        */
/*                                                                        */
/*    linflexd.c                                       Cortex-R52/GNU     */
/*                                                           6.5.2        */
/*  AUTHOR                                                                */
/*                                                                        */
/*    Frédéric Desbiens, Eclipse Foundation                               */
/*                                                                        */
/*  DESCRIPTION                                                           */
/*                                                                        */
/*    Polled console on LINFlex_9, which is the instance wired to the     */
/*    S32Z280-594EVB daughtercard USB-UART through jumper J248.  Not      */
/*    LINFlex_0: that is simply the first instance in the Reference       */
/*    Manual's list and reaches no connector on this board.               */
/*                                                                        */
/*  BAUD RATE                                                             */
/*                                                                        */
/*    LINFlex_9 is clocked by P5_LIN_BAUD_CLK, which MC_CGM_5 MUX 2       */
/*    drives.  Read from the board: MUX_2_CSS selects source 2 with the   */
/*    divider set to 1, and the EVB carries a 40 MHz crystal (UG10268     */
/*    section 3.3.1.1), so the clock is 40 MHz.                           */
/*                                                                        */
/*        LFDIV   = 40000000 / (16 * 115200) = 21.7014                    */
/*        LINIBRR = 21                                                    */
/*        LINFBRR = round(0.7014 * 16) = 11                               */
/*        actual  = 40000000 / (16 * 21.6875) = 115274 baud, 0.06% error  */
/*                                                                        */
/*    Those are exactly the values the BootROM had already left in the    */
/*    registers, which is what confirms the 40 MHz figure rather than     */
/*    merely assuming it.  They are programmed here anyway: inheriting    */
/*    another program's register state makes this image's behaviour       */
/*    depend on how the board was last booted.                            */
/*                                                                        */
/*    The BootROM's configuration is NOT reused for a second reason: it   */
/*    leaves PCE set (parity enabled) and TxEn clear, because it is       */
/*    listening for a serial-boot download rather than printing.  A host  */
/*    terminal set to 8N1 against that would show framing errors.         */
/*                                                                        */
/*  MISRA C:2012 deviations (justified)                                   */
/*                                                                        */
/*    Rule 11.4/11.6 -- casting integer addresses to volatile pointers is */
/*      inherent to memory-mapped device access; confined to REG32.       */
/*                                                                        */
/**************************************************************************/

#include "linflexd.h"
#include "platform.h"

/* Register offsets, from the S32Z2 Reference Manual section 75.5.1.      */

#define LINFLEXD_LINCR1         0x00U
#define LINFLEXD_LINSR          0x08U
#define LINFLEXD_UARTCR         0x10U
#define LINFLEXD_UARTSR         0x14U
#define LINFLEXD_LINFBRR        0x24U
#define LINFLEXD_LINIBRR        0x28U
#define LINFLEXD_BDRL           0x38U

/* LINCR1                                                                 */
#define LINCR1_INIT             (1U << 0)       /* initialisation mode      */
#define LINCR1_SLEEP            (1U << 1)

/* UARTCR.  Bit positions verified against the register diagram; PCE at bit 2
   and TxEn at bit 4 are the two that matter here and are easy to transpose.  */
#define UARTCR_UART             (1U << 0)       /* UART rather than LIN mode */
#define UARTCR_WL0              (1U << 1)       /* with WL1 clear: 8-bit     */
#define UARTCR_PCE              (1U << 2)       /* parity enable             */
#define UARTCR_TXEN             (1U << 4)
#define UARTCR_RXEN             (1U << 5)

/* UARTSR                                                                 */
#define UARTSR_DTF              (1U << 1)       /* transmit complete, w1c    */

/* LINSR[15:12] is the LIN state; 0x1 is initialisation mode.  Confirmed by
   reading 0x2000 (idle) from the BootROM-configured module.               */
#define LINSR_LINS_MASK         (0xFU << 12)
#define LINSR_LINS_INIT         (0x1U << 12)

/* Bounded rather than infinite: a console that hangs the boot is worse than
   one that reports it could not configure itself.                        */
#define LINFLEXD_INIT_GUARD     100000U

/* 115200 from a 40 MHz P5_LIN_BAUD_CLK; see the file header.             */
#define LINFLEXD_IBRR_115200    21U
#define LINFLEXD_FBRR_115200    11U

#define CONSOLE_BASE            S32Z_LINFLEX_9_BASE


unsigned int linflexd_init(void)
{
    unsigned int  status = LINFLEXD_INIT_OK;
    unsigned int  guard;
    unsigned int  wanted;
    unsigned int  got;

    /* Enter initialisation mode and WAIT until the module reports it.
       Most of UARTCR is writable only in initialisation mode, and the module
       does not enter it in the same cycle as the LINCR1 write.  Configuring
       without waiting silently half-works: bits being *set* take effect while
       bits being *cleared* do not, so PCE stays enabled and the line runs 8E1
       against a host expecting 8N1 -- which corrupts only those characters
       whose parity bit happens to be 0 and leaves the rest readable, looking
       for all the world like a marginal baud rate.  */

    REG32(CONSOLE_BASE + LINFLEXD_LINCR1) = LINCR1_INIT;

    guard = LINFLEXD_INIT_GUARD;
    while (((REG32(CONSOLE_BASE + LINFLEXD_LINSR) & LINSR_LINS_MASK)
                != LINSR_LINS_INIT) && (guard > 0U))
    {
        guard--;
    }

    if (guard == 0U)
    {
        status |= LINFLEXD_INIT_NO_INITMODE;
    }

    /* The UART bit gates writes to the rest of UARTCR, so it has to be set
       before the fields that depend on it, not alongside them.  */

    REG32(CONSOLE_BASE + LINFLEXD_UARTCR) = UARTCR_UART;

    /* 8N1, transmit and receive.  PCE deliberately left clear: the BootROM
       enables parity for serial boot, and a host on 8N1 would see framing
       errors.  */

    wanted = UARTCR_UART | UARTCR_WL0 | UARTCR_TXEN | UARTCR_RXEN;
    REG32(CONSOLE_BASE + LINFLEXD_UARTCR) = wanted;

    REG32(CONSOLE_BASE + LINFLEXD_LINFBRR) = LINFLEXD_FBRR_115200;
    REG32(CONSOLE_BASE + LINFLEXD_LINIBRR) = LINFLEXD_IBRR_115200;

    /* Read back before leaving initialisation mode.  A write that was
       silently ignored is the failure this driver already made once, so it is
       checked rather than assumed.  */

    got = REG32(CONSOLE_BASE + LINFLEXD_UARTCR) & 0xFFU;
    if (got != wanted)
    {
        status |= LINFLEXD_INIT_UARTCR_MISMATCH;
    }

    /* Leave initialisation mode; the module starts operating.  */

    REG32(CONSOLE_BASE + LINFLEXD_LINCR1) = 0U;

    return status;
}


void linflexd_putc(char c)
{
    if (c == '\n')
    {
        linflexd_putc('\r');
    }

    unsigned int guard;

    /* Start the byte, wait for completion, clear the flag, then wait for the
       clear to actually take effect.
       *
       * The last step is the subtle one.  DTF is write-one-to-clear and does
       * not de-assert in the same cycle as the clearing write, so without it
       * the *next* byte's poll can observe this byte's flag, conclude the line
       * is free while it is still busy, and have its write silently dropped by
       * the transmitter.  That cost exactly one character after every "\r\n"
       * pair -- the only place two bytes are sent back to back -- and showed
       * up as the first letter of every line going missing.
       *
       * Clearing *before* the write instead does not fix it and is worse: the
       * write then lands while the previous byte is still shifting and is
       * dropped, and the poll afterwards sees the previous byte's completion,
       * so most of the output disappears.  Order matters in both directions.
       */

    REG32(CONSOLE_BASE + LINFLEXD_BDRL) = (unsigned int)(unsigned char)c;

    /* Polled on purpose: this console runs before any interrupt controller is
       configured, and it must work inside a fault handler.  */

    while ((REG32(CONSOLE_BASE + LINFLEXD_UARTSR) & UARTSR_DTF) == 0U)
    {
        /* wait for this byte to go out */
    }

    REG32(CONSOLE_BASE + LINFLEXD_UARTSR) = UARTSR_DTF;

    guard = LINFLEXD_INIT_GUARD;
    while (((REG32(CONSOLE_BASE + LINFLEXD_UARTSR) & UARTSR_DTF) != 0U)
               && (guard > 0U))
    {
        guard--;
    }
}


void linflexd_puts(const char *string)
{
    const char *p = string;

    if (p != (const char *)0)
    {
        while (*p != '\0')
        {
            linflexd_putc(*p);
            p++;
        }
    }
}


void linflexd_put_hex32(unsigned int value)
{
    static const char digits[] = "0123456789ABCDEF";
    unsigned int      shift    = 32U;

    while (shift > 0U)
    {
        shift -= 4U;
        linflexd_putc(digits[(value >> shift) & 0xFU]);
    }
}
