/***************************************************************************
 * Copyright (c) 2026 Eclipse ThreadX contributors
 *
 * This program and the accompanying materials are made available under the
 * terms of the MIT License which is available at
 * https://opensource.org/licenses/MIT.
 *
 * AI Disclosure: This file was largely AI-generated by Claude Code (Opus 5).
 * The AI-generated portions may be considered public domain (CC0-1.0)
 * and not subject to the project's licence. The human contributor has
 * reviewed and verified that the code is correct.
 *
 * SPDX-License-Identifier: MIT and CC0-1.0
 **************************************************************************/

/**************************************************************************/
/*                                                                        */
/*  BOARD SUPPORT                                          RELEASE        */
/*                                                                        */
/*    demo_vfp_s32z280.c                               Cortex-R52/GNU     */
/*                                                           6.5.2        */
/*  AUTHOR                                                                */
/*                                                                        */
/*    Frederic Desbiens, Eclipse Foundation                               */
/*                                                                        */
/*  DESCRIPTION                                                           */
/*                                                                        */
/*    Lazy floating-point context save and restore on S32Z280 silicon.    */
/*                                                                        */
/*    This is the FVP's demo_m5.c test design, reporting over the         */
/*    LINFlexD console instead of semihosting.  The design is kept        */
/*    deliberately: the model established that the two halves of the VFP  */
/*    context path need separate provocation, and silicon does not change */
/*    that, it only changes whether the hardware agrees.                  */
/*                                                                        */
/*      fp check  holds eight live doubles across tx_thread_sleep.  Eight */
/*                forces the compiler onto the callee-saved bank D8-D15,  */
/*                which is what a SOLICITED switch must preserve.         */
/*                                                                        */
/*      fp busy   lowest priority and never sleeps, so the periodic tick  */
/*                interrupts it mid-computation.  That exercises the      */
/*                INTERRUPT half, D0-D15 plus FPSCR, and it checks its    */
/*                own values every iteration.                             */
/*                                                                        */
/*    Both call tx_thread_vfp_enable().  With lazy save and restore a     */
/*    thread that has not asked for floating point does not get its       */
/*    registers saved, so a test where every thread opts in would not     */
/*    show whether the opt-in is what does the work.                      */
/*                                                                        */
/*    Every constant is an exact binary fraction and the step is 0.5, so  */
/*    the comparisons are exact and no epsilon is needed.  MISRA C:2012   */
/*    Dir 4.6 and Rule 13.3 would normally object to == on floating       */
/*    point; here it is the point, since any inexactness means a register */
/*    was not preserved.                                                  */
/*                                                                        */
/*    What silicon adds over the model: the FPU must actually be enabled  */
/*    by the BSP.  entry.S opens CPACR and FPEXC.EN at EL1 under          */
/*    __ARM_FP, because tx_thread_vfp_enable() sets only the per-thread   */
/*    software flag and never touches the hardware.  Without that, the    */
/*    first D-register access after a switch takes an Undefined           */
/*    Instruction exception -- which on this board was invisible until    */
/*    SCTLR.TE was cleared.                                              */
/*                                                                        */
/**************************************************************************/

#include "tx_api.h"
#include "linflexd.h"
#include "board.h"

#define DEMO_STACK_SIZE     2048
#define FILEX_PTR_SENTINEL  ((void *) 0xF11EF11EUL)
#define FP_ITERATIONS       50UL
#define FP_STEP             0.5           /* exactly representable          */

static TX_THREAD    thread_check;
static TX_THREAD    thread_fp_busy;

static ULONG        thread_check_stack[DEMO_STACK_SIZE / sizeof(ULONG)];
static ULONG        thread_fp_busy_stack[DEMO_STACK_SIZE / sizeof(ULONG)];

static volatile ULONG   busy_iterations;
static volatile ULONG   busy_corruptions;


/* Breakpoint target for tools/read_identity.gdb.  Not static and not empty so
   an optimising build cannot discard it.  */

void bsp_done(void)
{
    __asm volatile ("nop");
}


static UINT report(const char *label_ptr, UINT passed)
{
    linflexd_puts(label_ptr);
    linflexd_puts((passed != 0U) ? "PASS\n" : "FAIL\n");
    return (passed != 0U) ? 0U : 1U;
}


static void report_hex(const char *label_ptr, unsigned long value)
{
    linflexd_puts(label_ptr);
    linflexd_puts(" = 0x");
    linflexd_put_hex32((unsigned int) value);
    linflexd_putc('\n');
}


/**************************************************************************/
/*  thread_fp_busy_entry -- the interrupt half of the VFP path.           */
/**************************************************************************/

static void thread_fp_busy_entry(ULONG thread_input)
{
    (void) thread_input;

    tx_thread_vfp_enable();

    for (;;)
    {
        /* Deliberately disjoint from the checking thread's range, so that
           state leaking from one context into the other is detectable rather
           than coincidentally correct.  */

        double v0 = 1024.5;
        double v1 = 2048.25;
        double v2 = 4096.125;
        double v3 = 8192.0625;

        v0 = (v0 * 2.0) - 1024.5;           /* 1024.5    */
        v1 = (v1 * 2.0) - 2048.25;          /* 2048.25   */
        v2 = (v2 * 2.0) - 4096.125;         /* 4096.125  */
        v3 = (v3 * 2.0) - 8192.0625;        /* 8192.0625 */

        if ((v0 != 1024.5) || (v1 != 2048.25) ||
            (v2 != 4096.125) || (v3 != 8192.0625))
        {
            busy_corruptions++;
        }

        busy_iterations++;
    }
}


/**************************************************************************/
/*  thread_check_entry -- the solicited half, and the judge.              */
/**************************************************************************/

static void thread_check_entry(ULONG thread_input)
{
    UINT        failures = 0U;
    ULONG       iteration;
    TX_THREAD  *self;

    double a = 1.5;
    double b = 2.25;
    double c = 3.125;
    double d = 4.0625;
    double e = 5.03125;
    double f = 6.015625;
    double g = 7.0078125;
    double h = 8.00390625;

    (void) thread_input;

    /* The VFP enable flag is reached from assembly by hard-coded offset. On the
       Cortex-R4 and R5 ports that offset lands on tx_thread_filex_ptr, because
       their TX_THREAD_EXTENSION_2 is empty. A sentinel turns that class of
       mistake into a visible failure instead of corruption that only appears
       once something actually uses FileX.  */

    self = tx_thread_identify();
    self->tx_thread_filex_ptr = FILEX_PTR_SENTINEL;

    tx_thread_vfp_enable();

    linflexd_puts("V1 floating-point work across solicited switches\n");

    for (iteration = 0UL; iteration < FP_ITERATIONS; iteration++)
    {
        /* Suspending here is the provocation: the switch must preserve all
           eight values, and the lower-priority thread runs meanwhile.  */

        tx_thread_sleep(1);

        a += FP_STEP;
        b += FP_STEP;
        c += FP_STEP;
        d += FP_STEP;
        e += FP_STEP;
        f += FP_STEP;
        g += FP_STEP;
        h += FP_STEP;
    }

    {
        const double delta = 0.5 * (double) FP_ITERATIONS;

        failures += report("V2 D8-D15 bank preserved across switches   ",
                           ((a == (1.5        + delta)) &&
                            (b == (2.25       + delta)) &&
                            (c == (3.125      + delta)) &&
                            (d == (4.0625     + delta)) &&
                            (e == (5.03125    + delta)) &&
                            (f == (6.015625   + delta)) &&
                            (g == (7.0078125  + delta)) &&
                            (h == (8.00390625 + delta))) ? 1U : 0U);
    }

    report_hex("iterations", busy_iterations);
    report_hex("corruptions", busy_corruptions);

    failures += report("V3 interrupted FP thread made progress     ",
                       (busy_iterations > 0UL) ? 1U : 0U);
    failures += report("V4 no FP corruption across interrupts      ",
                       (busy_corruptions == 0UL) ? 1U : 0U);

    report_hex("filex_ptr", (unsigned long) self->tx_thread_filex_ptr);

    failures += report("V5 VFP flag did not alias filex_ptr        ",
                       (self->tx_thread_filex_ptr == FILEX_PTR_SENTINEL) ? 1U : 0U);

    if (failures == 0U)
    {
        linflexd_puts("PASS lazy VFP context switch verified on silicon\n");
    }
    else
    {
        linflexd_puts("FAIL lazy VFP context switch\n");
    }

    linflexd_puts("=== vfp demo complete ===\n");

    bsp_done();

    for (;;)
    {
        tx_thread_sleep(100UL);
    }
}


void tx_application_define(void *first_unused_memory)
{
    (void) first_unused_memory;

    (void) tx_thread_create(&thread_check, "fp check", thread_check_entry, 0UL,
                            thread_check_stack, sizeof(thread_check_stack),
                            10U, 10U, TX_NO_TIME_SLICE, TX_AUTO_START);

    (void) tx_thread_create(&thread_fp_busy, "fp busy", thread_fp_busy_entry,
                            0UL, thread_fp_busy_stack,
                            sizeof(thread_fp_busy_stack),
                            20U, 20U, TX_NO_TIME_SLICE, TX_AUTO_START);
}


/**************************************************************************/
/*  bsp_main -- entered at EL1 from entry.S; hands over to the kernel.    */
/**************************************************************************/

void bsp_main(void)
{
    unsigned int console_status = linflexd_init();

    linflexd_puts("\n=== ThreadX Cortex-R52 :: S32Z280-594EVB lazy VFP ===\n");
    report_hex("console", (unsigned long) console_status);
    linflexd_puts("entering kernel\n");

    tx_kernel_enter();

    /* Not reached.  */

    linflexd_puts("FAIL tx_kernel_enter returned\n");

    for (;;)
    {
        __asm volatile ("nop");
    }
}
