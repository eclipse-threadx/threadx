/***************************************************************************
 * Copyright (c) 2026 Eclipse ThreadX contributors
 *
 * This program and the accompanying materials are made available under the
 * terms of the MIT License which is available at
 * https://opensource.org/licenses/MIT.
 *
 * AI Disclosure: This file was largely AI-generated by Claude Code (Opus 5).
 * The AI-generated portions may be considered public domain (CC0-1.0)
 * and not subject to the project's licence. The human contributor has
 * reviewed and verified that the code is correct.
 *
 * SPDX-License-Identifier: MIT and CC0-1.0
 **************************************************************************/

/**************************************************************************/
/*                                                                        */
/*  BOARD SUPPORT                                          RELEASE        */
/*                                                                        */
/*    demo_nesting_s32z280.c                           Cortex-R52/GNU     */
/*                                                           6.5.2        */
/*  AUTHOR                                                                */
/*                                                                        */
/*    Frederic Desbiens, Eclipse Foundation                               */
/*                                                                        */
/*  DESCRIPTION                                                           */
/*                                                                        */
/*    Nested IRQ handling on S32Z280 silicon.                             */
/*                                                                        */
/*    The FVP established that the nesting routines work and, more         */
/*    usefully, what breaks them: the interrupt has to be acknowledged     */
/*    before nesting starts, or the still-pending level-asserted timer is  */
/*    retaken the moment IRQ is enabled and recurses until the stacks are  */
/*    gone.  entry.S here has the same ordering for the same reason.       */
/*                                                                        */
/*    What the model could not answer is whether a real GIC-600 agrees.    */
/*    Two things differ from a model and both are visible here:            */
/*                                                                        */
/*      P1  how many priority bits the GIC implements.  Equal priorities   */
/*          do not preempt, and it is the low bits that vanish, so if the  */
/*          timer and the SGI collapse to the same value after truncation  */
/*          nesting cannot happen at all.  board_init discovers the count  */
/*          by write and readback rather than assuming the model's five,   */
/*          and this demo reports it.                                      */
/*                                                                        */
/*      P2  whether an SGI raised on real silicon is delivered at all.     */
/*          ICC_SGI1R is a 64-bit AArch32 CP15 register and its encoding   */
/*          does not transcribe from the AArch64 alias, so N1 tests SGI    */
/*          delivery on its own before nesting is involved.                */
/*                                                                        */
/**************************************************************************/

#include "tx_api.h"
#include "linflexd.h"
#include "board.h"
#include "gicv3.h"

#define DEMO_STACK_SIZE     2048

static TX_THREAD    thread_check;
static TX_THREAD    thread_spin;

static ULONG        thread_check_stack[DEMO_STACK_SIZE / sizeof(ULONG)];
static ULONG        thread_spin_stack[DEMO_STACK_SIZE / sizeof(ULONG)];

static volatile ULONG   spin_runs;


/* Breakpoint target for tools/read_identity.gdb.  Not static and not empty so
   an optimising build cannot discard it.  */

void bsp_done(void)
{
    __asm volatile ("nop");
}


static UINT report(const char *label_ptr, UINT passed)
{
    linflexd_puts(label_ptr);
    linflexd_puts((passed != 0U) ? "PASS\n" : "FAIL\n");
    return (passed != 0U) ? 0U : 1U;
}


static void report_hex(const char *label_ptr, unsigned long value)
{
    linflexd_puts(label_ptr);
    linflexd_puts(" = 0x");
    linflexd_put_hex32((unsigned int) value);
    linflexd_putc('\n');
}


static void thread_spin_entry(ULONG thread_input)
{
    (void) thread_input;

    for (;;)
    {
        spin_runs++;
    }
}


static void thread_check_entry(ULONG thread_input)
{
    UINT    failures = 0U;
    ULONG   sgi_before;
    ULONG   ticks_start;
    ULONG   ticks_end;
    ULONG   spin_before;

    (void) thread_input;

    /* P1: what the GIC actually implements, and whether the two priorities this
       test depends on survive truncation.  */

    report_hex("priority bits", board_priority_bits);
    report_hex("timer effective", board_timer_priority);
    report_hex("sgi effective", board_sgi_priority);

    failures += report("P1 SGI outranks timer after truncation     ",
                       (board_sgi_priority < board_timer_priority) ? 1U : 0U);

    /* N1: SGI delivery on its own, before nesting is involved.  */

    linflexd_puts("N1 raising an SGI from thread context\n");

    sgi_before = board_sgi_count;
    gicv3_send_sgi(BOARD_NEST_SGI_INTID);
    tx_thread_sleep(2);

    failures += report("N1 SGI delivered and dispatched            ",
                       (board_sgi_count > sgi_before) ? 1U : 0U);

    if (board_sgi_count == sgi_before)
    {
        /* Everything below needs the SGI, so reporting four more failures with
           the same cause would only obscure it.  */

        linflexd_puts("SGI never arrived; the nesting checks would only\n"
                      "restate that, so they are skipped.\n");
        linflexd_puts("FAIL nested IRQ handling\n");
        linflexd_puts("=== nesting demo complete ===\n");
        bsp_done();
        for (;;)
        {
            tx_thread_sleep(100UL);
        }
    }

    /* N2 onwards: let the timer handler provoke a nested SGI.  */

    linflexd_puts("N2 enabling nested provocation in the timer handler\n");

    board_nest_provoke = 1UL;
    ticks_start = tx_time_get();
    spin_before = spin_runs;
    tx_thread_sleep(50);
    ticks_end = tx_time_get();
    board_nest_provoke = 0UL;

    report_hex("max depth", board_nest_max);
    report_hex("nested SGIs", board_sgi_nested_count);
    report_hex("depth now", board_nest_depth);

    failures += report("N2 SGI nested inside another handler       ",
                       ((board_sgi_nested_count > 0UL) &&
                        (board_nest_max >= 2UL)) ? 1U : 0U);

    failures += report("N3 nesting unwound to depth zero           ",
                       (board_nest_depth == 0UL) ? 1U : 0U);

    failures += report("N4 tick still advancing after nesting      ",
                       ((ticks_end - ticks_start) >= 40UL) ? 1U : 0U);

    failures += report("N5 lower-priority thread still scheduled   ",
                       (spin_runs > spin_before) ? 1U : 0U);

    report_hex("spurious", board_spurious_count);
    report_hex("unexpected", board_unexpected_intid);

    failures += report("N6 no spurious or unexpected interrupts    ",
                       ((board_spurious_count == 0UL) &&
                        (board_unexpected_intid == 0UL)) ? 1U : 0U);

    if (failures == 0U)
    {
        linflexd_puts("PASS nested IRQ handling verified on silicon\n");
    }
    else
    {
        linflexd_puts("FAIL nested IRQ handling\n");
    }

    linflexd_puts("=== nesting demo complete ===\n");

    bsp_done();

    for (;;)
    {
        tx_thread_sleep(100UL);
    }
}


void tx_application_define(void *first_unused_memory)
{
    (void) first_unused_memory;

    (void) tx_thread_create(&thread_check, "nest check", thread_check_entry,
                            0UL, thread_check_stack, sizeof(thread_check_stack),
                            10U, 10U, TX_NO_TIME_SLICE, TX_AUTO_START);

    (void) tx_thread_create(&thread_spin, "spinner", thread_spin_entry,
                            0UL, thread_spin_stack, sizeof(thread_spin_stack),
                            20U, 20U, TX_NO_TIME_SLICE, TX_AUTO_START);
}


void bsp_main(void)
{
    unsigned int console_status = linflexd_init();

    linflexd_puts("\n=== ThreadX Cortex-R52 :: S32Z280-594EVB nested IRQ ===\n");
    report_hex("console", (unsigned long) console_status);
    linflexd_puts("entering kernel\n");

    tx_kernel_enter();

    /* Not reached.  */

    linflexd_puts("FAIL tx_kernel_enter returned\n");

    for (;;)
    {
        __asm volatile ("nop");
    }
}
