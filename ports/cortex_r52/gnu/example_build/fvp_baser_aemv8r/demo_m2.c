/***************************************************************************
 * Copyright (C) 2026 Eclipse ThreadX contributors
 *
 * This program and the accompanying materials are made available under the
 * terms of the MIT License which is available at
 * https://opensource.org/licenses/MIT.
 *
 * AI Disclosure: This file was largely AI-generated by Claude Code (Opus 5).
 * The AI-generated portions may be considered public domain (CC0-1.0)
 * and not subject to the project's licence. The human contributor has
 * reviewed and verified that the code is correct.
 *
 * SPDX-License-Identifier: MIT and CC0-1.0
 **************************************************************************/

/**************************************************************************/
/*                                                                        */
/*  DEMONSTRATION                                          RELEASE        */
/*                                                                        */
/*    demo_m2.c                                        Cortex-R52/GNU     */
/*                                                                        */
/*  DESCRIPTION                                                           */
/*                                                                        */
/*    AR1 milestone M2: two threads switching cooperatively, with no       */
/*    interrupts and no timer tick.  This is the first real exercise of    */
/*    the ported assembly -- _tx_thread_stack_build builds each thread's    */
/*    initial frame, _tx_thread_schedule restores it, and                  */
/*    _tx_thread_system_return saves a solicited context on every          */
/*    tx_thread_relinquish call.                                           */
/*                                                                        */
/*    The threads record their execution order in a trace buffer, and the  */
/*    expected alternating sequence is asserted at the end.  Counting      */
/*    iterations alone would not prove a context switch happened: if       */
/*    switching were broken, one thread could run to completion by itself. */
/*                                                                        */
/*    Only tx_thread_relinquish is used.  tx_thread_sleep would hang       */
/*    without a tick, which AR1/M3 adds.                                  */
/*                                                                        */
/**************************************************************************/

#include "tx_api.h"
#include "board.h"
#include "console.h"

#define DEMO_STACK_SIZE     2048
#define DEMO_ITERATIONS     5U
#define TRACE_LENGTH        (2U * DEMO_ITERATIONS)

static TX_THREAD    thread_0;
static TX_THREAD    thread_1;

static ULONG        thread_0_stack[DEMO_STACK_SIZE / sizeof(ULONG)];
static ULONG        thread_1_stack[DEMO_STACK_SIZE / sizeof(ULONG)];

static volatile ULONG   thread_0_counter;
static volatile ULONG   thread_1_counter;

/* Execution order, one character per slice.  */

static char             trace[TRACE_LENGTH + 1U];
static volatile UINT    trace_index;


/**************************************************************************/
/*  trace_record -- append one thread's mark to the execution trace.       */
/**************************************************************************/

static void trace_record(char mark)
{
    if (trace_index < TRACE_LENGTH)
    {
        trace[trace_index] = mark;
        trace_index++;
    }
}


/**************************************************************************/
/*  report -- print one labelled check result.                            */
/**************************************************************************/

static void report(const char *label_ptr, UINT passed)
{
    console_puts(label_ptr);
    console_puts((passed != 0U) ? "PASS\n" : "FAIL\n");
}


/**************************************************************************/
/*  thread_1_entry -- yields back to thread 0 on every slice.             */
/**************************************************************************/

static void thread_1_entry(ULONG thread_input)
{
    (void) thread_input;

    while (thread_1_counter < DEMO_ITERATIONS)
    {
        thread_1_counter++;
        trace_record('1');

        console_puts("[thread 1] slice ");
        console_puthex(thread_1_counter);
        console_puts("\n");

        tx_thread_relinquish();
    }
}


/**************************************************************************/
/*  thread_0_entry -- yields to thread 1, then checks the outcome.        */
/**************************************************************************/

static void thread_0_entry(ULONG thread_input)
{
    UINT failures = 0U;
    UINT index;

    (void) thread_input;

    while (thread_0_counter < DEMO_ITERATIONS)
    {
        thread_0_counter++;
        trace_record('0');

        console_puts("[thread 0] slice ");
        console_puthex(thread_0_counter);
        console_puts("\n");

        tx_thread_relinquish();
    }

    /* Check 1: both threads ran the expected number of slices.  A broken
       context switch would leave thread 1 at zero.  */

    console_puts("\n[check] slices thread 0 / thread 1 = ");
    console_puthex(thread_0_counter);
    console_puts(" / ");
    console_puthex(thread_1_counter);
    console_puts("\n");

    if ((thread_0_counter == (ULONG) DEMO_ITERATIONS) &&
        (thread_1_counter == (ULONG) DEMO_ITERATIONS))
    {
        report("[check] both threads ran every slice               ", 1U);
    }
    else
    {
        failures++;
        report("[check] both threads ran every slice               ", 0U);
    }

    /* Check 2: execution strictly alternated, proving each relinquish
       really switched context rather than returning to the same thread.  */

    trace[TRACE_LENGTH] = '\0';
    console_puts("[check] execution order = ");
    console_puts(trace);
    console_puts(" (expected 0101010101)\n");

    for (index = 0U; index < TRACE_LENGTH; index++)
    {
        char expected = ((index % 2U) == 0U) ? '0' : '1';

        if (trace[index] != expected)
        {
            failures++;
            break;
        }
    }

    report("[check] threads alternated on every relinquish     ",
           (UINT) ((failures == 0U) ? 1U : 0U));

    if (failures == 0U)
    {
        console_puts("\nM2 RESULT: ALL CHECKS PASSED\n");
    }
    else
    {
        console_puts("\nM2 RESULT: FAILED\n");
    }

    console_exit(failures);
}


/**************************************************************************/
/*  tx_application_define -- create the demo threads.                     */
/*                                                                        */
/*  Static stacks are used rather than a byte pool so that M2 exercises    */
/*  only the context-switch path, with no allocator in the way.           */
/**************************************************************************/

void tx_application_define(void *first_unused_memory)
{
    (void) first_unused_memory;

    (void) tx_thread_create(&thread_0, "thread 0", thread_0_entry, 0UL,
                            thread_0_stack, sizeof(thread_0_stack),
                            16U, 16U, TX_NO_TIME_SLICE, TX_AUTO_START);

    (void) tx_thread_create(&thread_1, "thread 1", thread_1_entry, 0UL,
                            thread_1_stack, sizeof(thread_1_stack),
                            16U, 16U, TX_NO_TIME_SLICE, TX_AUTO_START);
}


/**************************************************************************/
/*  bsp_main -- entered at EL1 from entry.S.  Does not return.            */
/**************************************************************************/

void bsp_main(void)
{
    console_puts("\n=== ThreadX AR1/M2 cooperative switch "
                 "(Cortex-R52, Armv8-R AArch32, Armv8-R AEM FVP) ===\n");

    tx_kernel_enter();
}
