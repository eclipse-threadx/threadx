/***************************************************************************
 * Copyright (C) 2026 Eclipse ThreadX contributors
 *
 * This program and the accompanying materials are made available under the
 * terms of the MIT License which is available at
 * https://opensource.org/licenses/MIT.
 *
 * AI Disclosure: This file was largely AI-generated by Claude Code (Opus 5).
 * The AI-generated portions may be considered public domain (CC0-1.0)
 * and not subject to the project's licence. The human contributor has
 * reviewed and verified that the code is correct.
 *
 * SPDX-License-Identifier: MIT and CC0-1.0
 **************************************************************************/

/**************************************************************************/
/*                                                                        */
/*  BOARD SUPPORT                                          RELEASE        */
/*                                                                        */
/*    console.c                                        Cortex-R52/GNU     */
/*                                                                        */
/*  DESCRIPTION                                                           */
/*                                                                        */
/*    Semihosting console for the Armv8-R AEM FVP.  Armv8 AArch32 uses     */
/*    HLT 0xF000 as the semihosting trap; the model implements it with no  */
/*    peripheral configuration, which keeps early bring-up independent of  */
/*    the platform memory map.                                            */
/*                                                                        */
/*  MISRA C:2012 deviations (justified)                                    */
/*                                                                        */
/*    Directive 4.3 (assembly language shall be encapsulated and isolated) */
/*      -- observed rather than violated: the single asm statement lives    */
/*      in semihost_call() and nowhere else in the port.                   */
/*    Rule 1.1 / 1.2 (language extensions)                                 */
/*      -- register-asm bindings and inline assembly are unavoidable to    */
/*      invoke a semihosting trap; no standard C construct expresses it.   */
/*                                                                        */
/**************************************************************************/

#include "console.h"

#ifdef TX_R52_CONSOLE_PL011
#include "uart_pl011.h"
#endif

/* Semihosting operation numbers (Arm semihosting specification).  */

#define SYS_WRITE0      0x04U
#define SYS_EXIT        0x18U

/* SYS_EXIT reason codes.  On AArch32 the parameter is a reason, not an exit
   status, so a failing run is reported by its printed result line.  */

#define ADP_STOPPED_APPLICATION_EXIT    0x20026U
#define ADP_STOPPED_RUN_TIME_ERROR      0x20023U

/* Number of hexadecimal digits in a 32-bit value.  */

#define HEX_DIGITS      8U


/**************************************************************************/
/*  semihost_call                                                         */
/*                                                                        */
/*  Issues a single semihosting operation.  This is the only assembly in   */
/*  the console driver (MISRA C:2012 Dir 4.3).                            */
/**************************************************************************/

static int semihost_call(int operation, const void *argument_ptr)
{
    register int         result   __asm__("r0") = operation;
    register const void *argument __asm__("r1") = argument_ptr;

    __asm__ volatile("hlt 0xf000"
                     : "+r"(result)
                     : "r"(argument)
                     : "memory");

    return result;
}


/**************************************************************************/
/*  console_puts                                                          */
/**************************************************************************/

void console_puts(const char *string_ptr)
{
    if (string_ptr == 0)
    {
        return;
    }

#ifdef TX_R52_CONSOLE_PL011

    /* Initialise on first use rather than from board_init, so that images
       with no ThreadX initialisation path (the M1 boot check) also get a
       working UART console.  */

    static unsigned int initialised = 0U;

    if (initialised == 0U)
    {
        pl011_init();
        initialised = 1U;
    }

    pl011_puts(string_ptr);

#else

    (void) semihost_call((int) SYS_WRITE0, string_ptr);

#endif
}


/**************************************************************************/
/*  console_puthex                                                        */
/**************************************************************************/

void console_puthex(unsigned long value)
{
    static const char digits[] = "0123456789abcdef";
    char              buffer[3U + HEX_DIGITS];   /* "0x" + digits + NUL     */
    unsigned int      index;

    buffer[0] = '0';
    buffer[1] = 'x';

    for (index = 0U; index < HEX_DIGITS; index++)
    {
        unsigned int shift = (HEX_DIGITS - 1U - index) * 4U;

        buffer[2U + index] = digits[(value >> shift) & 0xFUL];
    }

    buffer[2U + HEX_DIGITS] = '\0';

    console_puts(buffer);
}


/**************************************************************************/
/*  console_exit                                                          */
/**************************************************************************/

/* Note this always uses semihosting, even with the PL011 console selected:
   SYS_EXIT is how the model is told to stop, which is a debug-channel
   operation rather than console output.  */

void console_exit(unsigned int status)
{
    unsigned int reason = (status == 0U) ? ADP_STOPPED_APPLICATION_EXIT
                                         : ADP_STOPPED_RUN_TIME_ERROR;

    (void) semihost_call((int) SYS_EXIT, (const void *) reason);

    /* The model terminates on the call above; loop defensively in case a
       host or debug configuration ignores semihosting exit.  */

    for (;;)
    {
        /* Intentionally empty.  */
    }
}
