/***************************************************************************
 * Copyright (c) 2026 Eclipse ThreadX contributors
 *
 * This program and the accompanying materials are made available under the
 * terms of the MIT License which is available at
 * https://opensource.org/licenses/MIT.
 *
 * AI Disclosure: This file was largely AI-generated by Claude Code (Opus 5).
 * The AI-generated portions may be considered public domain (CC0-1.0)
 * and not subject to the project's licence. The human contributor has
 * reviewed and verified that the code is correct.
 *
 * SPDX-License-Identifier: MIT and CC0-1.0
 **************************************************************************/

/**************************************************************************/
/*                                                                        */
/*  BOARD SUPPORT                                          RELEASE        */
/*                                                                        */
/*    entry.S                                          Cortex-R52/GNU     */
/*                                                           6.5.2        */
/*  AUTHOR                                                                */
/*                                                                        */
/*    Frédéric Desbiens, Eclipse Foundation                               */
/*                                                                        */
/*  DESCRIPTION                                                           */
/*                                                                        */
/*    Reset entry for Cortex-R52 (Armv8-R, AArch32) on the Armv8-R AEM    */
/*    FVP.  The R52 always implements EL2 and resets into it, so this     */
/*    file configures EL2 first, installs both the EL2 and EL1 vector     */
/*    tables, and only then drops to EL1 (Supervisor mode) to run the     */
/*    kernel.  The HVC entry in the EL2 table is the seam that ZoneX      */
/*    (roadmap AR3) grows into -- it is deliberately present from AR1 so  */
/*    that partitioning does not require re-architecting the boot path.   */
/*                                                                        */
/*    Define TX_R52_BOOT_AT_EL1 to skip EL2 configuration, for targets    */
/*    where an earlier boot stage or a vendor EL2 monitor (for example    */
/*    NXP's EL2M on S32Z2) has already dropped privilege to EL1.          */
/*                                                                        */
/**************************************************************************/

#include "platform.h"

    /* No .arch directive here.  GNU as accepts "armv8-r", LLVM's integrated
       assembler accepts no spelling of it at all -- not armv8-r, not armv8r --
       and fails with "Unknown Arch". The architecture is already selected by
       -mcpu=cortex-r52 on the command line, which both toolchains require and
       both toolchain files pass, so the directive only restated it.  */

    .syntax unified
    .arm

/* AArch32 CPSR mode encodings and interrupt mask bits.                   */

    .equ    MODE_USR,   0x10
    .equ    MODE_FIQ,   0x11
    .equ    MODE_IRQ,   0x12
    .equ    MODE_SVC,   0x13
    .equ    MODE_ABT,   0x17
    .equ    MODE_HYP,   0x1A
    .equ    MODE_UND,   0x1B
    .equ    MODE_SYS,   0x1F
    .equ    PSR_A,      0x100           /* asynchronous abort mask          */
    .equ    PSR_I,      0x80            /* IRQ mask                         */
    .equ    PSR_F,      0x40            /* FIQ mask                         */

/* HCR (Hyp Configuration Register) bits used here.                       */

    .equ    HCR_VM,     (1 << 0)        /* stage-2 MPU enable               */
    .equ    HCR_AMO,    (1 << 3)        /* route aborts to EL2              */
    .equ    HCR_IMO,    (1 << 4)        /* route IRQ to EL2                 */
    .equ    HCR_FMO,    (1 << 5)        /* route FIQ to EL2                 */
    .equ    HCR_TGE,    (1 << 27)       /* trap general exceptions to EL2   */
    .equ    HCR_HCD,    (1 << 29)       /* HVC disable -- must be clear      */

    .equ    HCPTR_TCP,  (3 << 10)       /* trap EL1 access to CP10/CP11     */

/* CNTHCTL: permit EL1/EL0 use of the physical counter and timer.         */

    .equ    CNTHCTL_PL1PCTEN, (1 << 0)
    .equ    CNTHCTL_PL1PCEN,  (1 << 1)

/* ICC_HSRE: enable the GICv3 system-register interface for EL1.          */

    .equ    ICC_HSRE_SRE,     (1 << 0)
    .equ    ICC_HSRE_ENABLE,  (1 << 3)

/* CPACR grants EL1/EL0 access to CP10 and CP11 (the floating-point unit);
   FPEXC.EN then enables floating-point execution.  */

    .equ    CPACR_CP10,       (3 << 20)
    .equ    CPACR_CP11,       (3 << 22)
    .equ    FPEXC_EN,         (1 << 30)

    .equ    SYS_WRITE0, 0x04            /* semihosting: write NUL-string    */

/* HSR (Hyp Syndrome Register) exception classes.  Every exception taken to
   EL2 from EL1/EL0 arrives at the single Hyp Trap Entry vector, so the cause
   must be decoded from HSR.EC (bits [31:26]).  */

    .equ    HSR_EC_SHIFT,   26
    .equ    HSR_EC_HVC,     0x12        /* HVC executed in AArch32          */

/* Report which vector was taken, then halt.  The FVP offers no GDB stub
   (Iris only), so a self-identifying fault is the primary debugging tool
   for this port.  Uses no stack: only r0/r1 and a semihosting call.  */

    .macro  FAULT_REPORT msglabel
    ldr     r1, =\msglabel
    mov     r0, #SYS_WRITE0
    hlt     0xf000
    b       fault_halt
    .endm

/**************************************************************************/
/*  EL2 (Hyp) vector table.  Must be 32-byte aligned for HVBAR.           */
/**************************************************************************/

    .section .vectors_el2, "ax"
    .balign 32
    .global el2_vectors
el2_vectors:
/* Offsets 0x04-0x10 are exceptions taken *from* Hyp mode itself.  Offset
   0x14 is the Hyp Trap Entry: every exception routed to EL2 from EL1/EL0 --
   HVC, stage-2 faults, trapped register accesses -- funnels through it and
   is decoded from HSR.  That single funnel is the ZoneX (AR3) seam.  */

    b       el2_trap_reset                  /* 0x00  reset (unused at EL2)  */
    b       el2_trap_undef                  /* 0x04  undef, from Hyp        */
    b       el2_trap_svc                    /* 0x08  SVC, from Hyp          */
    b       el2_trap_pabt                   /* 0x0C  prefetch abort, Hyp    */
    b       el2_trap_dabt                   /* 0x10  data abort, from Hyp   */
    b       el2_hyp_trap_entry              /* 0x14  from EL1/EL0 <-- seam  */
    b       el2_trap_irq                    /* 0x18  IRQ                    */
    b       el2_trap_fiq                    /* 0x1C  FIQ                    */

/**************************************************************************/
/*  EL1 vector table.  Must be 32-byte aligned for VBAR.                  */
/**************************************************************************/

    .section .vectors_el1, "ax"
    .balign 32
    .global el1_vectors
el1_vectors:
    b       el1_trap_reset                  /* 0x00  reset                  */
    b       el1_trap_undef                  /* 0x04  undefined instruction  */
    b       el1_trap_svc                    /* 0x08  supervisor call        */
    b       el1_trap_pabt                   /* 0x0C  prefetch abort         */
    b       el1_trap_dabt                   /* 0x10  data abort             */
    b       el1_trap_reserved               /* 0x14  reserved               */
    b       el1_irq_entry                   /* 0x18  IRQ                    */
    b       el1_trap_fiq                    /* 0x1C  FIQ                    */

    .text
    .balign 4

/**************************************************************************/
/*  _start -- reset entry.  Entered at EL2 (Hyp mode) on Cortex-R52.      */
/**************************************************************************/

    .global _start
    .type   _start, %function
_start:
#ifndef TX_R52_BOOT_AT_EL1

    /* Hyp-mode stack must exist before anything can be pushed at EL2.  */

    ldr     sp, =__hyp_stack_top

    /* Install the EL2 vector table (HVBAR).  */

    ldr     r0, =el2_vectors
    mcr     p15, 4, r0, c12, c0, 0
    isb

    /* Configure EL2: keep exceptions and interrupts routed to EL1, and
       leave the stage-2 MPU disabled for AR1 (the FVP background memory
       map already permits execution and data access in low DRAM).  ZoneX
       enables HCR_VM and programs stage 2 in AR3.

       HCR_HCD is cleared explicitly so HVC is enabled from EL1 rather than
       relying on its reset value -- the ZoneX seam depends on it.  */

    mrc     p15, 4, r0, c1, c1, 0           /* HCR                          */
    ldr     r1, =(HCR_TGE | HCR_AMO | HCR_IMO | HCR_FMO | HCR_VM | HCR_HCD)
    bic     r0, r0, r1
    mcr     p15, 4, r0, c1, c1, 0
    isb

    /* Let EL1 use the FPU: clear HCPTR.TCP11/TCP10.  R52 always implements
       at least a single-precision FPU, so these traps must be cleared even
       for a soft-float kernel build if application code uses the FPU.  */

    mrc     p15, 4, r0, c1, c1, 2           /* HCPTR                        */
    ldr     r1, =HCPTR_TCP
    bic     r0, r0, r1
    mcr     p15, 4, r0, c1, c1, 2
    isb

    /* Generic timer, part 1 of 2 (part 2 is timer_init at EL1).

       CNTFRQ resets to ZERO on this model and is writable only at the
       highest implemented exception level, so it must be programmed here at
       EL2.  The value is CNTFID0 read back from the counter control frame.
       Software that derived a tick interval from CNTFRQ without this would
       divide by zero.  */

    ldr     r0, =SYSTEM_COUNTER_HZ
    mcr     p15, 0, r0, c14, c0, 0          /* CNTFRQ                       */

    /* Permit EL1/EL0 to use the physical counter and the physical timer.
       CNTHCTL.PL1PCTEN/PL1PCEN reset disabled, so without this every EL1
       access to CNTPCT or CNTP_* would trap to EL2.  */

    mrc     p15, 4, r0, c14, c1, 0          /* CNTHCTL                      */
    orr     r0, r0, #(CNTHCTL_PL1PCTEN | CNTHCTL_PL1PCEN)
    mcr     p15, 4, r0, c14, c1, 0
    isb

    /* Permit EL1 to reach the GICv3 CPU interface through its system
       registers (ICC_*), which is how the R52 acknowledges interrupts.  */

    mrc     p15, 4, r0, c12, c9, 5          /* ICC_HSRE                     */
    orr     r0, r0, #(ICC_HSRE_SRE | ICC_HSRE_ENABLE)
    mcr     p15, 4, r0, c12, c9, 5
    isb

    /* Progress marker: proves we reached EL2 and semihosting works.  */

    ldr     r1, =msg_el2
    mov     r0, #SYS_WRITE0
    hlt     0xf000

    /* Drop to EL1 (Supervisor), interrupts still masked.  */

    ldr     r0, =el1_entry
    msr     ELR_hyp, r0
#ifdef TX_ENABLE_FIQ_SUPPORT

    /* FIQ left unmasked, IRQ still masked.  ThreadX unmasks IRQ when it
     * schedules the first thread; FIQ is different, because tx_thread_stack_build
     * only clears the F bit in a thread's CPSR when the library was built with
     * FIQ support, and nothing else ever clears it.  Leaving PSR_F set here
     * would mask FIQ until the first thread ran, which is survivable but makes
     * an FIQ raised from bsp_main silently do nothing.
     */

    ldr     r0, =(PSR_A | PSR_I | MODE_SVC)
#else
    ldr     r0, =(PSR_A | PSR_I | PSR_F | MODE_SVC)
#endif
    msr     SPSR_hyp, r0
    isb
    eret

#else
    b       el1_entry
#endif

/**************************************************************************/
/*  el1_entry -- first instruction executed at EL1.                       */
/**************************************************************************/

    .global el1_entry
    .type   el1_entry, %function
el1_entry:

    /* Install the EL1 vector table (VBAR).  */

    ldr     r0, =el1_vectors
    mcr     p15, 0, r0, c12, c0, 0
    isb

    /* Give every EL1 mode its own stack.  Interrupts stay masked: CPS
       changes mode only.  System mode shares SP_usr, so it is set last
       before returning to Supervisor mode.  */

    cps     #MODE_IRQ
    ldr     sp, =__irq_stack_top
    cps     #MODE_FIQ
    ldr     sp, =__fiq_stack_top
    cps     #MODE_ABT
    ldr     sp, =__abt_stack_top
    cps     #MODE_UND
    ldr     sp, =__und_stack_top
    cps     #MODE_SYS
    ldr     sp, =__sys_stack_top
    cps     #MODE_SVC
    ldr     sp, =__svc_stack_top

#ifdef __ARM_FP

    /* Enable the floating-point unit for EL1.
     *
     * Two separate gates must be opened and both reset closed:
     *   CPACR   grants EL1/EL0 access to CP10/CP11.  It reads 0 out of reset,
     *           so the first floating-point instruction would otherwise raise
     *           an Undefined Instruction exception.
     *   FPEXC   .EN enables floating-point execution itself.
     * EL2 has already cleared HCPTR.TCP10/TCP11 so neither access traps to EL2.
     *
     * This is a BSP responsibility, not the kernel's: tx_thread_vfp_enable()
     * only sets the per-thread software flag that makes the context switch
     * save and restore floating-point state.  It does not turn the hardware
     * on, so without the code below a VFP-enabled build faults on its first
     * context switch that touches D-registers.
     *
     * Guarded by __ARM_FP, which the compiler defines exactly when the build
     * can emit floating-point instructions.  In a soft-float build "vmsr
     * fpexc" is not even assemblable for this target.
     */

    mrc     p15, 0, r0, c1, c0, 2           /* CPACR                        */
    orr     r0, r0, #(CPACR_CP10 | CPACR_CP11)
    mcr     p15, 0, r0, c1, c0, 2
    isb

    mov     r0, #FPEXC_EN
    vmsr    fpexc, r0
    isb

#endif

    /* Zero .bss before any C code runs.  */

    ldr     r0, =__bss_start__
    ldr     r1, =__bss_end__
    mov     r2, #0
bss_zero_loop:
    cmp     r0, r1
    bhs     bss_zero_done
    str     r2, [r0], #4
    b       bss_zero_loop
bss_zero_done:

#ifdef TX_R52_ENABLE_MPU

    /* Protection and caches on before any application code runs.  This is
       after .bss is cleared because mpu_init keeps its region table there.  */

    bl      mpu_init

#endif

    bl      bsp_main

    /* bsp_main is not expected to return.  */
_start_hang:
    b       _start_hang

/**************************************************************************/
/*  el1_irq_entry -- IRQ vector.                                          */
/*                                                                        */
/*  With ThreadX linked in, the IRQ vector branches straight into         */
/*  _tx_thread_context_save, which saves the interrupted context and      */
/*  branches back to __tx_irq_processing_return.  The branch must be a    */
/*  plain B: context save adjusts lr itself to find the point of          */
/*  interrupt.  Interrupts are still disabled on return from it.          */
/*                                                                        */
/*  Images that do not link ThreadX (the M1 boot check) keep the          */
/*  self-identifying fault reporter instead.                              */
/**************************************************************************/

    .global el1_irq_entry
    .type   el1_irq_entry, %function
el1_irq_entry:
#ifdef TX_R52_USE_THREADX_IRQ
    b       _tx_thread_context_save

    .global __tx_irq_processing_return
__tx_irq_processing_return:
#ifdef TX_ENABLE_IRQ_NESTING

    /* Nested IRQ handling.  _tx_thread_irq_nesting_start leaves IRQ mode for
     * System mode and re-enables IRQ, so an interrupt of higher priority can
     * preempt this handler and re-enter at el1_irq_entry above.  It is paired
     * with _tx_thread_irq_nesting_end before _tx_thread_context_restore.
     *
     * The ORDER here is the whole difficulty, and getting it wrong does not
     * fail gracefully.  The interrupt must be ACKNOWLEDGED BEFORE nesting is
     * started.  Reading ICC_IAR1 is what raises the GIC's running priority to
     * this interrupt's own, which is what masks it and everything of equal or
     * lower priority; only then is re-enabling IRQ safe.  Acknowledge after
     * nesting_start instead and the still-pending, still-level-asserted timer
     * is taken again the instant IRQ is enabled, and again, until the IRQ and
     * System stacks are destroyed.  That presents as garbage on the console and
     * a hang, with no fault to point at it.  The Cortex-R5 example BSP says the
     * same thing in one line: "ensure all IRQ interrupts are cleared prior to
     * enabling nested IRQ interrupts".
     *
     * The INTID is carried in r4, which survives the mode switch because only
     * SP and LR are banked, and is also pushed on the IRQ stack so a nested
     * level that reuses r4 cannot lose this level's value.  End-of-interrupt is
     * left until after nesting_end, in IRQ mode with interrupts masked, so
     * dropping the running priority cannot re-admit this same interrupt.
     */

    bl      gicv3_acknowledge               /* IRQ mode, interrupts masked  */
    mov     r4, r0
    stmdb   sp!, {r4, r5}                   /* r5 keeps 8-byte alignment    */

    bl      _tx_thread_irq_nesting_start
    mov     r0, r4
    bl      board_irq_service
    bl      _tx_thread_irq_nesting_end

    ldmia   sp!, {r4, r5}
    mov     r0, r4
    bl      gicv3_end_of_interrupt
#else
    bl      board_irq_handler
#endif
    b       _tx_thread_context_restore
#else
    FAULT_REPORT msg_el1_irq
#endif

/**************************************************************************/
/*  el2_hyp_trap_entry -- the ZoneX (AR3) seam.                           */
/*                                                                        */
/*  Reached for every exception routed to EL2 from EL1/EL0, so the cause  */
/*  is decoded from HSR.EC before dispatch.  AR1 handles only HVC, which  */
/*  it counts before returning to EL1; that proves EL2 is live and        */
/*  reachable without the boot path changing later.  AR3 grows the        */
/*  dispatch table here (stage-2 faults, trapped accesses, IRQ paravirt). */
/*                                                                        */
/*  EL1's registers must be preserved -- this runs on the Hyp stack.      */
/**************************************************************************/

    .global el2_hyp_trap_entry
    .type   el2_hyp_trap_entry, %function
el2_hyp_trap_entry:
    push    {r0, r1}
    mrc     p15, 4, r0, c5, c2, 0           /* HSR                          */
    lsr     r1, r0, #HSR_EC_SHIFT
    cmp     r1, #HSR_EC_HVC
    bne     el2_hyp_trap_unhandled

    /* HVC from EL1: AR1 placeholder for the ZoneX hypercall dispatch.  */

    ldr     r0, =_hvc_call_count
    ldr     r1, [r0]
    add     r1, r1, #1
    str     r1, [r0]
    pop     {r0, r1}
    eret

el2_hyp_trap_unhandled:
    pop     {r0, r1}
    FAULT_REPORT msg_el2_hyp

/**************************************************************************/
/*  Unhandled exceptions.  Each records a distinct code in r12 so a halted*/
/*  model or a later fault dump (AR1/M5) can identify the cause.  Real    */
/*  handlers arrive with the interrupt work in M3.                        */
/**************************************************************************/

/* Unhandled exceptions.  Real handlers arrive with the interrupt work in
   AR1/M3; until then each vector identifies itself and halts.  */

el2_trap_reset:     FAULT_REPORT msg_el2_reset
el2_trap_undef:     FAULT_REPORT msg_el2_undef
el2_trap_svc:       FAULT_REPORT msg_el2_svc
el2_trap_pabt:      FAULT_REPORT msg_el2_pabt
el2_trap_dabt:      FAULT_REPORT msg_el2_dabt
el2_trap_irq:       FAULT_REPORT msg_el2_irq
el2_trap_fiq:       FAULT_REPORT msg_el2_fiq

el1_trap_reset:     FAULT_REPORT msg_el1_reset
el1_trap_undef:     FAULT_REPORT msg_el1_undef
el1_trap_svc:       FAULT_REPORT msg_el1_svc
/* Prefetch abort.  Fatal, except during the MPU self-test's execute-never
   check.  This one cannot recover the way the data-abort path does: skipping
   "the faulting instruction" is impossible when the instruction is precisely
   what could not be fetched.  So mpu_try_execute below records where to land
   and this handler returns there, restoring the pre-fault mode from SPSR.  */

el1_trap_pabt:
#ifdef TX_R52_MPU_FAULT_TEST
    push    {r0, r1}
    ldr     r0, =mpu_expect_pabt
    ldr     r1, [r0]
    cmp     r1, #0
    beq     el1_pabt_fatal
    mov     r1, #0
    str     r1, [r0]                        /* consume the expectation      */
    ldr     r0, =mpu_pabt_count
    ldr     r1, [r0]
    add     r1, r1, #1
    str     r1, [r0]
    dsb
    ldr     r0, =mpu_abort_return
    ldr     r1, [r0]
    mov     lr, r1                          /* land point, set before pop   */
    pop     {r0, r1}
    subs    pc, lr, #0                      /* return, restoring CPSR       */
el1_pabt_fatal:
    pop     {r0, r1}
#endif
    FAULT_REPORT msg_el1_pabt


#ifdef TX_R52_MPU_FAULT_TEST
/* mpu_try_execute(void (*target)(void))
   Call target and return normally if the fetch is permitted.  If it is not,
   el1_trap_pabt returns to the same place, so the caller continues either way
   and can tell the two apart by mpu_pabt_count.  SP is untouched by the
   faulting branch, so the saved LR is still on the stack when we land.  */

    .global mpu_try_execute
    .type   mpu_try_execute, %function
mpu_try_execute:
    push    {r4, lr}
    ldr     r1, =mpu_abort_return
    adr     r2, mpu_try_execute_land
    str     r2, [r1]
    dsb
    isb
    blx     r0
mpu_try_execute_land:
    pop     {r4, lr}
    bx      lr
    .size   mpu_try_execute, . - mpu_try_execute
#endif

/* Data abort.  Normally fatal and self-reporting, but the MPU self-test
   needs to provoke a permission fault and carry on: without that, "the MPU
   is enabled" is an unverified claim.  When mpu_expect_abort is non-zero the
   fault is counted and execution resumes at the instruction *after* the one
   that faulted.  On a data abort LR_abt holds the faulting address plus 8,
   so returning to LR_abt-4 skips it, where LR_abt-8 would retry it forever.
   Runs on the Abort-mode stack set up above.  */

el1_trap_dabt:
#ifdef TX_R52_MPU_FAULT_TEST
    push    {r0, r1}
    ldr     r0, =mpu_expect_abort
    ldr     r1, [r0]
    cmp     r1, #0
    beq     el1_dabt_fatal
    mov     r1, #0
    str     r1, [r0]                        /* consume the expectation      */
    ldr     r0, =mpu_abort_count
    ldr     r1, [r0]
    add     r1, r1, #1
    str     r1, [r0]
    dsb
    pop     {r0, r1}
    subs    pc, lr, #4                      /* resume after the fault       */
el1_dabt_fatal:
    pop     {r0, r1}
#endif
    FAULT_REPORT msg_el1_dabt
el1_trap_reserved:  FAULT_REPORT msg_el1_reserved
el1_trap_fiq:
#if defined(TX_ENABLE_FIQ_SUPPORT) && defined(TX_R52_USE_THREADX_IRQ)

    /* Both guards are needed, and the second is not obvious.
     * TX_ENABLE_FIQ_SUPPORT is PUBLIC on the threadx target, so it reaches every
     * image the moment the library is built with FIQ, including images that link
     * no interrupt controller at all.  demo_m2 is one: it has no gicv3.c and no
     * irq_dispatch.c, so referencing gicv3_acknowledge_group0 and
     * board_fiq_service from here broke its link outright.  Images without the
     * interrupt infrastructure keep the fault reporter on this vector, which is
     * how the IRQ vector above is gated too.
     */

    /* FIQ has its own context save and restore in the port, and its own nesting
     * pair.  The shape mirrors the IRQ path, and so does the trap: the interrupt
     * must be acknowledged before nesting starts.  Group 0 has its own
     * acknowledge and end-of-interrupt registers -- using the Group 1 ones here
     * returns the spurious INTID and leaves the interrupt pending, which
     * presents as an FIQ storm rather than as an error.
     *
     * FIQ mode banks r8-r12 as well as SP and LR, so the INTID cannot ride in a
     * high register across the switch to System mode the way r4 does on the IRQ
     * path.  r4 is not banked in FIQ mode either, so it still works, and it is
     * pushed on the FIQ stack as well so a nested level cannot lose it.
     */

    b       _tx_thread_fiq_context_save

    .global __tx_fiq_processing_return
__tx_fiq_processing_return:
#ifdef TX_ENABLE_FIQ_NESTING
    bl      gicv3_acknowledge_group0
    mov     r4, r0
    stmdb   sp!, {r4, r5}

    bl      _tx_thread_fiq_nesting_start
    mov     r0, r4
    bl      board_fiq_service
    bl      _tx_thread_fiq_nesting_end

    ldmia   sp!, {r4, r5}
    mov     r0, r4
    bl      gicv3_end_of_interrupt_group0
#else
    bl      board_fiq_handler
#endif
    b       _tx_thread_fiq_context_restore
#else
    FAULT_REPORT msg_el1_fiq
#endif

fault_halt:         b       fault_halt

    .section .rodata
    .balign 4
msg_el2:
    .asciz  "[EL2] reset entry reached; configuring EL2 and dropping to EL1\n"

msg_el2_reset:      .asciz  "[FAULT] EL2 reset vector\n"
msg_el2_undef:      .asciz  "[FAULT] EL2 undefined instruction\n"
msg_el2_svc:        .asciz  "[FAULT] EL2 supervisor call from Hyp mode\n"
msg_el2_pabt:       .asciz  "[FAULT] EL2 prefetch abort\n"
msg_el2_dabt:       .asciz  "[FAULT] EL2 data abort\n"
msg_el2_hyp:        .asciz  "[FAULT] EL2 hyp trap with unhandled HSR.EC\n"
msg_el2_irq:        .asciz  "[FAULT] EL2 IRQ (unexpected: IRQs route to EL1)\n"
msg_el2_fiq:        .asciz  "[FAULT] EL2 FIQ (unexpected: FIQs route to EL1)\n"

msg_el1_reset:      .asciz  "[FAULT] EL1 reset vector\n"
msg_el1_undef:      .asciz  "[FAULT] EL1 undefined instruction\n"
msg_el1_svc:        .asciz  "[FAULT] EL1 supervisor call (no handler yet)\n"
msg_el1_pabt:       .asciz  "[FAULT] EL1 prefetch abort\n"
msg_el1_dabt:       .asciz  "[FAULT] EL1 data abort\n"
msg_el1_reserved:   .asciz  "[FAULT] EL1 reserved vector\n"
msg_el1_irq:        .asciz  "[FAULT] EL1 IRQ (no handler yet)\n"
msg_el1_fiq:        .asciz  "[FAULT] EL1 FIQ (no handler yet)\n"

    .section .data
    .balign 4
    .global _hvc_call_count
_hvc_call_count:
    .word   0

/* Used by the MPU enforcement self-test (see el1_trap_dabt).             */

    .global mpu_expect_abort
mpu_expect_abort:
    .word   0

    .global mpu_abort_count
mpu_abort_count:
    .word   0

/* Used by the execute-never self-test (see el1_trap_pabt).                */

    .global mpu_expect_pabt
mpu_expect_pabt:
    .word   0

    .global mpu_pabt_count
mpu_pabt_count:
    .word   0

    .global mpu_abort_return
mpu_abort_return:
    .word   0
