/***************************************************************************
 * Copyright (c) 2026 Eclipse ThreadX contributors
 *
 * This program and the accompanying materials are made available under the
 * terms of the MIT License which is available at
 * https://opensource.org/licenses/MIT.
 *
 * AI Disclosure: This file was largely AI-generated by Claude Code (Opus 5).
 * The AI-generated portions may be considered public domain (CC0-1.0)
 * and not subject to the project's licence. The human contributor has
 * reviewed and verified that the code is correct.
 *
 * SPDX-License-Identifier: MIT and CC0-1.0
 **************************************************************************/

/**************************************************************************/
/*                                                                        */
/*  BOARD SUPPORT                                          RELEASE        */
/*                                                                        */
/*    irq_dispatch.c                                   Cortex-R52/GNU     */
/*                                                           6.5.2        */
/*  AUTHOR                                                                */
/*                                                                        */
/*    Frédéric Desbiens, Eclipse Foundation                               */
/*                                                                        */
/*  DESCRIPTION                                                           */
/*                                                                        */
/*    Interrupt dispatch for Cortex-R52 on the Armv8-R AEM FVP.  Called   */
/*    from __tx_irq_processing_return in entry.S, that is after           */
/*    _tx_thread_context_save has saved the interrupted context and with  */
/*    interrupts still disabled.                                          */
/*                                                                        */
/*    _tx_timer_interrupt is safe to call from C: it uses only r0-r3 and  */
/*    returns through lr like an ordinary function.                       */
/*                                                                        */
/**************************************************************************/

#include "board.h"
#include "gicv3.h"
#include "timer.h"

/* ThreadX periodic timer entry point (assembly, AAPCS-compatible).       */

extern void _tx_timer_interrupt(void);

/* Observability for the M3 checks.  board_timer_intid records the INTID that
   actually arrived -- this is how the timer PPI was identified during bring-up
   (see TIMER_PPI_INTID) and it keeps reporting it, so a platform that assigns
   the timer elsewhere shows up as an unexpected INTID rather than a silent
   absence of ticks.  */

volatile unsigned long  board_irq_count;
volatile unsigned long  board_timer_intid;
volatile unsigned long  board_spurious_count;
volatile unsigned long  board_unexpected_intid;

volatile unsigned long  board_nest_depth;
volatile unsigned long  board_nest_max;
volatile unsigned long  board_sgi_count;
volatile unsigned long  board_sgi_nested_count;
volatile unsigned long  board_nest_provoke;


/* Timer PPI priority.  Only the top 5 priority bits are implemented on this
   model, so the value is a multiple of 8.  */

#define TIMER_PPI_PRIORITY      0xA0U


/**************************************************************************/
/*  board_init                                                            */
/*                                                                        */
/*  Called from _tx_initialize_low_level.  Interrupts are still masked at */
/*  this point, so the tick cannot be delivered before the kernel is      */
/*  ready for it.                                                         */
/**************************************************************************/

void board_init(void)
{
    gicv3_init();
    gicv3_enable_ppi(TIMER_PPI_INTID, TIMER_PPI_PRIORITY);

    /* The nesting SGI must outrank the timer or it could never preempt it:
       in the GIC a numerically lower priority value wins.  Enabling it costs
       nothing in images that never raise it.  */

    gicv3_enable_sgi(BOARD_NEST_SGI_INTID, TIMER_PPI_PRIORITY / 2U);

    timer_init();
}


/**************************************************************************/
/*  board_irq_handler                                                     */
/**************************************************************************/

/**************************************************************************/
/*  board_irq_service -- service an already-acknowledged INTID.            */
/*                                                                        */
/*  Split out so the nesting path in entry.S can acknowledge in IRQ mode   */
/*  before nesting starts.  Does not acknowledge and does not EOI.         */
/**************************************************************************/

void board_irq_service(unsigned long intid)
{
    if (intid == GICV3_SPURIOUS_INTID)
    {
        /* No interrupt was actually pending; must not be acknowledged.  */

        board_spurious_count++;
        return;
    }

    /* Depth is incremented after the spurious check so a spurious entry does
       not register as nesting.  It reaches 2 only if a second interrupt is
       taken while this handler is still on the stack, which cannot happen
       without TX_ENABLE_IRQ_NESTING.  */

    board_nest_depth++;
    if (board_nest_depth > board_nest_max)
    {
        board_nest_max = board_nest_depth;
    }

    if (intid == (unsigned long) TIMER_PPI_INTID)
    {
        board_timer_intid = intid;
        board_irq_count++;

        /* Re-arm before servicing so the next interval starts immediately;
           this also deasserts the level-sensitive timer output.  */

        timer_reload();

        /* Provoke the nesting, if this image asked for it.  Raising the SGI
           here is only useful because _tx_thread_irq_nesting_start has already
           re-enabled IRQ; the bounded spin gives the GIC the chance to deliver
           it before this handler returns, so the nesting is deterministic
           rather than a race we hope wins.  The bound matters: without
           TX_ENABLE_IRQ_NESTING the SGI can never arrive and this must not
           become a hang.  */

        if (board_nest_provoke != 0UL)
        {
            unsigned long seen = board_sgi_count;
            unsigned long guard;

            gicv3_send_sgi(BOARD_NEST_SGI_INTID);

            for (guard = 0UL; guard < 100000UL; guard++)
            {
                if (board_sgi_count != seen)
                {
                    break;
                }
            }
        }

        _tx_timer_interrupt();
    }
    else if (intid == (unsigned long) BOARD_NEST_SGI_INTID)
    {
        board_sgi_count++;

        /* Depth above 1 means this SGI arrived inside another handler, which
           is the whole point of the test.  */

        if (board_nest_depth > 1UL)
        {
            board_sgi_nested_count++;
        }
    }
    else
    {
        board_unexpected_intid = intid;
    }

    board_nest_depth--;
}


/**************************************************************************/
/*  board_irq_handler -- the non-nesting entry point.                      */
/*                                                                        */
/*  Acknowledges, services and ends the interrupt, all in IRQ mode with    */
/*  interrupts masked.  entry.S calls this when the image was built without */
/*  TX_ENABLE_IRQ_NESTING, so the behaviour of every existing image is      */
/*  exactly what it was.                                                  */
/**************************************************************************/

void board_irq_handler(void)
{
    unsigned long intid = gicv3_acknowledge();

    board_irq_service(intid);

    if (intid != GICV3_SPURIOUS_INTID)
    {
        gicv3_end_of_interrupt(intid);
    }
}
