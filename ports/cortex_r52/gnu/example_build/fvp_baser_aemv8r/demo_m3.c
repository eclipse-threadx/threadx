/***************************************************************************
 * Copyright (c) 2026 Eclipse ThreadX contributors
 *
 * This program and the accompanying materials are made available under the
 * terms of the MIT License which is available at
 * https://opensource.org/licenses/MIT.
 *
 * AI Disclosure: This file was largely AI-generated by Claude Code (Opus 5).
 * The AI-generated portions may be considered public domain (CC0-1.0)
 * and not subject to the project's licence. The human contributor has
 * reviewed and verified that the code is correct.
 *
 * SPDX-License-Identifier: MIT and CC0-1.0
 **************************************************************************/

/**************************************************************************/
/*                                                                        */
/*  DEMONSTRATION                                          RELEASE        */
/*                                                                        */
/*    demo_m3.c                                        Cortex-R52/GNU     */
/*                                                           6.5.2        */
/*  AUTHOR                                                                */
/*                                                                        */
/*    Frédéric Desbiens, Eclipse Foundation                               */
/*                                                                        */
/*  DESCRIPTION                                                           */
/*                                                                        */
/*    AR1 milestone M3: periodic tick and preemptive scheduling.  This    */
/*    exercises the parts of the port that M2 could not reach --          */
/*    _tx_thread_context_save, _tx_timer_interrupt and                    */
/*    _tx_thread_context_restore -- by driving them from a real generic   */
/*    timer interrupt routed through GICv3.                               */
/*                                                                        */
/*    The checks build on each other, so a failure localises the cause:   */
/*      1. CNTFRQ is non-zero      -> entry.S programmed it at EL2        */
/*      2. counter is enabled       -> the control frame was started      */
/*      3. CNTPCT advances          -> the counter really runs            */
/*      4. interrupts arrive        -> GICv3 + PPI + vector wiring work   */
/*      5. tx_time_get advances     -> _tx_timer_interrupt drives the tick*/
/*      6. tx_thread_sleep returns  -> timer-driven thread resumption     */
/*      7. a lower-priority thread ran while we slept -> preemption and   */
/*         context save/restore across an interrupt                       */
/*                                                                        */
/*    The timer PPI INTID is reported, not assumed: the whole PPI range is*/
/*    enabled and whichever INTID the model drives is recorded.           */
/*                                                                        */
/**************************************************************************/

#include "tx_api.h"
#include "board.h"
#include "console.h"
#include "timer.h"

#define DEMO_STACK_SIZE     2048
#define SLEEP_TICKS         20UL
#define SLEEP_SLACK_TICKS   10UL

static TX_THREAD    thread_main;
static TX_THREAD    thread_busy;

static ULONG        thread_main_stack[DEMO_STACK_SIZE / sizeof(ULONG)];
static ULONG        thread_busy_stack[DEMO_STACK_SIZE / sizeof(ULONG)];

static volatile ULONG   busy_counter;

/* Recorded by the interrupt dispatcher.                                  */



/**************************************************************************/
/*  report -- print one labelled check result.                            */
/**************************************************************************/

static UINT report(const char *label_ptr, UINT passed)
{
    console_puts(label_ptr);
    console_puts((passed != 0U) ? "PASS\n" : "FAIL\n");

    return (passed != 0U) ? 0U : 1U;
}


/**************************************************************************/
/*  thread_busy_entry -- lowest priority; only runs when nothing else can.*/
/**************************************************************************/

static void thread_busy_entry(ULONG thread_input)
{
    (void) thread_input;

    for (;;)
    {
        busy_counter++;
    }
}


/**************************************************************************/
/*  thread_main_entry -- runs the checks and terminates the simulation.   */
/**************************************************************************/

static void thread_main_entry(ULONG thread_input)
{
    UINT                failures = 0U;
    unsigned long       frequency;
    unsigned long long  counter_first;
    unsigned long long  counter_second;
    ULONG               time_before;
    ULONG               time_after;
    ULONG               elapsed;
    ULONG               busy_before;
    ULONG               busy_after;
    unsigned long       irq_before;

    (void) thread_input;

    /* Check 1: CNTFRQ was programmed at EL2 (the model resets it to zero).  */

    frequency = timer_frequency();
    console_puts("[check] CNTFRQ = ");
    console_puthex(frequency);
    console_puts(" Hz\n");
    failures += report("[check] CNTFRQ programmed at EL2 (non-zero)        ",
                       (frequency != 0UL) ? 1U : 0U);

    /* Check 2: the system counter was started (stopped at reset).  */

    failures += report("[check] system counter enabled by BSP              ",
                       timer_counter_enabled());

    /* Check 3: the counter actually advances.  */

    counter_first = timer_counter();
    {
        volatile unsigned int spin;
        for (spin = 0U; spin < 20000U; spin++)
        {
            /* Burn a little time.  */
        }
    }
    counter_second = timer_counter();
    failures += report("[check] CNTPCT advancing                           ",
                       (counter_second > counter_first) ? 1U : 0U);

    /* Check 4: timer interrupts are being delivered through GICv3.  */

    irq_before = board_irq_count;
    time_before = tx_time_get();
    busy_before = busy_counter;

    /* Check 6: a timer-driven sleep returns.  While suspended, the only
       runnable thread is the lower-priority busy thread.  */

    tx_thread_sleep(SLEEP_TICKS);

    time_after = tx_time_get();
    busy_after = busy_counter;

    console_puts("[check] timer PPI INTID observed = ");
    console_puthex(board_timer_intid);
    console_puts("\n[check] timer interrupts taken   = ");
    console_puthex(board_irq_count);
    console_puts("\n");

    failures += report("[check] timer interrupts delivered via GICv3        ",
                       (board_irq_count > irq_before) ? 1U : 0U);

    /* Check 5: the ThreadX clock is driven by those interrupts.  */

    elapsed = time_after - time_before;
    console_puts("[check] tx_time_get elapsed      = ");
    console_puthex(elapsed);
    console_puts(" ticks (slept ");
    console_puthex(SLEEP_TICKS);
    console_puts(")\n");

    failures += report("[check] tx_time_get advancing                       ",
                       (elapsed >= SLEEP_TICKS) ? 1U : 0U);

    failures += report("[check] sleep lasted about the requested time       ",
                       (elapsed <= (SLEEP_TICKS + SLEEP_SLACK_TICKS)) ? 1U : 0U);

    /* Check 7: the lower-priority thread ran while we were suspended, then
       was preempted when the tick made this thread ready again.  That
       requires a correct context save and restore across the interrupt.  */

    console_puts("[check] busy-thread counter delta = ");
    console_puthex(busy_after - busy_before);
    console_puts("\n");

    failures += report("[check] lower-priority thread ran, then preempted   ",
                       (busy_after > busy_before) ? 1U : 0U);

    /* Nothing unexpected should have arrived on the interrupt path.  */

    if (board_unexpected_intid != 0UL)
    {
        console_puts("[check] unexpected INTID = ");
        console_puthex(board_unexpected_intid);
        console_puts("\n");
    }
    failures += report("[check] no unexpected interrupt IDs                 ",
                       (board_unexpected_intid == 0UL) ? 1U : 0U);

    if (failures == 0U)
    {
        console_puts("\nM3 RESULT: ALL CHECKS PASSED\n");
    }
    else
    {
        console_puts("\nM3 RESULT: FAILED\n");
    }

    console_exit(failures);
}


/**************************************************************************/
/*  tx_application_define                                                 */
/**************************************************************************/

void tx_application_define(void *first_unused_memory)
{
    (void) first_unused_memory;

    /* Priority 10 runs the checks; priority 20 only gets the processor when
       the checking thread is suspended.  */

    (void) tx_thread_create(&thread_main, "check thread", thread_main_entry,
                            0UL, thread_main_stack, sizeof(thread_main_stack),
                            10U, 10U, TX_NO_TIME_SLICE, TX_AUTO_START);

    (void) tx_thread_create(&thread_busy, "busy thread", thread_busy_entry,
                            0UL, thread_busy_stack, sizeof(thread_busy_stack),
                            20U, 20U, TX_NO_TIME_SLICE, TX_AUTO_START);
}


/**************************************************************************/
/*  bsp_main -- entered at EL1 from entry.S.  Does not return.            */
/**************************************************************************/

void bsp_main(void)
{
    console_puts("\n=== ThreadX AR1/M3 tick and preemption "
                 "(Cortex-R52, Armv8-R AArch32, Armv8-R AEM FVP) ===\n");

    tx_kernel_enter();
}
