/***************************************************************************
 * Copyright (c) 2026 Eclipse ThreadX contributors
 *
 * This program and the accompanying materials are made available under the
 * terms of the MIT License which is available at
 * https://opensource.org/licenses/MIT.
 *
 * AI Disclosure: This file was largely AI-generated by Claude Code (Opus 5).
 * The AI-generated portions may be considered public domain (CC0-1.0)
 * and not subject to the project's licence. The human contributor has
 * reviewed and verified that the code is correct.
 *
 * SPDX-License-Identifier: MIT and CC0-1.0
 **************************************************************************/

/**************************************************************************/
/*                                                                        */
/*  BOARD SUPPORT                                          RELEASE        */
/*                                                                        */
/*    uart_pl011.c                                     Cortex-R52/GNU     */
/*                                                           6.5.2        */
/*  DESCRIPTION                                                           */
/*                                                                        */
/*    PL011 UART output for the Armv8-R AEM FVP, used as the console when */
/*    the image is built with TX_R52_CONSOLE_PL011.                       */
/*                                                                        */
/*    Semihosting remains the default because it needs no peripheral at   */
/*    all, which keeps early bring-up independent of the memory map.  The */
/*    UART matters because it is what real silicon will use: exercising it*/
/*    here means the S32Z280 console differs only in its base address and */
/*    clocking, not in structure.                                         */
/*                                                                        */
/*    The model leaves UART0 disabled at reset                            */
/*    (bp.pl011_uart0.uart_enable=0), so the control register must be     */
/*    written before the first character.  Baud rate is left alone: the   */
/*    model does not emulate serial timing, and inventing a divisor here  */
/*    would only be misleading.                                           */
/*                                                                        */
/*  MISRA C:2012 deviations (justified)                                   */
/*                                                                        */
/*    Rule 11.4/11.6 -- casting integer addresses to volatile pointers is */
/*      inherent to memory-mapped device access; confined to REG32.       */
/*                                                                        */
/**************************************************************************/

#include "platform.h"
#include "uart_pl011.h"

/* PL011 register offsets.                                                */

#define UART_DR         0x000U          /* data                             */
#define UART_FR         0x018U          /* flags                            */
#define UART_LCR_H      0x02CU          /* line control                     */
#define UART_CR         0x030U          /* control                          */

#define UART_FR_TXFF    (1UL << 5)      /* transmit FIFO full               */

#define UART_LCR_H_WLEN_8   (3UL << 5)  /* 8 data bits                      */
#define UART_LCR_H_FEN      (1UL << 4)  /* enable FIFOs                     */

#define UART_CR_UARTEN      (1UL << 0)  /* UART enable                      */
#define UART_CR_TXE         (1UL << 8)  /* transmit enable                  */
#define UART_CR_RXE         (1UL << 9)  /* receive enable                   */


/**************************************************************************/
/*  pl011_init                                                            */
/**************************************************************************/

void pl011_init(void)
{
    /* Disable while reconfiguring, as the programming model requires.  */

    REG32(PL011_UART0_BASE + UART_CR) = 0UL;

    REG32(PL011_UART0_BASE + UART_LCR_H) = UART_LCR_H_WLEN_8 | UART_LCR_H_FEN;

    REG32(PL011_UART0_BASE + UART_CR) =
        UART_CR_UARTEN | UART_CR_TXE | UART_CR_RXE;
}


/**************************************************************************/
/*  pl011_putc                                                            */
/**************************************************************************/

void pl011_putc(char character)
{
    /* Expand newlines so the host console shows discrete lines.  */

    if (character == '\n')
    {
        pl011_putc('\r');
    }

    while ((REG32(PL011_UART0_BASE + UART_FR) & UART_FR_TXFF) != 0UL)
    {
        /* Wait for room in the transmit FIFO.  */
    }

    REG32(PL011_UART0_BASE + UART_DR) = (unsigned long) (unsigned char) character;
}


/**************************************************************************/
/*  pl011_puts                                                            */
/**************************************************************************/

void pl011_puts(const char *string_ptr)
{
    const char *cursor = string_ptr;

    if (cursor == 0)
    {
        return;
    }

    while (*cursor != '\0')
    {
        pl011_putc(*cursor);
        cursor++;
    }
}
