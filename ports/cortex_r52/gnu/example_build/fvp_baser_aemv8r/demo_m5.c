/***************************************************************************
 * Copyright (C) 2026 Eclipse ThreadX contributors
 *
 * This program and the accompanying materials are made available under the
 * terms of the MIT License which is available at
 * https://opensource.org/licenses/MIT.
 *
 * AI Disclosure: This file was largely AI-generated by Claude Code (Opus 5).
 * The AI-generated portions may be considered public domain (CC0-1.0)
 * and not subject to the project's licence. The human contributor has
 * reviewed and verified that the code is correct.
 *
 * SPDX-License-Identifier: MIT and CC0-1.0
 **************************************************************************/

/**************************************************************************/
/*                                                                        */
/*  DEMONSTRATION                                          RELEASE        */
/*                                                                        */
/*    demo_m5.c                                        Cortex-R52/GNU     */
/*                                                                        */
/*  DESCRIPTION                                                           */
/*                                                                        */
/*    AR1 milestone M5: lazy floating-point context save and restore.      */
/*                                                                        */
/*    Two paths must be covered, and they use different register sets:     */
/*                                                                        */
/*      solicited  tx_thread_system_return saves D8-D15 and FPSCR, because */
/*                 the callee-saved half is all a voluntary switch can      */
/*                 lose.  Exercised by the checking thread, which keeps     */
/*                 eight doubles live across tx_thread_sleep.              */
/*      interrupt  tx_thread_context_restore restores D0-D15 and FPSCR,     */
/*                 because an asynchronous interrupt can land anywhere.     */
/*                 Exercised by a lower-priority thread doing continuous    */
/*                 floating-point work while the tick fires into it.        */
/*                                                                        */
/*    Every constant is an exact binary fraction, so the comparisons are    */
/*    exact and a single corrupted register shows up as a mismatch rather   */
/*    than as rounding noise.  The two threads use disjoint value ranges,   */
/*    so leakage from one context into the other is also caught.            */
/*                                                                        */
/*    Both threads call tx_thread_vfp_enable(): with lazy save/restore, a   */
/*    thread that has not asked for floating-point support does not get it, */
/*    so forgetting the call would show up as corruption rather than as a   */
/*    build error.                                                        */
/*                                                                        */
/**************************************************************************/

#include "tx_api.h"
#include "console.h"

#define DEMO_STACK_SIZE     2048
#define FILEX_PTR_SENTINEL  ((void *) 0xF11EF11EUL)
#define FP_ITERATIONS       50UL
#define FP_STEP             0.5           /* exactly representable          */

static TX_THREAD    thread_check;
static TX_THREAD    thread_fp_busy;

static ULONG        thread_check_stack[DEMO_STACK_SIZE / sizeof(ULONG)];
static ULONG        thread_fp_busy_stack[DEMO_STACK_SIZE / sizeof(ULONG)];

/* Set by the busy thread if its floating-point state was ever seen wrong.  */

static volatile ULONG   busy_iterations;
static volatile ULONG   busy_corruptions;


/**************************************************************************/
/*  report                                                                */
/**************************************************************************/

static UINT report(const char *label_ptr, UINT passed)
{
    console_puts(label_ptr);
    console_puts((passed != 0U) ? "PASS\n" : "FAIL\n");

    return (passed != 0U) ? 0U : 1U;
}


/**************************************************************************/
/*  thread_fp_busy_entry                                                  */
/*                                                                        */
/*  Lowest priority, never sleeps: the periodic tick therefore interrupts  */
/*  it in the middle of floating-point work, which is what exercises the   */
/*  interrupt half of the VFP context path (D0-D15 + FPSCR).  Its values   */
/*  are checked every iteration against exactly representable constants.   */
/**************************************************************************/

static void thread_fp_busy_entry(ULONG thread_input)
{
    (void) thread_input;

    tx_thread_vfp_enable();

    for (;;)
    {
        /* Disjoint from the checking thread's range, so cross-contamination
           between contexts is detectable.  */

        double v0 = 1024.5;
        double v1 = 2048.25;
        double v2 = 4096.125;
        double v3 = 8192.0625;

        v0 = (v0 * 2.0) - 1024.5;       /* 1024.5   */
        v1 = (v1 * 2.0) - 2048.25;      /* 2048.25  */
        v2 = (v2 * 2.0) - 4096.125;     /* 4096.125 */
        v3 = (v3 * 2.0) - 8192.0625;    /* 8192.0625*/

        if ((v0 != 1024.5) || (v1 != 2048.25) ||
            (v2 != 4096.125) || (v3 != 8192.0625))
        {
            busy_corruptions++;
        }

        busy_iterations++;
    }
}


/**************************************************************************/
/*  thread_check_entry                                                    */
/**************************************************************************/

static void thread_check_entry(ULONG thread_input)
{
    UINT        failures = 0U;
    ULONG       iteration;
    ULONG       expected_steps;
    TX_THREAD  *self;

    /* Eight live doubles held across a blocking call.  Eight is chosen so
       the compiler must use the callee-saved bank D8-D15 (or spill), which
       is exactly what a solicited context switch has to preserve.  */

    double a = 1.5;
    double b = 2.25;
    double c = 3.125;
    double d = 4.0625;
    double e = 5.03125;
    double f = 6.015625;
    double g = 7.0078125;
    double h = 8.00390625;

    (void) thread_input;

    /* Guard against the VFP enable flag aliasing another thread member.  The
       flag is reached from assembly by hard-coded offset, and on the
       Cortex-R4/R5 ports that offset lands on tx_thread_filex_ptr because
       their TX_THREAD_EXTENSION_2 is empty.  Planting a sentinel here turns
       that class of mistake into a visible failure rather than corruption
       that only surfaces once FileX is added.  */

    self = tx_thread_identify();
    self->tx_thread_filex_ptr = FILEX_PTR_SENTINEL;

    tx_thread_vfp_enable();

    console_puts("[check] running floating-point work across ");
    console_puthex(FP_ITERATIONS);
    console_puts(" solicited switches...\n");

    for (iteration = 0UL; iteration < FP_ITERATIONS; iteration++)
    {
        /* Suspend: the switch must preserve every one of these values, and
           the lower-priority floating-point thread runs meanwhile.  */

        tx_thread_sleep(1);

        a += FP_STEP;
        b += FP_STEP;
        c += FP_STEP;
        d += FP_STEP;
        e += FP_STEP;
        f += FP_STEP;
        g += FP_STEP;
        h += FP_STEP;
    }

    expected_steps = FP_ITERATIONS;

    /* Exact comparisons: every value above is an exact binary fraction and
       FP_STEP is 0.5, so no rounding is involved.  */

    failures += report("[check] D-register value a preserved exactly        ",
                       (a == (1.5        + (0.5 * (double) expected_steps))) ? 1U : 0U);
    failures += report("[check] D-register value b preserved exactly        ",
                       (b == (2.25       + (0.5 * (double) expected_steps))) ? 1U : 0U);
    failures += report("[check] D-register value c preserved exactly        ",
                       (c == (3.125      + (0.5 * (double) expected_steps))) ? 1U : 0U);
    failures += report("[check] D-register value d preserved exactly        ",
                       (d == (4.0625     + (0.5 * (double) expected_steps))) ? 1U : 0U);
    failures += report("[check] D-register value e preserved exactly        ",
                       (e == (5.03125    + (0.5 * (double) expected_steps))) ? 1U : 0U);
    failures += report("[check] D-register value f preserved exactly        ",
                       (f == (6.015625   + (0.5 * (double) expected_steps))) ? 1U : 0U);
    failures += report("[check] D-register value g preserved exactly        ",
                       (g == (7.0078125  + (0.5 * (double) expected_steps))) ? 1U : 0U);
    failures += report("[check] D-register value h preserved exactly        ",
                       (h == (8.00390625 + (0.5 * (double) expected_steps))) ? 1U : 0U);

    /* The busy thread must have run, and never seen its own state damaged
       by an interrupt landing inside its floating-point sequence.  */

    console_puts("[check] busy-thread iterations = ");
    console_puthex(busy_iterations);
    console_puts("\n[check] busy-thread corruptions = ");
    console_puthex(busy_corruptions);
    console_puts("\n");

    failures += report("[check] interrupted FP thread made progress        ",
                       (busy_iterations > 0UL) ? 1U : 0U);
    failures += report("[check] no FP corruption across interrupts         ",
                       (busy_corruptions == 0UL) ? 1U : 0U);

    /* The VFP flag must not have aliased tx_thread_filex_ptr.  */

    console_puts("[check] tx_thread_filex_ptr = ");
    console_puthex((unsigned long) self->tx_thread_filex_ptr);
    console_puts(" (expected 0xf11ef11e)\n");

    failures += report("[check] VFP flag did not alias filex_ptr           ",
                       (self->tx_thread_filex_ptr == FILEX_PTR_SENTINEL) ? 1U : 0U);

    if (failures == 0U)
    {
        console_puts("\nM5 RESULT: ALL CHECKS PASSED\n");
    }
    else
    {
        console_puts("\nM5 RESULT: FAILED\n");
    }

    console_exit(failures);
}


/**************************************************************************/
/*  tx_application_define                                                 */
/**************************************************************************/

void tx_application_define(void *first_unused_memory)
{
    (void) first_unused_memory;

    (void) tx_thread_create(&thread_check, "fp check", thread_check_entry, 0UL,
                            thread_check_stack, sizeof(thread_check_stack),
                            10U, 10U, TX_NO_TIME_SLICE, TX_AUTO_START);

    (void) tx_thread_create(&thread_fp_busy, "fp busy", thread_fp_busy_entry,
                            0UL, thread_fp_busy_stack,
                            sizeof(thread_fp_busy_stack),
                            20U, 20U, TX_NO_TIME_SLICE, TX_AUTO_START);
}


/**************************************************************************/
/*  bsp_main -- entered at EL1 from entry.S.  Does not return.            */
/**************************************************************************/

void bsp_main(void)
{
    console_puts("\n=== ThreadX AR1/M5 lazy VFP context switch "
                 "(Cortex-R52, Armv8-R AArch32, Armv8-R AEM FVP) ===\n");

    tx_kernel_enter();
}
