/***************************************************************************
 * Copyright (c) 2026 Eclipse ThreadX contributors
 *
 * This program and the accompanying materials are made available under the
 * terms of the MIT License which is available at
 * https://opensource.org/licenses/MIT.
 *
 * AI Disclosure: This file was largely AI-generated by Claude Code (Opus 5).
 * The AI-generated portions may be considered public domain (CC0-1.0)
 * and not subject to the project's licence. The human contributor has
 * reviewed and verified that the code is correct.
 *
 * SPDX-License-Identifier: MIT and CC0-1.0
 **************************************************************************/

/* This test drives the two places where the SMP scheduler asks whether the
   core it is running on has a thread to execute at all, and is told that it
   has not.

   The resume path and the preemption check each compare the core's current
   thread against its execute entry and, when they differ, pick the execute
   entry up to check its stack. The entry is empty whenever the core has
   nothing to run, so both guard the stack check with a null test. Ordinary use
   never reaches those guards with an empty entry: a core whose current thread
   is still set is a core that is running something, and the scheduler has
   normally already chosen what runs next.

   The arrangement that separates the two is a thread excluded from every core.
   tx_thread_smp_core_exclude supports that explicitly, and it leaves the thread
   ready and permanently unmapped, so the execute entry of the core it was
   running on is emptied while the thread itself carries on until it next gives
   the core up.

   The preemption check has to give the core up, because that is what it is for.
   The test thread is therefore rescued from interrupt context: the tick puts its
   exclusion mask back once the core has gone idle, which is the one moment that
   cannot be confused with the window before the check runs. The mask change and
   the rescue are the only two things this test does to the running system; no
   kernel source is modified and every service it calls is one the kernel
   publishes.  */


#include   <stdio.h>
#include   "tx_api.h"
#define    TX_SOURCE_CODE

/* The execute list, the current thread list and the preempt disable flag are
   what this test constructs a state out of, and on SMP the first two are per
   core behind a macro that hides the array.  */

#define    TX_THREAD_SMP_SOURCE_CODE
#include   "tx_thread.h"


/* Define the ISR dispatch.  */

extern VOID    (*test_isr_dispatch)(void);


#define TEST_PRIORITY               16
#define SCRATCH_PRIORITY            20

/* Every core excluded. The service takes the exclusion map, so this is all of
   the cores the port declares.  */

#define ALL_CORES_EXCLUDED          ((ULONG) TX_THREAD_SMP_CORE_MASK)

/* How many times the preemption check is arranged. The arrangement is lost if
   a tick lands between the moment preemption is allowed again and the moment
   the check takes the protection, which is a window of a few instructions
   against a tick of many thousands. Repeating it costs two ticks an attempt and
   removes the question.  */

#define PREEMPT_CHECK_ATTEMPTS      8

/* How long the test waits for the tick to put it back. A park that is never
   rescued would otherwise hang rather than fail.  */

#define RESCUE_TICK_LIMIT           100


static unsigned long   thread_0_counter =  0;
static TX_THREAD       thread_0;

/* The thread the resume is driven against. It is excluded from every core as
   well, so resuming it leaves the execute list exactly as empty as it found
   it.  */

static TX_THREAD       thread_1;

static volatile ULONG  rescue_count =  0;
static ULONG           idle_resume_seen =  0;


/* Define thread prototypes.  */

static void    thread_0_entry(ULONG thread_input);
static void    thread_1_entry(ULONG thread_input);


/* Prototype for test control return.  */

void  test_control_return(UINT status);


/* Put the test thread's exclusion mask back, from interrupt context, once the
   core it was running on has gone idle. A null current thread on core 0 is the
   signal: the port leaves the interrupted thread in that entry for the whole of
   an interrupt, so it is empty only when the core had nothing running when the
   tick arrived.  */

static void  test_isr(void)
{

    if (_tx_thread_current_ptr[0] == TX_NULL)
    {

        if (thread_0.tx_thread_smp_cores_excluded != ((ULONG) 0))
        {

            (VOID) _tx_thread_smp_core_exclude(&thread_0, ((ULONG) 0));
            rescue_count++;
        }
    }
}


/* Empty this core's execute entry by excluding the running thread from every
   core. Preemption is held off by the caller, so the exclusion does not return
   to the system on its way out and the thread carries on running with nothing
   scheduled behind it.  */

static UINT  empty_the_execute_list(UINT core)
{

UINT    status;


    status =  _tx_thread_smp_core_exclude(&thread_0, ALL_CORES_EXCLUDED);

    if (status == TX_SUCCESS)
    {

        if (_tx_thread_execute_ptr[core] != TX_NULL)
        {

            status =  TX_NOT_DONE;
        }
    }

    return(status);
}


/* A resume that finds the core it runs on with nothing to execute. The whole
   arrangement is held under one SMP protection, so no tick and no other core
   observes it.  */

static UINT  pass_resume_with_idle_core(void)
{

TX_INTERRUPT_SAVE_AREA

UINT    core;
UINT    status;


    TX_DISABLE
    core =  tx_thread_smp_core_get();

    _tx_thread_preempt_disable++;

    status =  empty_the_execute_list(core);

    if (status == TX_SUCCESS)
    {

        /* The scratch thread is excluded from every core too, so the resume
           makes it ready and finds nowhere to put it. The core's execute entry
           is still empty when the resume reaches its own preemption check.  */
        status =  _tx_thread_resume(&thread_1);

        if (status == TX_SUCCESS)
        {

            if (_tx_thread_execute_ptr[core] == TX_NULL)
            {
                idle_resume_seen++;
            }

            status =  _tx_thread_suspend(&thread_1);
        }
    }

    if (_tx_thread_smp_core_exclude(&thread_0, ((ULONG) 0)) != TX_SUCCESS)
    {
        status =  TX_NOT_DONE;
    }

    _tx_thread_preempt_disable--;
    TX_RESTORE

    return(status);
}


/* A preemption check that finds the core it runs on with nothing to execute.
   It returns to the system, which is what the check is for, so the tick puts
   the thread back afterwards.  */

static UINT  pass_preempt_check_with_idle_core(void)
{

TX_INTERRUPT_SAVE_AREA

UINT    core;
UINT    attempt;
UINT    status =  TX_SUCCESS;
ULONG   rescues_before;
ULONG   wait;


    for (attempt = 0; attempt < PREEMPT_CHECK_ATTEMPTS; attempt++)
    {

        rescues_before =  rescue_count;

        TX_DISABLE
        core =  tx_thread_smp_core_get();
        _tx_thread_preempt_disable++;

        status =  empty_the_execute_list(core);

        _tx_thread_preempt_disable--;
        TX_RESTORE

        if (status != TX_SUCCESS)
        {
            break;
        }

        /* Give the core up. The check sees the core's current thread and its
           execute entry differ, picks the entry up, finds nothing there and
           returns to the system without a stack to check.  */
        _tx_thread_system_preempt_check();

        /* Back again, which only happens once the tick has put the mask
           back.  */
        wait =  0;

        while ((rescue_count == rescues_before) && (wait < RESCUE_TICK_LIMIT))
        {

            tx_thread_sleep(1);
            wait++;
        }

        if (rescue_count == rescues_before)
        {

            status =  TX_NOT_DONE;
            break;
        }
    }

    return(status);
}


/* Define what the initial system looks like.  */

#ifdef CTEST
void test_application_define(void *first_unused_memory)
#else
void    threadx_thread_idle_core_application_define(void *first_unused_memory)
#endif
{

UINT    status;
CHAR    *pointer;


    /* Put first available memory address into a character pointer.  */
    pointer =  (CHAR *) first_unused_memory;

    status =  tx_thread_create(&thread_0, "thread 0", thread_0_entry, 0,
            pointer, TEST_STACK_SIZE_PRINTF,
            TEST_PRIORITY, TEST_PRIORITY, TX_NO_TIME_SLICE, TX_AUTO_START);
    pointer =  pointer + TEST_STACK_SIZE_PRINTF;

    /* Check for status.  */
    if (status != TX_SUCCESS)
    {

        printf("Running Thread Idle Core Test...................................... ERROR #1\n");
        test_control_return(1);
    }

    status =  tx_thread_create(&thread_1, "thread 1", thread_1_entry, 1,
            pointer, TEST_STACK_SIZE_PRINTF,
            SCRATCH_PRIORITY, SCRATCH_PRIORITY, TX_NO_TIME_SLICE, TX_DONT_START);
    pointer =  pointer + TEST_STACK_SIZE_PRINTF;

    /* Check for status.  */
    if (status != TX_SUCCESS)
    {

        printf("Running Thread Idle Core Test...................................... ERROR #2\n");
        test_control_return(1);
    }

    /* Keep the scratch thread off every core, so that resuming it never gives
       the test thread's core something to execute.  */
    status =  tx_thread_smp_core_exclude(&thread_1, ALL_CORES_EXCLUDED);

    /* Check for status.  */
    if (status != TX_SUCCESS)
    {

        printf("Running Thread Idle Core Test...................................... ERROR #3\n");
        test_control_return(1);
    }
}


/* The scratch thread never runs.  */

static void    thread_1_entry(ULONG thread_input)
{

    while (1)
    {

        tx_thread_suspend(&thread_1);
    }
}


/* Define the test thread.  */

static void    thread_0_entry(ULONG thread_input)
{

    /* Increment thread 0 counter.  */
    thread_0_counter++;

    /* Inform user of success getting to this test.  */
    printf("Running Thread Idle Core Test...................................... ");

    /* Arm the rescue before anything gives a core up.  */
    test_isr_dispatch =  test_isr;

    if (pass_resume_with_idle_core() != TX_SUCCESS)
    {

        test_isr_dispatch =  TX_NULL;
        printf("ERROR #4\n");
        test_control_return(1);
    }

    if (idle_resume_seen == 0)
    {

        test_isr_dispatch =  TX_NULL;
        printf("ERROR #5\n");
        test_control_return(1);
    }

    if (pass_preempt_check_with_idle_core() != TX_SUCCESS)
    {

        test_isr_dispatch =  TX_NULL;
        printf("ERROR #6\n");
        test_control_return(1);
    }

    test_isr_dispatch =  TX_NULL;

    /* Every attempt gave the core up and was put back, so the check ran with an
       empty execute entry as many times as it was arranged.  */
    if (rescue_count < PREEMPT_CHECK_ATTEMPTS)
    {

        printf("ERROR #7\n");
        test_control_return(1);
    }

    /* Success!  */
    printf("SUCCESS!\n");
    test_control_return(0);
}
