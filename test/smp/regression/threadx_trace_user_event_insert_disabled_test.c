/***************************************************************************
 * Copyright (c) 2026 Eclipse ThreadX contributors
 *
 * This program and the accompanying materials are made available under the
 * terms of the MIT License which is available at
 * https://opensource.org/licenses/MIT.
 *
 * AI Disclosure: This file was largely AI-generated by Claude Code (Opus 5).
 * The AI-generated portions may be considered public domain (CC0-1.0)
 * and not subject to the project's licence. The human contributor has
 * reviewed and verified that the code is correct.
 *
 * SPDX-License-Identifier: MIT and CC0-1.0
 **************************************************************************/

/* This test takes the user event insert's own test of a trace buffer pointer
   the service checked a few instructions earlier.

   _tx_trace_user_event_insert tests _tx_trace_buffer_current_ptr and returns
   TX_NOT_DONE if it is null; the insert sits in the else, and the macro then
   reads the same variable into a local and tests it again. The second test's
   false arm is what this test reaches. On one core it cannot be reached at all:
   the two tests are a handful of instructions apart inside one protection, with
   nothing between them.

   On SMP it is an ordinary state of the running kernel, and no fault has to be
   invented to produce it. _tx_trace_disable is a published service that clears
   that pointer, and it takes no lock of any kind -- no interrupt lockout, no
   SMP protection. So a thread disabling tracing on one core while another core
   is inside the insert, past its own check and short of the macro's, clears the
   pointer under it. Nothing here is a state the kernel cannot reach; the test
   only makes it reach it often.

   The second thread writes the pointer directly rather than calling
   tx_trace_disable in a loop. That is the same store _tx_trace_disable performs
   -- the value written, the variable written and the absence of any lock are
   identical -- arriving without the service call and the matching enable around
   it, which is what makes the window come round often enough to be measured.
   The kernel is not modified and no symbol is replaced: both services run their
   own code from end to end.

   What the assertions below can and cannot establish is worth being plain
   about. They establish that the arrangement was live: that the two threads ran
   on different cores, that the writer's stores were visible to the service --
   some calls are refused by the service's own check, which only its stores can
   cause -- and that the insert ran the number of times it was asked to. They do
   not count how often the macro's own test saw the null, because nothing
   outside the macro can observe that. The branch is evidenced by the coverage
   report, which is what this test exists to move.

   The pass count is set from measurement rather than guessed, and the two
   machines it was measured on differ by the better part of a decimal order. A
   workstation took the arm 71, 110, 111 and 131 times in about 368,000 passes;
   seven runs on a shared CI runner took it 521, 529, 568, 863, 998, 1066 and
   1298 times over the same count, so the shared runner is the more parallel of
   the two and the workstation is the case to size for. At the count below the
   workstation takes it 49 to 132 times over three runs. A run that reaches it
   zero times is not a thing that happens, and a machine on which the two
   threads never overlap would fail the writer assertion below rather than pass
   while covering nothing.  */


#include   <stdio.h>
#include   "tx_api.h"
#define    TX_SOURCE_CODE
#define    TX_THREAD_SMP_SOURCE_CODE
#include   "tx_thread.h"
#include   "tx_trace.h"


#define TEST_PRIORITY               16

/* The core the writer is put on. Every thread in this suite is created mapped
   to core 0 alone and the test thread keeps that mapping, so excluding the
   writer from every core but this one leaves the test thread's core to it.  */

#define WRITER_CORE                 1

/* Passes through the service under test. See the note above on how this number
   was arrived at.  */

#define INSERT_PASSES               300000

/* Bounds, so that a step that never happens fails the test rather than hanging
   it.  */

#define SETTLE_TICKS_MAX            100

#define TRACE_BUFFER_SIZE           8192
#define TRACE_REGISTRY_ENTRIES      32


static unsigned long   thread_0_counter =  0;
static TX_THREAD       thread_0;
static TX_THREAD       writer_thread;

static UCHAR           trace_buffer[TRACE_BUFFER_SIZE];

/* 0 stand by, 1 write, 9 stop.  */
static volatile ULONG  writer_phase =    0;
static volatile ULONG  writer_started =  0;
static volatile ULONG  writer_core =     0xFFFFFFFFUL;
static volatile ULONG  writer_stores =   0;
static volatile ULONG  writer_done =     0;

static volatile ULONG  inserts_accepted = 0;
static volatile ULONG  inserts_refused =  0;


static void    thread_0_entry(ULONG thread_input);
static void    writer_thread_entry(ULONG thread_input);


/* Prototype for test control return.  */

void  test_control_return(UINT status);


/* The second core. It clears the buffer pointer and puts it straight back, which
   is the store _tx_trace_disable makes, without the lock nobody takes.  */

static void    writer_thread_entry(ULONG thread_input)
{

#ifdef TX_ENABLE_EVENT_TRACE
TX_TRACE_BUFFER_ENTRY   *saved;
#endif

    writer_core =     tx_thread_smp_core_get();
    writer_started =  1;

    /* Stand by until the test thread is ready. Sleeping here leaves the core to
       the rebalance while it settles.  */
    while (writer_phase == ((ULONG) 0))
    {

        tx_thread_sleep(1);
    }

#ifdef TX_ENABLE_EVENT_TRACE

    while (writer_phase == ((ULONG) 1))
    {

        saved =  _tx_trace_buffer_current_ptr;

        if (saved != TX_NULL)
        {

            _tx_trace_buffer_current_ptr =  TX_NULL;
            _tx_trace_buffer_current_ptr =  saved;
            writer_stores++;
        }
    }
#endif

    writer_done =  1;
}


static void    thread_0_entry(ULONG thread_input)
{

UINT    status;
ULONG   waited;
ULONG   i;


    /* Increment thread 0 counter.  */
    thread_0_counter++;

    /* Inform user of success getting to this test.  */
    printf("Running Trace User Event Insert Disabled Test..................... ");

    /* Let the writer run on a core of its own.  */
    status =  tx_thread_smp_core_exclude(&writer_thread,
                    ((((ULONG) 1) << TX_THREAD_SMP_MAX_CORES) - ((ULONG) 1)) &
                    (~(((ULONG) 1) << ((UINT) WRITER_CORE))));

    if (status != TX_SUCCESS)
    {

        printf("ERROR #2\n");
        test_control_return(1);
    }

    status =  tx_thread_resume(&writer_thread);

    if (status != TX_SUCCESS)
    {

        printf("ERROR #3\n");
        test_control_return(1);
    }

    /* Wait for the rebalance to map it to its core. It records the core it lands
       on and says so on the way in, so this is the arrangement arriving rather
       than a fixed number of ticks guessed at.  */
    waited =  0;

    while ((writer_started == ((ULONG) 0)) && (waited < SETTLE_TICKS_MAX))
    {

        tx_thread_sleep(1);
        waited++;
    }

    if (writer_started == ((ULONG) 0))
    {

        printf("ERROR #4\n");
        test_control_return(1);
    }

    /* Two threads on one core cannot race, so a run that put them together is a
       run that proves nothing and must fail rather than pass quietly.  */
    if (writer_core == (ULONG) tx_thread_smp_core_get())
    {

        printf("ERROR #5\n");
        test_control_return(1);
    }

#ifdef TX_ENABLE_EVENT_TRACE

    status =  tx_trace_enable(trace_buffer, sizeof(trace_buffer), TRACE_REGISTRY_ENTRIES);

    if (status != TX_SUCCESS)
    {

        printf("ERROR #6\n");
        test_control_return(1);
    }

    writer_phase =  1;

    for (i = ((ULONG) 0); i < ((ULONG) INSERT_PASSES); i++)
    {

        if (tx_trace_user_event_insert(TX_TRACE_USER_EVENT_START, 0, 0, 0, 0) == TX_SUCCESS)
        {

            inserts_accepted++;
        }
        else
        {

            inserts_refused++;
        }
    }

    writer_phase =  9;

    /* Wait for the writer to leave its loop, so nothing it does outlives this
       test.  */
    waited =  0;

    while ((writer_done == ((ULONG) 0)) && (waited < SETTLE_TICKS_MAX))
    {

        tx_thread_sleep(1);
        waited++;
    }

    if (writer_done == ((ULONG) 0))
    {

        printf("ERROR #7\n");
        test_control_return(1);
    }

    /* The writer's stores reached the service: the only thing that can make the
       service refuse a caller here is the pointer being null when it looks, and
       the only thing that nulls it is the writer.  */
    if ((writer_stores == ((ULONG) 0)) || (inserts_refused == ((ULONG) 0)))
    {

        printf("ERROR #8\n");
        test_control_return(1);
    }

    /* And the service ran the number of times it was asked to.  */
    if ((inserts_accepted + inserts_refused) != ((ULONG) INSERT_PASSES))
    {

        printf("ERROR #9\n");
        test_control_return(1);
    }

    /* Leave tracing off, so nothing after this test inherits it.  */
    status =  tx_trace_disable();

    if (status != TX_SUCCESS)
    {

        printf("ERROR #10\n");
        test_control_return(1);
    }

#else

    /* Without tracing compiled in the service is a stub that refuses every
       caller, and there is no window and nothing to write. Let the writer go.  */
    writer_phase =  9;

    waited =  0;

    while ((writer_done == ((ULONG) 0)) && (waited < SETTLE_TICKS_MAX))
    {

        tx_thread_sleep(1);
        waited++;
    }

    if (writer_done == ((ULONG) 0))
    {

        printf("ERROR #7\n");
        test_control_return(1);
    }
#endif

    /* Success!  */
    printf("SUCCESS!\n");
    test_control_return(0);
}


/* Define what the initial system looks like.  */

#ifdef CTEST
void test_application_define(void *first_unused_memory)
#else
void    threadx_trace_user_event_insert_disabled_application_define(void *first_unused_memory)
#endif
{

UINT    status;
CHAR   *pointer;


    /* Put first available memory address into a character pointer.  */
    pointer =  (CHAR *) first_unused_memory;

    status =  tx_thread_create(&thread_0, "thread 0", thread_0_entry, 0,
            pointer, TEST_STACK_SIZE_PRINTF,
            TEST_PRIORITY, TEST_PRIORITY, TX_NO_TIME_SLICE, TX_AUTO_START);
    pointer =  pointer + TEST_STACK_SIZE_PRINTF;

    /* Check for status.  */
    if (status != TX_SUCCESS)
    {

        printf("Running Trace User Event Insert Disabled Test..................... ERROR #1\n");
        test_control_return(1);
    }

    status =  tx_thread_create(&writer_thread, "writer thread", writer_thread_entry, 0,
            pointer, TEST_STACK_SIZE_PRINTF,
            TEST_PRIORITY, TEST_PRIORITY, TX_NO_TIME_SLICE, TX_DONT_START);
    pointer =  pointer + TEST_STACK_SIZE_PRINTF;

    /* Check for status.  */
    if (status != TX_SUCCESS)
    {

        printf("Running Trace User Event Insert Disabled Test..................... ERROR #1\n");
        test_control_return(1);
    }
}
