/***************************************************************************
 * Copyright (c) 2026 Eclipse ThreadX contributors
 *
 * This program and the accompanying materials are made available under the
 * terms of the MIT License which is available at
 * https://opensource.org/licenses/MIT.
 *
 * AI Disclosure: This file was largely AI-generated by Claude Code (Opus 5).
 * The AI-generated portions may be considered public domain (CC0-1.0)
 * and not subject to the project's licence. The human contributor has
 * reviewed and verified that the code is correct.
 *
 * SPDX-License-Identifier: MIT and CC0-1.0
 **************************************************************************/

/* This test drives the filtered arm of the two trace inserts the enable service
   writes.

   The enable sets every event enable bit near the top of its body and records
   two running events at the bottom of it, so from inside the enabling thread
   the inserts can only ever find their own event class enabled. The second
   insert can be reached with it disabled, because a buffer-full notification
   registered against a one-event buffer is called from inside the first insert
   and can filter the class before the second one runs - that is what
   threadx_trace_enable_trace_test does. The first insert has no such lever: it
   is the first insert there is.

   What SMP adds is another core, and what makes it an arrangement rather than a
   race is that the enable blocks. tx_trace_event_filter is a single unprotected
   read-modify-write of the enable bits and takes no lock of any kind, while the
   enable takes the SMP protection partway down its body, after it has set the
   bits and long before it reaches either insert. So a thread holding the
   protection on another core leaves the enable parked at its own TX_DISABLE
   with the bits already set, for as long as that thread wants. The filter
   thread below takes the protection first, waits for the bits, clears them and
   only then releases; the enable runs on to its inserts and finds the class
   gone.

   The other core has to be there first and does not have to win anything. An
   arrangement that only waited for the window rather than holding it open was
   built first and measured: it fails about one run in ten, and widening the
   window eightfold only takes that to about one in thirty, which is the
   signature of a race rather than of a window that needed to be longer.

   The test asserts the consequence rather than the timing. If the class was
   already clear when the enable reached its inserts, neither wrote an entry, so
   the buffer is still where the enable left it. The filter clears every class
   rather than only the one the inserts read, so that nothing else in the system
   can write an entry between the enable returning and the test thread reading
   the buffer - which is what makes that assertion a statement about these two
   inserts rather than about the tick.  */


#include   <stdio.h>
#include   "tx_api.h"
#define    TX_SOURCE_CODE
#define    TX_THREAD_SMP_SOURCE_CODE
#include   "tx_trace.h"
#include   "tx_thread.h"


static unsigned long   thread_0_counter =  0;
static TX_THREAD       thread_0;

/* The thread that holds the window open and clears the class, from a core of
   its own.  */

static TX_THREAD       filter_thread;

static ULONG           trace_buffer[1024];

#define TRACE_REGISTRY_ENTRIES      16

/* The core the filter thread is put on. Every thread in this suite is created
   mapped to core 0 alone and the test thread keeps that mapping, so excluding
   the filter thread from every core but this one leaves the test thread's core
   to itself.  */

#define FILTER_CORE                 1

/* Bounds on the two spins, so that a step that never happens fails the test
   rather than hanging it. Neither is a timing assumption: the filter thread is
   released by the enable setting the bits, and the enable is released by the
   filter thread giving the protection back, so each side waits on something the
   other side does rather than on a moment passing.  */

#define SPIN_CAP                    ((ULONG) 2000000000UL)

#define SETTLE_TICKS_MAX            100

static volatile ULONG  filter_armed =    0;
static volatile ULONG  filter_holding =  0;
static volatile ULONG  filter_applied =  0;
static volatile ULONG  filter_started =  0;
static ULONG           filter_core =     0xFFFFFFFFUL;


/* Define thread prototypes.  */

static void    thread_0_entry(ULONG thread_input);
static void    filter_thread_entry(ULONG thread_input);


/* Prototype for test control return.  */

void  test_control_return(UINT status);


/* Define what the initial system looks like.  */

#ifdef CTEST
void test_application_define(void *first_unused_memory)
#else
void    threadx_trace_enable_filtered_application_define(void *first_unused_memory)
#endif
{

UINT    status;
CHAR    *pointer;


    /* Put first available memory address into a character pointer.  */
    pointer =  (CHAR *) first_unused_memory;

    /* Put system definition stuff in here, e.g. thread creates and other assorted
       create information.  */
    status =  tx_thread_create(&thread_0, "thread 0", thread_0_entry, 1,
            pointer, TEST_STACK_SIZE_PRINTF,
            16, 16, TX_NO_TIME_SLICE, TX_AUTO_START);
    pointer =  pointer + TEST_STACK_SIZE_PRINTF;

    /* Check for status.  */
    if (status != TX_SUCCESS)
    {

        printf("Running Trace Enable Filtered Test................................. ERROR #1\n");
        test_control_return(1);
    }

    /* The filter thread is created stopped, at the test thread's own priority
       so that neither can preempt the other on a core they happen to share
       while the rebalance settles.  */
    status =  tx_thread_create(&filter_thread, "filter thread", filter_thread_entry, 0,
            pointer, TEST_STACK_SIZE_PRINTF,
            16, 16, TX_NO_TIME_SLICE, TX_DONT_START);
    pointer =  pointer + TEST_STACK_SIZE_PRINTF;

    /* Check for status.  */
    if (status != TX_SUCCESS)
    {

        printf("Running Trace Enable Filtered Test................................. ERROR #2\n");
        test_control_return(1);
    }
}


/* The thread that holds the window open and clears the class.  */

static void    filter_thread_entry(ULONG thread_input)
{

TX_INTERRUPT_SAVE_AREA

ULONG   spins;


    filter_core =     tx_thread_smp_core_get();
    filter_started =  1;

    /* Stand by until the test thread is ready. Sleeping here leaves the core to
       the rebalance while it settles, and it is the last kernel service this
       thread calls before it takes the protection.  */
    while (filter_armed == ((ULONG) 0))
    {

        tx_thread_sleep(1);
    }

#ifdef TX_ENABLE_EVENT_TRACE

    /* Take the protection. From here the enable can run as far as its own
       TX_DISABLE and no further, which is past the assignment this thread is
       waiting for and short of the inserts it is arranging for.  */
    TX_DISABLE

    filter_holding =  1;

    /* Wait for the enable to set every event bit. They are zero until the first
       enable in the process, so this edge is the assignment and nothing else. */
    spins =  0;

    while ((_tx_trace_event_enable_bits != 0xFFFFFFFFUL) && (spins < SPIN_CAP))
    {

        spins++;
    }

    if (_tx_trace_event_enable_bits == 0xFFFFFFFFUL)
    {

        tx_trace_event_filter(0xFFFFFFFFUL);
        filter_applied =  1;
    }

    /* Let the enable run on to its inserts.  */
    TX_RESTORE

#else

    /* Without tracing compiled in there is no window and nothing to clear.  */
    spins =           0;
    filter_holding =  1;
    filter_applied =  1;

#endif
}


/* Define the test thread.  */

static void    thread_0_entry(ULONG thread_input)
{

UINT    status;
UINT    test_core;
ULONG   waited;
#ifdef TX_ENABLE_EVENT_TRACE
TX_TRACE_BUFFER_ENTRY   *current_on_return;
TX_TRACE_BUFFER_ENTRY   *start_on_return;
#endif


    /* Increment thread 0 counter.  */
    thread_0_counter++;

    /* Inform user of success getting to this test.  */
    printf("Running Trace Enable Filtered Test................................. ");

    /* Let the filter thread run on a core of its own.  */
    status =  tx_thread_smp_core_exclude(&filter_thread,
                    ((((ULONG) 1) << TX_THREAD_SMP_MAX_CORES) - ((ULONG) 1)) &
                    (~(((ULONG) 1) << ((UINT) FILTER_CORE))));

    if (status != TX_SUCCESS)
    {

        printf("ERROR #3\n");
        test_control_return(1);
    }

    test_core =  tx_thread_smp_core_get();

    status =  tx_thread_resume(&filter_thread);

    if (status != TX_SUCCESS)
    {

        printf("ERROR #4\n");
        test_control_return(1);
    }

    /* Wait for the rebalance to map it to its core. It records the core it
       lands on and says so on the way in, so this is the arrangement arriving
       rather than a fixed number of ticks guessed at.  */
    waited =  0;

    while ((filter_started == ((ULONG) 0)) && (waited < SETTLE_TICKS_MAX))
    {

        tx_thread_sleep(1);
        waited++;
    }

    if (filter_started == ((ULONG) 0))
    {

        printf("ERROR #5\n");
        test_control_return(1);
    }

    if (filter_core == (ULONG) test_core)
    {

        printf("ERROR #6\n");
        test_control_return(1);
    }

    filter_armed =  1;

    /* Wait for the protection to be taken, by spinning rather than sleeping.
       Every kernel service takes the protection, so a sleep here would park
       this thread behind the filter thread while the filter thread waits for
       this thread to set the bits.  */
    waited =  0;

    while ((filter_holding == ((ULONG) 0)) && (waited < SPIN_CAP))
    {

        waited++;
    }

    if (filter_holding == ((ULONG) 0))
    {

        printf("ERROR #7\n");
        test_control_return(1);
    }

    status =  tx_trace_enable(trace_buffer, sizeof(trace_buffer), TRACE_REGISTRY_ENTRIES);

#ifdef TX_ENABLE_EVENT_TRACE

    /* Read the buffer position before anything else runs. Every service the
       test could call from here on writes an entry of its own, so a later read
       would be answering a different question.  */
    current_on_return =  _tx_trace_buffer_current_ptr;
    start_on_return =    _tx_trace_buffer_start_ptr;

#endif

#ifndef TX_ENABLE_EVENT_TRACE

    if (status != TX_FEATURE_NOT_ENABLED)
    {

        printf("ERROR #8\n");
        test_control_return(1);
    }

    printf("SUCCESS!\n");
    test_control_return(0);

#else

    if (status != TX_SUCCESS)
    {

        printf("ERROR #9\n");
        test_control_return(1);
    }

    if (filter_applied == ((ULONG) 0))
    {

        printf("ERROR #10\n");
        test_control_return(1);
    }

    if ((_tx_trace_event_enable_bits & ((ULONG) TX_TRACE_INTERNAL_EVENTS)) != ((ULONG) 0))
    {

        printf("ERROR #11\n");
        test_control_return(1);
    }

    /* The consequence, and the whole point of the arrangement: the class was
       already clear when the enable reached its two inserts, so neither wrote
       an entry and the buffer is still where the enable left it.  */
    if (current_on_return != start_on_return)
    {

        printf("ERROR #12\n");
        test_control_return(1);
    }

    /* The enable marks every entry invalid on its way through, and nothing has
       written one since.  */
    if (start_on_return -> tx_trace_buffer_entry_thread_pointer != ((ULONG) 0))
    {

        printf("ERROR #13\n");
        test_control_return(1);
    }

    status =  tx_trace_event_unfilter(0xFFFFFFFFUL);

    if (status != TX_SUCCESS)
    {

        printf("ERROR #14\n");
        test_control_return(1);
    }

    status =  tx_trace_disable();

    if (status != TX_SUCCESS)
    {

        printf("ERROR #15\n");
        test_control_return(1);
    }

    printf("SUCCESS!\n");
    test_control_return(0);

#endif
}
