/***************************************************************************
 * Copyright (c) 2026 Eclipse ThreadX contributors
 *
 * This program and the accompanying materials are made available under the
 * terms of the MIT License which is available at
 * https://opensource.org/licenses/MIT.
 *
 * AI Disclosure: This file was largely AI-generated by Claude Code (Opus 5.5).
 * The AI-generated portions may be considered public domain (CC0-1.0)
 * and not subject to the project's licence. The human contributor has
 * reviewed and verified that the code is correct.
 *
 * SPDX-License-Identifier: MIT and CC0-1.0
 **************************************************************************/

/* Runs a second simulated interrupt source beside the port's timer, the way the
   GUIX Win32 driver and application-defined interrupt threads do. Each source
   makes a solicited thread ready from _tx_thread_context_restore, so both wait
   for the scheduler's handoff at the same time. The test fails if either
   source stops waking its thread before both reach their target counts.  */

#include <stdio.h>
#include <windows.h>
#include "tx_api.h"


#define TEST_STACK_SIZE             4096
#define TEST_ISR_ITERATIONS         1000
#define TEST_TICK_WAKEUPS           500
#define TEST_STALL_MS               3000


static TX_THREAD        isr_wake_thread;
static TX_THREAD        tick_wake_thread;
static TX_THREAD        busy_thread;
static TX_SEMAPHORE     isr_semaphore;

static ULONG            isr_wake_stack[TEST_STACK_SIZE / sizeof(ULONG)];
static ULONG            tick_wake_stack[TEST_STACK_SIZE / sizeof(ULONG)];
static ULONG            busy_stack[TEST_STACK_SIZE / sizeof(ULONG)];

static volatile LONG    isr_count;
static volatile LONG    isr_wake_count;
static volatile LONG    tick_wake_count;
static volatile ULONG   busy_count;

static HANDLE           isr_start_event;

/* Read directly: a stalled port may hold the lock that tx_time_get takes.  */
extern volatile ULONG   _tx_timer_system_clock;


/* Simulated interrupt: wakes isr_wake_thread from outside ThreadX.  */
static DWORD WINAPI isr_source_entry(LPVOID parameter)
{
    (VOID) parameter;

    (VOID) WaitForSingleObject(isr_start_event, INFINITE);

    while (isr_count < TEST_ISR_ITERATIONS)
    {
        _tx_thread_context_save();
        (VOID) tx_semaphore_put(&isr_semaphore);
        _tx_thread_context_restore();

        (VOID) InterlockedIncrement(&isr_count);
        Sleep(1);
    }

    return 0;
}


/* Fails the test with the progress counters if either source stalls.  */
static DWORD WINAPI watchdog_entry(LPVOID parameter)
{
LONG    last_isr_wake_count;
LONG    last_tick_wake_count;

    (VOID) parameter;

    do
    {
        last_isr_wake_count =  isr_wake_count;
        last_tick_wake_count =  tick_wake_count;
        Sleep(TEST_STALL_MS);
    } while (((isr_wake_count != last_isr_wake_count) || (isr_wake_count >= TEST_ISR_ITERATIONS)) &&
             (tick_wake_count != last_tick_wake_count));

    printf("Running Windows simulator ISR handoff test.......................... ERROR!\n");
    printf("  ticks=%lu isr=%ld isr_wakeups=%ld tick_wakeups=%ld\n",
           _tx_timer_system_clock, isr_count, isr_wake_count, tick_wake_count);
    (VOID) fflush(stdout);
    (VOID) TerminateProcess(GetCurrentProcess(), 1);
    return 0;
}


static VOID isr_wake_entry(ULONG input)
{
    (VOID) input;

    while (1)
    {
        if (tx_semaphore_get(&isr_semaphore, TX_WAIT_FOREVER) == TX_SUCCESS)
        {
            (VOID) InterlockedIncrement(&isr_wake_count);
        }
    }
}


/* Woken by the timer on every tick; ends the test once both sources are done.  */
static VOID tick_wake_entry(ULONG input)
{
    (VOID) input;

    (VOID) SetEvent(isr_start_event);

    while (1)
    {
        tx_thread_sleep(1);
        (VOID) InterlockedIncrement(&tick_wake_count);

        if ((tick_wake_count >= TEST_TICK_WAKEUPS) &&
            (isr_count >= TEST_ISR_ITERATIONS) &&
            (isr_wake_count >= TEST_ISR_ITERATIONS))
        {
            printf("Running Windows simulator ISR handoff test.......................... SUCCESS!\n");
            exit(0);
        }
    }
}


/* Keeps a thread running so the timer also takes the preemption path.  */
static VOID busy_entry(ULONG input)
{
    (VOID) input;

    while (1)
    {
        busy_count++;
    }
}


VOID tx_application_define(VOID *first_unused_memory)
{
    (VOID) first_unused_memory;

    isr_start_event = CreateEvent(NULL, TRUE, FALSE, NULL);

    (VOID) tx_semaphore_create(&isr_semaphore, "isr semaphore", 0);
    (VOID) tx_thread_create(&isr_wake_thread, "isr wake", isr_wake_entry, 0,
                            isr_wake_stack, sizeof(isr_wake_stack), 5, 5, TX_NO_TIME_SLICE, TX_AUTO_START);
    (VOID) tx_thread_create(&tick_wake_thread, "tick wake", tick_wake_entry, 0,
                            tick_wake_stack, sizeof(tick_wake_stack), 6, 6, TX_NO_TIME_SLICE, TX_AUTO_START);
    (VOID) tx_thread_create(&busy_thread, "busy", busy_entry, 0,
                            busy_stack, sizeof(busy_stack), 20, 20, TX_NO_TIME_SLICE, TX_AUTO_START);

    if ((isr_start_event == NULL) ||
        (CreateThread(NULL, 0, isr_source_entry, NULL, 0, NULL) == NULL) ||
        (CreateThread(NULL, 0, watchdog_entry, NULL, 0, NULL) == NULL))
    {
        printf("Running Windows simulator ISR handoff test.......................... ERROR!\n");
        exit(1);
    }
}


int main(void)
{
    tx_kernel_enter();
    return 0;
}
