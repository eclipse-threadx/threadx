/***************************************************************************
 * Copyright (c) 2026 Eclipse ThreadX contributors
 *
 * This program and the accompanying materials are made available under the
 * terms of the MIT License which is available at
 * https://opensource.org/licenses/MIT.
 *
 * AI Disclosure: This file was largely AI-generated by Claude Code (Opus 5.5).
 * The AI-generated portions may be considered public domain (CC0-1.0)
 * and not subject to the project's licence. The human contributor has
 * reviewed and verified that the code is correct.
 *
 * SPDX-License-Identifier: MIT and CC0-1.0
 **************************************************************************/


/**************************************************************************/
/**************************************************************************/
/**                                                                       */
/** ThreadX Test                                                          */
/**                                                                       */
/**   Module Manager load bounds                                          */
/**                                                                       */
/**************************************************************************/
/**************************************************************************/

/* The Module Manager loads a module from an image whose preamble describes it: the size
   of its instruction area, the offsets or addresses of its entry functions, and the sizes
   of its data area and default thread stacks. Every one of those fields comes from the
   image. This test drives each loader with images whose preamble lies about them, and
   checks that the loader refuses before acting on the lie.

   Four things are checked.

   The length-checked loaders are given the image's length, and must refuse an image
   too short for its own preamble, or one whose declared instruction area runs past its
   end, before reading anything else. The image is placed so that its last byte is the
   last byte of a readable page and the next page is inaccessible: a loader that reads
   one byte too far takes a fault rather than returning, so the test cannot pass by
   reading past the image and then refusing.

   Every loader, old and new, must refuse entry functions that lie outside the module's
   instruction area, a missing callback function, an instruction area smaller than the
   preamble, and a preamble size larger than the instruction area.

   A preamble whose data or stack sizes overflow when the loader adds them up must be
   refused with the Module Manager's protection mutex released. The mutex here counts
   its owner, so a loader that returns holding it is caught at the next case.

   The file loader must not clear a module control block it is about to refuse as
   already loaded, and the in-place loader's alignment check must not release a mutex
   it does not hold.  */

#include <stdio.h>
#include <string.h>
#include <sys/mman.h>
#include <unistd.h>

#include "threadx_module_manager_host_test_port.h"

#include "tx_initialize.h"
#include "tx_thread.h"
#include "tx_timer.h"
#include "tx_queue.h"
#include "tx_event_flags.h"
#include "tx_semaphore.h"
#include "tx_mutex.h"
#include "tx_block_pool.h"
#include "tx_byte_pool.h"
#include "txm_module.h"
#include "txm_module_manager_util.h"


/* Define the stand-in interrupt lock the port shim counts through.  */

unsigned int    test_interrupt_disable_depth;
unsigned int    test_interrupt_disable_max_depth;
unsigned int    test_interrupt_restore_underflows;


/* Define the kernel and Module Manager state the sources under test link against.  */

volatile ULONG          _tx_thread_system_state;
TX_MUTEX                _txm_module_manager_mutex;
TX_BYTE_POOL            _txm_module_manager_byte_pool;
TX_BYTE_POOL            _txm_module_manager_object_pool;
UINT                    _txm_module_manager_object_pool_created;
TXM_MODULE_INSTANCE     *_txm_module_manager_loaded_list_ptr;
ULONG                   _txm_module_manger_loaded_count;
UINT                    _txm_module_manager_ready;
ULONG                   _txm_module_manager_properties_supported;
ULONG                   _txm_module_manager_properties_required;

TX_BLOCK_POOL           *_tx_block_pool_created_ptr;
ULONG                   _tx_block_pool_created_count;
TX_BYTE_POOL            *_tx_byte_pool_created_ptr;
ULONG                   _tx_byte_pool_created_count;
TX_EVENT_FLAGS_GROUP    *_tx_event_flags_created_ptr;
ULONG                   _tx_event_flags_created_count;
TX_MUTEX                *_tx_mutex_created_ptr;
ULONG                   _tx_mutex_created_count;
TX_QUEUE                *_tx_queue_created_ptr;
ULONG                   _tx_queue_created_count;
TX_SEMAPHORE            *_tx_semaphore_created_ptr;
ULONG                   _tx_semaphore_created_count;
TX_THREAD               *_tx_thread_created_ptr;
ULONG                   _tx_thread_created_count;
TX_TIMER                *_tx_timer_created_ptr;
ULONG                   _tx_timer_created_count;


static UINT     test_failures;
static ULONG    test_checks;


/* Record the outcome of one expectation.  */
static VOID  test_expect(const char *description, ULONG actual, ULONG expected)
{
    test_checks++;

    if (actual != expected)
    {
        printf("FAIL: %s (expected %lu, got %lu)\n", description, (unsigned long) expected, (unsigned long) actual);
        test_failures++;
    }
}


/* The protection mutex. It counts its owner, and counts a release by a caller that
   does not hold it, which the real mutex refuses with TX_NOT_OWNED.  */

static ULONG    test_mutex_depth;
static ULONG    test_mutex_unowned_puts;

UINT  _tx_mutex_get(TX_MUTEX *mutex_ptr, ULONG wait_option)
{
    (VOID) mutex_ptr;
    (VOID) wait_option;

    test_mutex_depth++;

    return(TX_SUCCESS);
}

UINT  _tx_mutex_put(TX_MUTEX *mutex_ptr)
{

UINT    status;


    (VOID) mutex_ptr;

    if (test_mutex_depth == ((ULONG) 0))
    {
        test_mutex_unowned_puts++;
        status =  TX_NOT_OWNED;
    }
    else
    {
        test_mutex_depth--;
        status =  TX_SUCCESS;
    }

    return(status);
}


/* The byte pool the loaders allocate code and data from: a bump allocator over a
   static arena, which can be told to refuse.  */

#define TEST_POOL_BYTES     ((ULONG) 8192)

static union
{
    ALIGN_TYPE  test_pool_alignment;
    UCHAR       test_pool_bytes[TEST_POOL_BYTES];
} test_pool;

static ULONG    test_pool_offset;
static ULONG    test_allocations;
static ULONG    test_releases;
static UINT     test_allocate_refuse;

UINT  _tx_byte_allocate(TX_BYTE_POOL *pool_ptr, VOID **memory_ptr, ULONG memory_size, ULONG wait_option)
{

ULONG   rounded_size;
UINT    status;


    (VOID) pool_ptr;
    (VOID) wait_option;

    rounded_size =  ((memory_size + ((ULONG) 7)) / ((ULONG) 8)) * ((ULONG) 8);

    if ((test_allocate_refuse != TX_FALSE) || (rounded_size > (TEST_POOL_BYTES - test_pool_offset)))
    {
        status =  TX_NO_MEMORY;
    }
    else
    {
        *memory_ptr =  (VOID *) &test_pool.test_pool_bytes[test_pool_offset];
        test_pool_offset =  test_pool_offset + rounded_size;
        test_allocations++;
        status =  TX_SUCCESS;
    }

    return(status);
}

UINT  _tx_byte_release(VOID *memory_ptr)
{
    (VOID) memory_ptr;

    test_releases++;

    return(TX_SUCCESS);
}


/* The port's alignment adjustment. The Cortex-M port's real adjustment rounds sizes
   up for its memory protection unit; none of that is under test, so this leaves the
   default alignments, except that a case can widen the data alignment to make the
   final allocation-size addition overflow.  */

static ULONG    test_data_alignment_override;

VOID  _txm_module_manager_alignment_adjust(TXM_MODULE_PREAMBLE *module_preamble, ULONG *code_size,
                                           ULONG *code_alignment, ULONG *data_size, ULONG *data_alignment)
{
    (VOID) module_preamble;
    (VOID) code_size;
    (VOID) code_alignment;
    (VOID) data_size;

    if (test_data_alignment_override != ((ULONG) 0))
    {
        *data_alignment =  test_data_alignment_override;
    }
}


/* The port's memory protection setup, which programs the module's code region from the
   instance. It records the region it is given.  */

static ULONG        test_setup_calls;
static ALIGN_TYPE   test_setup_code_start;
static ALIGN_TYPE   test_setup_code_end;

VOID  _txm_module_manager_mm_register_setup(TXM_MODULE_INSTANCE *module_instance)
{
    test_setup_calls++;
    test_setup_code_start =  (ALIGN_TYPE) module_instance -> txm_module_instance_code_start;
    test_setup_code_end =    (ALIGN_TYPE) module_instance -> txm_module_instance_code_end;
}


/* The module data check the utility source refers to. No case reaches it.  */

UINT  _txm_module_manager_inside_data_check(TXM_MODULE_INSTANCE *module_instance, ALIGN_TYPE obj_ptr, UINT obj_size)
{
    (VOID) module_instance;
    (VOID) obj_ptr;
    (VOID) obj_size;

    return(TX_FALSE);
}


/* The IPSR read the port's inline helpers make, which the system-state shim points
   here. Thread context.  */
unsigned int  test_get_ipsr_value(void)
{
    return(0U);
}


/* An in-memory file for the file loader.  */

static UCHAR    *test_file_data;
static ULONG    test_file_size;

UINT  fx_file_open(FX_MEDIA *media_ptr, FX_FILE *file_ptr, CHAR *file_name, UINT open_type)
{
    (VOID) media_ptr;
    (VOID) file_name;
    (VOID) open_type;

    file_ptr -> fx_file_offset =  0;

    return(FX_SUCCESS);
}

UINT  fx_file_read(FX_FILE *file_ptr, VOID *buffer_ptr, ULONG request_size, ULONG *actual_size)
{

ULONG   remaining;
ULONG   copy_size;


    remaining =  test_file_size - file_ptr -> fx_file_offset;
    copy_size =  (request_size < remaining) ? request_size : remaining;
    memcpy(buffer_ptr, &test_file_data[file_ptr -> fx_file_offset], copy_size);
    file_ptr -> fx_file_offset =  file_ptr -> fx_file_offset + copy_size;
    *actual_size =  copy_size;

    return(FX_SUCCESS);
}

UINT  fx_file_seek(FX_FILE *file_ptr, ULONG byte_offset)
{
    file_ptr -> fx_file_offset =  byte_offset;

    return(FX_SUCCESS);
}

UINT  fx_file_close(FX_FILE *file_ptr)
{
    (VOID) file_ptr;

    return(FX_SUCCESS);
}


/* The module images. Each image is built at the end of a readable page whose
   successor is inaccessible, so the byte after the image is unreadable.  */

#define TEST_IMAGE_BYTES        ((ULONG) 512)
#define TEST_SHELL_OFFSET       ((ULONG) 128)
#define TEST_START_OFFSET       ((ULONG) 132)
#define TEST_STOP_OFFSET        ((ULONG) 136)
#define TEST_CALLBACK_OFFSET    ((ULONG) 140)
#define TEST_PROPERTIES         (TXM_MODULE_RVDS_COMPILER | TXM_MODULE_USER_MODE | TXM_MODULE_MEMORY_PROTECTION)

static UCHAR    *test_guard_page;
static ULONG    test_page_bytes;

static union
{
    ALIGN_TYPE  test_data_alignment;
    UCHAR       test_data_bytes[256];
} test_absolute_data;

static TXM_MODULE_INSTANCE  test_instance;
static FX_MEDIA             test_media;


/* Return where an image of the given length must start for its last byte to be the
   last readable byte.  */
static UCHAR  *test_image_place(ULONG image_bytes)
{
    return(test_guard_page - image_bytes);
}


/* Build a well-formed module image of TEST_IMAGE_BYTES at the end of the readable page.
   The entry fields are offsets for the relative loaders, or absolute addresses when
   absolute is set.  */
static TXM_MODULE_PREAMBLE  *test_image_build(UINT absolute)
{

UCHAR                   *image;
TXM_MODULE_PREAMBLE     *preamble;
ULONG                   base;


    image =     test_image_place(TEST_IMAGE_BYTES);
    preamble =  (TXM_MODULE_PREAMBLE *) image;

    memset(image, 0, TEST_IMAGE_BYTES);

    base =  (absolute != TX_FALSE) ? (ULONG) (ALIGN_TYPE) image : ((ULONG) 0);

    preamble -> txm_module_preamble_id =                    TXM_MODULE_ID;
    preamble -> txm_module_preamble_preamble_size =         ((ULONG) sizeof(TXM_MODULE_PREAMBLE)) / ((ULONG) sizeof(ULONG));
    preamble -> txm_module_preamble_property_flags =        TEST_PROPERTIES;
    preamble -> txm_module_preamble_shell_entry_function =  base + TEST_SHELL_OFFSET;
    preamble -> txm_module_preamble_start_function =        base + TEST_START_OFFSET;
    preamble -> txm_module_preamble_stop_function =         base + TEST_STOP_OFFSET;
    preamble -> txm_module_preamble_callback_function =     base + TEST_CALLBACK_OFFSET;
    preamble -> txm_module_preamble_start_stop_priority =   ((ULONG) 10);
    preamble -> txm_module_preamble_start_stop_stack_size = ((ULONG) 256);
    preamble -> txm_module_preamble_callback_priority =     ((ULONG) 10);
    preamble -> txm_module_preamble_callback_stack_size =   ((ULONG) 256);
    preamble -> txm_module_preamble_code_size =             TEST_IMAGE_BYTES;
    preamble -> txm_module_preamble_data_size =             ((ULONG) 128);

    return(preamble);
}


/* Forget every module loaded so far, so each case starts from an empty manager.  */
static VOID  test_reset(VOID)
{
    memset(&test_instance, 0, sizeof(test_instance));
    _txm_module_manager_loaded_list_ptr =  TX_NULL;
    _txm_module_manger_loaded_count =      ((ULONG) 0);
    test_pool_offset =                     ((ULONG) 0);
    test_allocate_refuse =                 TX_FALSE;
    test_data_alignment_override =         ((ULONG) 0);
    test_setup_calls =                     ((ULONG) 0);
}


/* The loaders under test, called uniformly. The length-checked loaders are given the
   full image length.  */

#define TEST_LOADER_IN_PLACE            0U
#define TEST_LOADER_IN_PLACE_EXT        1U
#define TEST_LOADER_MEMORY              2U
#define TEST_LOADER_MEMORY_EXT          3U
#define TEST_LOADER_FILE                4U
#define TEST_LOADER_ABSOLUTE            5U
#define TEST_LOADER_ABSOLUTE_EXTENDED   6U
#define TEST_LOADER_ABSOLUTE_EXT        7U
#define TEST_LOADER_COUNT               8U

static const char * const   test_loader_names[TEST_LOADER_COUNT] =
{
    "in_place_load", "in_place_load_ext", "memory_load", "memory_load_ext",
    "file_load", "absolute_load", "absolute_load_extended", "absolute_load_ext"
};

static UINT  test_loader_is_absolute(UINT loader)
{
    return((loader >= TEST_LOADER_ABSOLUTE) ? TX_TRUE : TX_FALSE);
}

static UINT  test_load(UINT loader, ULONG image_bytes)
{

UCHAR   *image;
UINT    status;


    image =  test_image_place(image_bytes);

    switch (loader)
    {
    case TEST_LOADER_IN_PLACE:
        status =  _txm_module_manager_in_place_load(&test_instance, "module", image);
        break;
    case TEST_LOADER_IN_PLACE_EXT:
        status =  _txm_module_manager_in_place_load_ext(&test_instance, "module", image, image_bytes);
        break;
    case TEST_LOADER_MEMORY:
        status =  _txm_module_manager_memory_load(&test_instance, "module", image);
        break;
    case TEST_LOADER_MEMORY_EXT:
        status =  _txm_module_manager_memory_load_ext(&test_instance, "module", image, image_bytes);
        break;
    case TEST_LOADER_FILE:
        test_file_data =  image;
        test_file_size =  image_bytes;
        status =  _txm_module_manager_file_load(&test_instance, "module", &test_media, "module.bin");
        break;
    case TEST_LOADER_ABSOLUTE:
        status =  _txm_module_manager_absolute_load(&test_instance, "module", image);
        break;
    case TEST_LOADER_ABSOLUTE_EXTENDED:
        status =  _txm_module_manager_absolute_load_extended(&test_instance, "module", image, (VOID *) &test_absolute_data);
        break;
    default:
        status =  _txm_module_manager_absolute_load_ext(&test_instance, "module", image, image_bytes, (VOID *) &test_absolute_data);
        break;
    }

    return(status);
}


/* The absolute loader without a data location refuses memory protection, so its
   images are built without it.  */
static VOID  test_properties_for(UINT loader, TXM_MODULE_PREAMBLE *preamble)
{
    if (loader == TEST_LOADER_ABSOLUTE)
    {
        preamble -> txm_module_preamble_property_flags =  TXM_MODULE_RVDS_COMPILER;
    }
}


/* Load once and check the status and that the mutex is free afterwards.  */
static VOID  test_load_expect(UINT loader, ULONG image_bytes, UINT expected, const char *what)
{

char    description[200];
UINT    status;


    status =  test_load(loader, image_bytes);

    snprintf(description, sizeof(description), "%s: %s", test_loader_names[loader], what);
    test_expect(description, (ULONG) status, (ULONG) expected);

    snprintf(description, sizeof(description), "%s: %s leaves the mutex free", test_loader_names[loader], what);
    test_expect(description, test_mutex_depth, ((ULONG) 0));
}


int  main(void)
{

TXM_MODULE_PREAMBLE     *preamble;
UCHAR                   *mapping;
UCHAR                   *image;
ULONG                   base;
UINT                    loader;
UINT                    status;
ULONG                   saved_id;
char                    description[200];


    /* Map two pages and make the second inaccessible.  */
    test_page_bytes =  (ULONG) sysconf(_SC_PAGESIZE);
    mapping =  (UCHAR *) mmap(NULL, (size_t) (test_page_bytes * ((ULONG) 2)), PROT_READ | PROT_WRITE,
                              MAP_PRIVATE | MAP_ANONYMOUS, -1, 0);
    if ((mapping == (UCHAR *) MAP_FAILED) ||
        (mprotect(mapping + test_page_bytes, (size_t) test_page_bytes, PROT_NONE) != 0))
    {
        printf("ERROR: could not map the guard page\n");
        return(1);
    }
    test_guard_page =  mapping + test_page_bytes;

    _txm_module_manager_ready =                 TX_TRUE;
    _txm_module_manager_properties_supported =  TXM_MODULE_USER_MODE | TXM_MODULE_MEMORY_PROTECTION | TXM_MODULE_SHARED_EXTERNAL_MEMORY_ACCESS;
    _txm_module_manager_properties_required =   ((ULONG) 0);


    /**********************************************************************/
    /* Well-formed images load through every loader.                      */
    /**********************************************************************/

    for (loader = 0U; loader < TEST_LOADER_COUNT; loader++)
    {
        test_reset();
        preamble =  test_image_build(test_loader_is_absolute(loader));
        test_properties_for(loader, preamble);
        test_load_expect(loader, TEST_IMAGE_BYTES, TX_SUCCESS, "a well-formed image loads");

        base =  (ULONG) (ALIGN_TYPE) test_instance.txm_module_instance_code_start;
        snprintf(description, sizeof(description), "%s: the shell entry is where the preamble puts it", test_loader_names[loader]);
        test_expect(description, (ULONG) (ALIGN_TYPE) test_instance.txm_module_instance_shell_entry_function, base + TEST_SHELL_OFFSET);
        snprintf(description, sizeof(description), "%s: the callback entry is where the preamble puts it", test_loader_names[loader]);
        test_expect(description, (ULONG) (ALIGN_TYPE) test_instance.txm_module_instance_callback_request_thread_entry, base + TEST_CALLBACK_OFFSET);
        snprintf(description, sizeof(description), "%s: the stop entry is where the preamble puts it", test_loader_names[loader]);
        test_expect(description, (ULONG) (ALIGN_TYPE) test_instance.txm_module_instance_stop_thread_entry, base + TEST_STOP_OFFSET);

        /* A module without a stop function still loads, with no stop entry.  */
        test_reset();
        preamble =  test_image_build(test_loader_is_absolute(loader));
        test_properties_for(loader, preamble);
        preamble -> txm_module_preamble_stop_function =  ((ULONG) 0);
        test_load_expect(loader, TEST_IMAGE_BYTES, TX_SUCCESS, "an image without a stop function loads");
        snprintf(description, sizeof(description), "%s: ...and has no stop entry", test_loader_names[loader]);
        test_expect(description, (ULONG) (ALIGN_TYPE) test_instance.txm_module_instance_stop_thread_entry, ((ULONG) 0));

        /* Entries at the last byte of the instruction area are inside it.  */
        test_reset();
        preamble =  test_image_build(test_loader_is_absolute(loader));
        test_properties_for(loader, preamble);
        base =  (test_loader_is_absolute(loader) != TX_FALSE) ? (ULONG) (ALIGN_TYPE) test_image_place(TEST_IMAGE_BYTES) : ((ULONG) 0);
        preamble -> txm_module_preamble_shell_entry_function =  base + (TEST_IMAGE_BYTES - ((ULONG) 1));
        preamble -> txm_module_preamble_start_function =        base + (TEST_IMAGE_BYTES - ((ULONG) 1));
        preamble -> txm_module_preamble_stop_function =         base + (TEST_IMAGE_BYTES - ((ULONG) 1));
        preamble -> txm_module_preamble_callback_function =     base + (TEST_IMAGE_BYTES - ((ULONG) 1));
        test_load_expect(loader, TEST_IMAGE_BYTES, TX_SUCCESS, "entries at the last code byte load");
    }


    /* The port adjusts each entry offset by an amount that depends on the compiler that
       built the module. The bound applies to the adjusted address.  */
    {
        static const ULONG  compilers[2] = { TXM_MODULE_IAR_COMPILER, TXM_MODULE_GNU_COMPILER };
        UINT    compiler;

        for (compiler = 0U; compiler < 2U; compiler++)
        {
            test_reset();
            preamble =  test_image_build(TX_FALSE);
            preamble -> txm_module_preamble_property_flags =  compilers[compiler] | TXM_MODULE_USER_MODE | TXM_MODULE_MEMORY_PROTECTION;
            test_load_expect(TEST_LOADER_IN_PLACE, TEST_IMAGE_BYTES, TX_SUCCESS, "an image from another compiler loads");
            base =  (ULONG) (ALIGN_TYPE) test_instance.txm_module_instance_code_start;
            test_expect("...with its shell entry adjusted for its compiler",
                        (ULONG) (ALIGN_TYPE) test_instance.txm_module_instance_shell_entry_function, base + TEST_SHELL_OFFSET + ((ULONG) TXM_MODULE_GNU_SHELL_ADJUST));

            /* An offset inside the code that the adjustment carries past its end.  */
            test_reset();
            preamble =  test_image_build(TX_FALSE);
            preamble -> txm_module_preamble_property_flags =  compilers[compiler] | TXM_MODULE_USER_MODE | TXM_MODULE_MEMORY_PROTECTION;
            preamble -> txm_module_preamble_callback_function =  TEST_IMAGE_BYTES - ((ULONG) 4);
            test_load_expect(TEST_LOADER_IN_PLACE, TEST_IMAGE_BYTES, TXM_MODULE_INVALID, "an entry the compiler adjustment carries past the code is refused");
        }
    }


    /**********************************************************************/
    /* Entry functions outside the instruction area are refused.          */
    /**********************************************************************/

    for (loader = 0U; loader < TEST_LOADER_COUNT; loader++)
    {
        static const char * const  entry_names[4] = { "shell", "start", "stop", "callback" };
        UINT    entry;
        UINT    variant;

        for (entry = 0U; entry < 4U; entry++)
        {
            for (variant = 0U; variant < 3U; variant++)
            {
                ULONG   value;
                ULONG   *field;

                test_reset();
                preamble =  test_image_build(test_loader_is_absolute(loader));
                test_properties_for(loader, preamble);
                base =  (test_loader_is_absolute(loader) != TX_FALSE) ? (ULONG) (ALIGN_TYPE) test_image_place(TEST_IMAGE_BYTES) : ((ULONG) 0);

                /* One past the area, far past it so the address wraps, and before it.  */
                if (variant == 0U)
                {
                    value =  base + TEST_IMAGE_BYTES;
                }
                else if (variant == 1U)
                {
                    value =  base + ((ULONG) 0xFFFFFFF0UL);
                }
                else
                {
                    value =  (test_loader_is_absolute(loader) != TX_FALSE) ? (base - ((ULONG) 4)) : ((ULONG) 0xFFFFFFFCUL);
                }

                field =  (entry == 0U) ? &preamble -> txm_module_preamble_shell_entry_function :
                         (entry == 1U) ? &preamble -> txm_module_preamble_start_function :
                         (entry == 2U) ? &preamble -> txm_module_preamble_stop_function :
                                         &preamble -> txm_module_preamble_callback_function;
                *field =  value;

                snprintf(description, sizeof(description), "a %s entry outside the code (case %u) is refused", entry_names[entry], variant);
                test_load_expect(loader, TEST_IMAGE_BYTES, TXM_MODULE_INVALID, description);
                snprintf(description, sizeof(description), "%s: ...and no module is left loaded", test_loader_names[loader]);
                test_expect(description, _txm_module_manger_loaded_count, ((ULONG) 0));
            }
        }

        /* The callback thread is always created, so a missing callback entry is refused.  */
        test_reset();
        preamble =  test_image_build(test_loader_is_absolute(loader));
        test_properties_for(loader, preamble);
        preamble -> txm_module_preamble_callback_function =  ((ULONG) 0);
        test_load_expect(loader, TEST_IMAGE_BYTES, TXM_MODULE_INVALID, "a missing callback entry is refused");
    }


    /**********************************************************************/
    /* The instruction area must hold the preamble.                       */
    /**********************************************************************/

    for (loader = 0U; loader < TEST_LOADER_COUNT; loader++)
    {
        /* A code size smaller than the preamble. The image itself is full size, so only
           the declared size is wrong.  */
        test_reset();
        preamble =  test_image_build(test_loader_is_absolute(loader));
        test_properties_for(loader, preamble);
        preamble -> txm_module_preamble_code_size =  ((ULONG) sizeof(TXM_MODULE_PREAMBLE)) - ((ULONG) 4);
        test_load_expect(loader, TEST_IMAGE_BYTES, TXM_MODULE_INVALID, "a code size smaller than the preamble is refused");

        /* The copying loaders refuse it before allocating, since the copy would not hold
           the preamble the load goes on to read.  */
        snprintf(description, sizeof(description), "%s: ...before allocating", test_loader_names[loader]);
        test_expect(description, test_pool_offset, ((ULONG) 0));

        /* The same, with the entries moved inside the smaller code area, so that the size
           itself is what is refused.  */
        test_reset();
        preamble =  test_image_build(test_loader_is_absolute(loader));
        test_properties_for(loader, preamble);
        base =  (test_loader_is_absolute(loader) != TX_FALSE) ? (ULONG) (ALIGN_TYPE) test_image_place(TEST_IMAGE_BYTES) : ((ULONG) 0);
        preamble -> txm_module_preamble_shell_entry_function =  base + ((ULONG) 64);
        preamble -> txm_module_preamble_start_function =        base + ((ULONG) 68);
        preamble -> txm_module_preamble_stop_function =         base + ((ULONG) 72);
        preamble -> txm_module_preamble_callback_function =     base + ((ULONG) 76);
        preamble -> txm_module_preamble_code_size =  ((ULONG) sizeof(TXM_MODULE_PREAMBLE)) - ((ULONG) 4);
        test_load_expect(loader, TEST_IMAGE_BYTES, TXM_MODULE_INVALID, "a code size smaller than the preamble, entries inside it, is refused");

        /* A preamble size larger than the code.  */
        test_reset();
        preamble =  test_image_build(test_loader_is_absolute(loader));
        test_properties_for(loader, preamble);
        preamble -> txm_module_preamble_preamble_size =  (TEST_IMAGE_BYTES / ((ULONG) sizeof(ULONG))) + ((ULONG) 1);
        test_load_expect(loader, TEST_IMAGE_BYTES, TXM_MODULE_INVALID, "a preamble size larger than the code is refused");
    }


    /**********************************************************************/
    /* The length-checked loaders refuse an image shorter than it claims. */
    /**********************************************************************/

    for (loader = TEST_LOADER_IN_PLACE_EXT; loader < TEST_LOADER_COUNT; loader++)
    {
        if ((loader != TEST_LOADER_IN_PLACE_EXT) && (loader != TEST_LOADER_MEMORY_EXT) && (loader != TEST_LOADER_ABSOLUTE_EXT))
        {
            continue;
        }

        /* An image shorter than a preamble: the image's last byte is the last readable
           byte, so reading the whole preamble would fault.  */
        test_reset();
        image =  test_image_place(((ULONG) sizeof(TXM_MODULE_PREAMBLE)) - ((ULONG) 8));
        memset(image, 0, ((ULONG) sizeof(TXM_MODULE_PREAMBLE)) - ((ULONG) 8));
        test_load_expect(loader, ((ULONG) sizeof(TXM_MODULE_PREAMBLE)) - ((ULONG) 8), TXM_MODULE_INVALID, "an image shorter than a preamble is refused");
        snprintf(description, sizeof(description), "%s: ...without allocating", test_loader_names[loader]);
        test_expect(description, test_pool_offset, ((ULONG) 0));

        /* An image that ends before the preamble's code size field. Reading that field
           to compare it with the length would itself fault.  */
        test_reset();
        image =  test_image_place((ULONG) 32);
        memset(image, 0, (ULONG) 32);
        test_load_expect(loader, (ULONG) 32, TXM_MODULE_INVALID, "an image ending before its code size field is refused");

        /* An image whose declared code runs one byte past its end. The preamble is
           built at the start of an image one byte shorter than its code size.  */
        test_reset();
        image =  test_image_place(TEST_IMAGE_BYTES - ((ULONG) 1));
        preamble =  test_image_build(test_loader_is_absolute(loader));
        memmove(image, preamble, TEST_IMAGE_BYTES - ((ULONG) 1));
        preamble =  (TXM_MODULE_PREAMBLE *) image;
        if (test_loader_is_absolute(loader) != TX_FALSE)
        {
            base =  (ULONG) (ALIGN_TYPE) image;
            preamble -> txm_module_preamble_shell_entry_function =  base + TEST_SHELL_OFFSET;
            preamble -> txm_module_preamble_start_function =        base + TEST_START_OFFSET;
            preamble -> txm_module_preamble_stop_function =         base + TEST_STOP_OFFSET;
            preamble -> txm_module_preamble_callback_function =     base + TEST_CALLBACK_OFFSET;
        }
        test_load_expect(loader, TEST_IMAGE_BYTES - ((ULONG) 1), TXM_MODULE_INVALID, "code one byte past the image is refused");
        snprintf(description, sizeof(description), "%s: ...without allocating", test_loader_names[loader]);
        test_expect(description, test_pool_offset, ((ULONG) 0));

        /* A null image.  */
        test_reset();
        switch (loader)
        {
        case TEST_LOADER_IN_PLACE_EXT:
            status =  _txm_module_manager_in_place_load_ext(&test_instance, "module", TX_NULL, TEST_IMAGE_BYTES);
            break;
        case TEST_LOADER_MEMORY_EXT:
            status =  _txm_module_manager_memory_load_ext(&test_instance, "module", TX_NULL, TEST_IMAGE_BYTES);
            break;
        default:
            status =  _txm_module_manager_absolute_load_ext(&test_instance, "module", TX_NULL, TEST_IMAGE_BYTES, (VOID *) &test_absolute_data);
            break;
        }
        snprintf(description, sizeof(description), "%s: a null image is refused", test_loader_names[loader]);
        test_expect(description, (ULONG) status, (ULONG) TX_PTR_ERROR);

        /* The protected code region handed to the port never extends past the image.  */
        test_reset();
        (VOID) test_image_build(test_loader_is_absolute(loader));
        test_load_expect(loader, TEST_IMAGE_BYTES, TX_SUCCESS, "an exact-length image loads");
        snprintf(description, sizeof(description), "%s: ...and the protected code region is programmed", test_loader_names[loader]);
        test_expect(description, test_setup_calls, ((ULONG) 1));
        if (loader != TEST_LOADER_MEMORY_EXT)
        {
            snprintf(description, sizeof(description), "%s: ...ending at the image's last byte", test_loader_names[loader]);
            test_expect(description, (ULONG) test_setup_code_end, (ULONG) (ALIGN_TYPE) (test_guard_page - 1));
        }
    }


    /**********************************************************************/
    /* Overflowing sizes are refused with the mutex released.             */
    /**********************************************************************/

    for (loader = 0U; loader < TEST_LOADER_COUNT; loader++)
    {
        UINT    field;

        for (field = 0U; field < 3U; field++)
        {
            test_reset();
            preamble =  test_image_build(test_loader_is_absolute(loader));
            test_properties_for(loader, preamble);
            if (field == 0U)
            {
                preamble -> txm_module_preamble_data_size =  (ULONG) 0xFFFFFFFEUL;
            }
            else if (field == 1U)
            {
                preamble -> txm_module_preamble_start_stop_stack_size =  (ULONG) 0xFFFFFFFEUL;
            }
            else
            {
                preamble -> txm_module_preamble_callback_stack_size =  (ULONG) 0xFFFFFFFEUL;
            }
            snprintf(description, sizeof(description), "an overflowing size (field %u) is refused", field);
            test_load_expect(loader, TEST_IMAGE_BYTES, TXM_MODULE_MATH_OVERFLOW, description);
        }

        /* Sizes that each fit but whose sum does not.  */
        test_reset();
        preamble =  test_image_build(test_loader_is_absolute(loader));
        test_properties_for(loader, preamble);
        preamble -> txm_module_preamble_data_size =             (ULONG) 0x7FFFFFF0UL;
        preamble -> txm_module_preamble_start_stop_stack_size = (ULONG) 0x80000000UL;
        preamble -> txm_module_preamble_callback_stack_size =   (ULONG) 0x80000000UL;
        test_load_expect(loader, TEST_IMAGE_BYTES, TXM_MODULE_MATH_OVERFLOW, "sizes whose sum overflows are refused");

        /* Sizes whose sum fits until the stack sizes are added, for the absolute
           loader, whose sum excludes the data size.  */
        test_reset();
        preamble =  test_image_build(test_loader_is_absolute(loader));
        test_properties_for(loader, preamble);
        preamble -> txm_module_preamble_data_size =             (ULONG) 0x10UL;
        preamble -> txm_module_preamble_start_stop_stack_size = (ULONG) 0xFFFFFFF0UL;
        preamble -> txm_module_preamble_callback_stack_size =   (ULONG) 0x10UL;
        test_load_expect(loader, TEST_IMAGE_BYTES, TXM_MODULE_MATH_OVERFLOW, "stack sizes whose sum overflows are refused");

        /* A data alignment wide enough that the final allocation size overflows. An
           absolute load given a data location refuses that location's alignment first.  */
        test_reset();
        preamble =  test_image_build(test_loader_is_absolute(loader));
        test_properties_for(loader, preamble);
        test_data_alignment_override =  (ULONG) 0xFFFFFF00UL;
        test_load_expect(loader, TEST_IMAGE_BYTES,
                         ((loader == TEST_LOADER_ABSOLUTE_EXTENDED) || (loader == TEST_LOADER_ABSOLUTE_EXT)) ? TXM_MODULE_ALIGNMENT_ERROR : TXM_MODULE_MATH_OVERFLOW,
                         "an allocation size that overflows is refused");

        /* An allocation the pool refuses.  */
        test_reset();
        preamble =  test_image_build(test_loader_is_absolute(loader));
        test_properties_for(loader, preamble);
        test_allocate_refuse =  TX_TRUE;
        test_load_expect(loader, TEST_IMAGE_BYTES, TX_NO_MEMORY, "a refused allocation is reported");
    }

    /* A code size whose rounding overflows, for the absolute loader, which computes its
       code alignment while holding the mutex.  */
    test_reset();
    preamble =  test_image_build(TX_TRUE);
    preamble -> txm_module_preamble_code_size =  (ULONG) 0xFFFFFFFEUL;
    test_load_expect(TEST_LOADER_ABSOLUTE_EXTENDED, TEST_IMAGE_BYTES, TXM_MODULE_MATH_OVERFLOW, "a code size whose rounding overflows is refused");


    /**********************************************************************/
    /* The loaders' remaining refusals keep the mutex balanced.           */
    /**********************************************************************/

    for (loader = 0U; loader < TEST_LOADER_COUNT; loader++)
    {
        test_reset();
        preamble =  test_image_build(test_loader_is_absolute(loader));
        test_properties_for(loader, preamble);
        preamble -> txm_module_preamble_id =  ((ULONG) 0);
        test_load_expect(loader, TEST_IMAGE_BYTES, TXM_MODULE_INVALID, "a bad module id is refused");

        test_reset();
        preamble =  test_image_build(test_loader_is_absolute(loader));
        test_properties_for(loader, preamble);
        preamble -> txm_module_preamble_property_flags =  TXM_MODULE_RVDS_COMPILER | TXM_MODULE_MEMORY_PROTECTION;
        test_load_expect(loader, TEST_IMAGE_BYTES, TXM_MODULE_INVALID_PROPERTIES, "memory protection without user mode is refused");

        test_reset();
        preamble =  test_image_build(test_loader_is_absolute(loader));
        test_properties_for(loader, preamble);
        preamble -> txm_module_preamble_shell_entry_function =  ((ULONG) 0);
        test_load_expect(loader, TEST_IMAGE_BYTES, TXM_MODULE_INVALID, "a missing shell entry is refused");

        test_reset();
        preamble =  test_image_build(test_loader_is_absolute(loader));
        test_properties_for(loader, preamble);
        preamble -> txm_module_preamble_start_stop_stack_size =  ((ULONG) 0);
        test_load_expect(loader, TEST_IMAGE_BYTES, TXM_MODULE_INVALID, "a zero stack size is refused");

        test_reset();
        preamble =  test_image_build(test_loader_is_absolute(loader));
        test_properties_for(loader, preamble);
        preamble -> txm_module_preamble_callback_stack_size =  ((ULONG) 0);
        test_load_expect(loader, TEST_IMAGE_BYTES, TXM_MODULE_INVALID, "a zero callback stack size is refused");

        test_reset();
        preamble =  test_image_build(test_loader_is_absolute(loader));
        test_properties_for(loader, preamble);
        preamble -> txm_module_preamble_start_function =  ((ULONG) 0);
        test_load_expect(loader, TEST_IMAGE_BYTES, TXM_MODULE_INVALID, "a missing start entry is refused");
    }

    /* The relative loaders also refuse a zero data size; the absolute loader accepts it.  */
    for (loader = 0U; loader < TEST_LOADER_COUNT; loader++)
    {
        test_reset();
        preamble =  test_image_build(test_loader_is_absolute(loader));
        test_properties_for(loader, preamble);
        preamble -> txm_module_preamble_data_size =  ((ULONG) 0);
        test_load_expect(loader, TEST_IMAGE_BYTES, (test_loader_is_absolute(loader) != TX_FALSE) ? TX_SUCCESS : TXM_MODULE_INVALID,
                         "a zero data size is handled");
    }

    /* The internal load refuses before taking the mutex when called from the wrong
       context or before the manager is ready.  */
    test_reset();
    (VOID) test_image_build(TX_FALSE);
    _txm_module_manager_ready =  TX_FALSE;
    test_load_expect(TEST_LOADER_IN_PLACE, TEST_IMAGE_BYTES, TX_NOT_AVAILABLE, "a load before the manager is ready is refused");
    _txm_module_manager_ready =  TX_TRUE;
    _tx_thread_system_state =  ((ULONG) 1);
    test_load_expect(TEST_LOADER_IN_PLACE, TEST_IMAGE_BYTES, TX_CALLER_ERROR, "a load from an interrupt is refused");
    _tx_thread_system_state =  TX_INITIALIZE_IN_PROGRESS;
    test_load_expect(TEST_LOADER_IN_PLACE, TEST_IMAGE_BYTES, TX_SUCCESS, "a load during initialization is accepted");
    _tx_thread_system_state =  ((ULONG) 0);
    test_reset();
    status =  _txm_module_manager_in_place_load(TX_NULL, "module", test_image_place(TEST_IMAGE_BYTES));
    test_expect("in_place_load: a null instance is refused", (ULONG) status, (ULONG) TX_PTR_ERROR);


    /**********************************************************************/
    /* An already-loaded module is refused and left intact.               */
    /**********************************************************************/

    for (loader = 0U; loader < TEST_LOADER_COUNT; loader++)
    {
        test_reset();
        preamble =  test_image_build(test_loader_is_absolute(loader));
        test_properties_for(loader, preamble);
        test_load_expect(loader, TEST_IMAGE_BYTES, TX_SUCCESS, "a first load succeeds");
        saved_id =  test_instance.txm_module_instance_id;

        test_load_expect(loader, TEST_IMAGE_BYTES, TXM_MODULE_ALREADY_LOADED, "a second load of the same instance is refused");
        snprintf(description, sizeof(description), "%s: ...and the loaded control block keeps its id", test_loader_names[loader]);
        test_expect(description, test_instance.txm_module_instance_id, saved_id);
        snprintf(description, sizeof(description), "%s: ...and keeps its state", test_loader_names[loader]);
        test_expect(description, test_instance.txm_module_instance_state, (ULONG) TXM_MODULE_LOADED);
        snprintf(description, sizeof(description), "%s: ...and only one module is loaded", test_loader_names[loader]);
        test_expect(description, _txm_module_manger_loaded_count, ((ULONG) 1));
    }

    /* A second module is linked into the loaded list behind the first.  */
    test_reset();
    (VOID) test_image_build(TX_FALSE);
    test_load_expect(TEST_LOADER_MEMORY, TEST_IMAGE_BYTES, TX_SUCCESS, "a first module loads");
    {
        TXM_MODULE_INSTANCE     first;

        first =  test_instance;
        memset(&test_instance, 0, sizeof(test_instance));
        _txm_module_manager_loaded_list_ptr =  &first;
        first.txm_module_instance_loaded_next =      &first;
        first.txm_module_instance_loaded_previous =  &first;
        test_load_expect(TEST_LOADER_MEMORY, TEST_IMAGE_BYTES, TX_SUCCESS, "a second module loads");
        test_expect("the second module follows the first", (ULONG) (ALIGN_TYPE) first.txm_module_instance_loaded_next, (ULONG) (ALIGN_TYPE) &test_instance);
        test_expect("two modules are loaded", _txm_module_manger_loaded_count, ((ULONG) 2));
        test_reset();
    }

    /* The file loader refuses a file shorter than its preamble or its code.  */
    test_reset();
    (VOID) test_image_build(TX_FALSE);
    test_file_data =  test_image_place(TEST_IMAGE_BYTES);
    test_file_size =  ((ULONG) sizeof(TXM_MODULE_PREAMBLE)) - ((ULONG) 4);
    status =  _txm_module_manager_file_load(&test_instance, "module", &test_media, "module.bin");
    test_expect("file_load: a file shorter than a preamble is refused", (ULONG) status, (ULONG) TXM_MODULE_FILEX_INVALID_BYTES_READ);
    test_file_size =  TEST_IMAGE_BYTES - ((ULONG) 1);
    status =  _txm_module_manager_file_load(&test_instance, "module", &test_media, "module.bin");
    test_expect("file_load: a file shorter than its code is refused", (ULONG) status, (ULONG) TXM_MODULE_FILEX_INVALID_BYTES_READ);
    test_expect("file_load: ...and its code memory is released", test_releases > ((ULONG) 0) ? ((ULONG) 1) : ((ULONG) 0), ((ULONG) 1));


    /**********************************************************************/
    /* The in-place alignment check holds the mutex it releases.          */
    /**********************************************************************/

    test_reset();
    test_mutex_unowned_puts =  ((ULONG) 0);
    image =  test_image_place(TEST_IMAGE_BYTES + ((ULONG) 2));
    preamble =  (TXM_MODULE_PREAMBLE *) image;
    memmove(image, test_image_build(TX_FALSE), TEST_IMAGE_BYTES);
    status =  _txm_module_manager_in_place_load(&test_instance, "module", image);
    test_expect("in_place_load: a misaligned image is refused", (ULONG) status, (ULONG) TXM_MODULE_ALIGNMENT_ERROR);
    test_expect("in_place_load: ...releasing only a mutex it holds", test_mutex_unowned_puts, ((ULONG) 0));
    test_expect("in_place_load: ...and leaving the mutex free", test_mutex_depth, ((ULONG) 0));

    /* The absolute loader checks the same alignment while holding the mutex.  */
    test_reset();
    test_mutex_unowned_puts =  ((ULONG) 0);
    image =  test_image_place(TEST_IMAGE_BYTES + ((ULONG) 2));
    memmove(image, test_image_build(TX_TRUE), TEST_IMAGE_BYTES);
    preamble =  (TXM_MODULE_PREAMBLE *) image;
    base =  (ULONG) (ALIGN_TYPE) image;
    preamble -> txm_module_preamble_shell_entry_function =  base + TEST_SHELL_OFFSET;
    preamble -> txm_module_preamble_start_function =        base + TEST_START_OFFSET;
    preamble -> txm_module_preamble_stop_function =         base + TEST_STOP_OFFSET;
    preamble -> txm_module_preamble_callback_function =     base + TEST_CALLBACK_OFFSET;
    status =  _txm_module_manager_absolute_load_extended(&test_instance, "module", image, (VOID *) &test_absolute_data);
    test_expect("absolute_load_extended: a misaligned image is refused", (ULONG) status, (ULONG) TXM_MODULE_ALIGNMENT_ERROR);
    test_expect("absolute_load_extended: ...releasing only a mutex it holds", test_mutex_unowned_puts, ((ULONG) 0));
    test_expect("absolute_load_extended: ...and leaving the mutex free", test_mutex_depth, ((ULONG) 0));
    /* A misaligned data location is refused with the mutex released.  */
    test_reset();
    (VOID) test_image_build(TX_TRUE);
    status =  _txm_module_manager_absolute_load_extended(&test_instance, "module", test_image_place(TEST_IMAGE_BYTES), (VOID *) (test_absolute_data.test_data_bytes + 1));
    test_expect("absolute_load_extended: a misaligned data location is refused", (ULONG) status, (ULONG) TXM_MODULE_ALIGNMENT_ERROR);
    test_expect("absolute_load_extended: ...leaving the mutex free", test_mutex_depth, ((ULONG) 0));

    /* Absolute loads refuse before the manager is ready, from an interrupt, and for a
       null instance; and accept a load during initialization.  */
    test_reset();
    (VOID) test_image_build(TX_TRUE);
    _txm_module_manager_ready =  TX_FALSE;
    test_load_expect(TEST_LOADER_ABSOLUTE_EXTENDED, TEST_IMAGE_BYTES, TX_NOT_AVAILABLE, "a load before the manager is ready is refused");
    _txm_module_manager_ready =  TX_TRUE;
    _tx_thread_system_state =  ((ULONG) 1);
    test_load_expect(TEST_LOADER_ABSOLUTE_EXTENDED, TEST_IMAGE_BYTES, TX_CALLER_ERROR, "a load from an interrupt is refused");
    _tx_thread_system_state =  TX_INITIALIZE_IN_PROGRESS;
    test_load_expect(TEST_LOADER_ABSOLUTE_EXTENDED, TEST_IMAGE_BYTES, TX_SUCCESS, "a load during initialization is accepted");
    _tx_thread_system_state =  ((ULONG) 0);
    status =  _txm_module_manager_absolute_load_extended(TX_NULL, "module", test_image_place(TEST_IMAGE_BYTES), TX_NULL);
    test_expect("absolute_load_extended: a null instance is refused", (ULONG) status, (ULONG) TX_PTR_ERROR);

    /* The relative loaders refuse a zero code size before reading further.  */
    for (loader = 0U; loader < TEST_LOADER_COUNT; loader++)
    {
        test_reset();
        preamble =  test_image_build(test_loader_is_absolute(loader));
        test_properties_for(loader, preamble);
        preamble -> txm_module_preamble_code_size =  ((ULONG) 0);
        status =  test_load(loader, TEST_IMAGE_BYTES);
        snprintf(description, sizeof(description), "%s: a zero code size is refused", test_loader_names[loader]);
        test_expect(description, (ULONG) ((status == TXM_MODULE_INVALID) ? TX_TRUE : TX_FALSE), (ULONG) TX_TRUE);
        snprintf(description, sizeof(description), "%s: ...leaving the mutex free", test_loader_names[loader]);
        test_expect(description, test_mutex_depth, ((ULONG) 0));
    }

    /* A code size whose rounding overflows is refused by the relative loaders before
       they take the mutex.  */
    for (loader = TEST_LOADER_IN_PLACE; loader <= TEST_LOADER_FILE; loader++)
    {
        test_reset();
        preamble =  test_image_build(TX_FALSE);
        preamble -> txm_module_preamble_code_size =  (ULONG) 0xFFFFFFFEUL;
        status =  test_load(loader, TEST_IMAGE_BYTES);
        snprintf(description, sizeof(description), "%s: a code size whose rounding overflows is refused", test_loader_names[loader]);
        test_expect(description, (ULONG) ((status != TX_SUCCESS) ? TX_TRUE : TX_FALSE), (ULONG) TX_TRUE);
        snprintf(description, sizeof(description), "%s: ...leaving the mutex free", test_loader_names[loader]);
        test_expect(description, test_mutex_depth, ((ULONG) 0));
    }


    /**********************************************************************/
    /* What the whole run has to have held.                               */
    /**********************************************************************/

    test_expect("no mutex was released by a non-owner", test_mutex_unowned_puts, ((ULONG) 0));
    test_expect("the interrupt lock is balanced", (ULONG) test_interrupt_disable_depth, ((ULONG) 0));
    test_expect("the interrupt lock never underflowed", (ULONG) test_interrupt_restore_underflows, ((ULONG) 0));

    if (test_failures == 0U)
    {
        printf("SUCCESS! %lu expectations\n", (unsigned long) test_checks);
        return(0);
    }

    printf("ERROR: %u expectation(s) failed of %lu\n", test_failures, (unsigned long) test_checks);
    return(1);
}
