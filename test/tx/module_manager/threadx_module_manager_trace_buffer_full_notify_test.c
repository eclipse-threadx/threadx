/***************************************************************************
 * Copyright (c) 2026 Eclipse ThreadX contributors
 *
 * This program and the accompanying materials are made available under the
 * terms of the MIT License which is available at
 * https://opensource.org/licenses/MIT.
 *
 * AI Disclosure: This file was largely AI-generated by Claude Code (Opus 5.5).
 * The AI-generated portions may be considered public domain (CC0-1.0)
 * and not subject to the project's licence. The human contributor has
 * reviewed and verified that the code is correct.
 *
 * SPDX-License-Identifier: MIT and CC0-1.0
 **************************************************************************/


/**************************************************************************/
/**************************************************************************/
/**                                                                       */
/** ThreadX Test                                                          */
/**                                                                       */
/**   Module Manager trace buffer full notify registration                */
/**                                                                       */
/**************************************************************************/
/**************************************************************************/

/* The kernel stores the trace-full callback a caller registers and calls it directly,
   from privileged code, each time the trace buffer wraps. The Module Manager hands the
   kernel a trampoline for every per-object notification, so that a module's callback
   runs on the module's own callback thread, but this one has no trampoline: a user-mode
   module that registered it would have its code run with kernel privilege. The
   dispatcher must therefore refuse user-mode modules, as the stack-error notification
   and the other trace services already do, and must still let a privileged module
   register, since a privileged module already runs with that privilege.

   The test drives the dispatcher directly with modules of each kind and records what
   reaches the kernel service, because a refusal that still registers the callback has
   refused nothing. The build defines every dispatch guard except this service's, so the
   translation unit holds only the dispatcher under test.  */

#include <stdio.h>
#include <string.h>

#include "threadx_module_manager_host_test_port.h"

#include "txm_module.h"
#include "txm_module_manager_util.h"
#include "txm_module_manager_dispatch.h"

#ifdef TXM_TRACE_BUFFER_FULL_NOTIFY_CALL_NOT_USED
#error "the service under test must be compiled in"
#endif

#ifndef TXM_TRACE_ENABLE_CALL_NOT_USED
#error "the services this test does not exercise must be compiled out"
#endif


/* Define the stand-in interrupt lock the port shim counts through.  */

unsigned int    test_interrupt_disable_depth;
unsigned int    test_interrupt_disable_max_depth;
unsigned int    test_interrupt_restore_underflows;


static UINT     test_failures;
static ULONG    test_checks;


/* Record the outcome of one expectation.  */
static VOID  test_expect(const char *description, ULONG actual, ULONG expected)
{
    test_checks++;

    if (actual != expected)
    {
        printf("FAIL: %s (expected %lu, got %lu)\n", description, (unsigned long) expected, (unsigned long) actual);
        test_failures++;
    }
}


/* Stand in for the kernel service, recording each registration it is handed and
   returning a status the dispatcher must pass back unchanged.  */

#define TEST_SERVICE_STATUS     ((UINT) TX_FEATURE_NOT_ENABLED)

static ULONG        test_service_calls;
static ALIGN_TYPE   test_registered_callback;

UINT  _tx_trace_buffer_full_notify(VOID (*full_buffer_callback)(VOID *buffer))
{
    test_service_calls++;
    test_registered_callback =  (ALIGN_TYPE) full_buffer_callback;

    return(TEST_SERVICE_STATUS);
}


/* The callback a module names. It is never called here.  */
static VOID  test_module_callback(VOID *buffer)
{
    (VOID) buffer;
}


/* Callback values a module could pass: a function, and null to clear a registration.  */

#define TEST_CALLBACK_COUNT     ((UINT) 2)

static const ALIGN_TYPE     test_callbacks[TEST_CALLBACK_COUNT] =
{
    (ALIGN_TYPE) test_module_callback,
    ((ALIGN_TYPE) 0)
};


/* Property flag combinations a module can be loaded with. The user-mode ones must be
   refused whether or not memory protection is also set.  */

#define TEST_MODULE_KIND_COUNT  ((UINT) 4)

static const ULONG          test_module_flags[TEST_MODULE_KIND_COUNT] =
{
    TXM_MODULE_USER_MODE | TXM_MODULE_MEMORY_PROTECTION,
    TXM_MODULE_USER_MODE,
    TXM_MODULE_MEMORY_PROTECTION,
    ((ULONG) 0)
};

static const char * const   test_module_names[TEST_MODULE_KIND_COUNT] =
{
    "user-mode, memory-protected",
    "user-mode",
    "privileged, memory-protected",
    "privileged"
};


int  main(void)
{

TXM_MODULE_INSTANCE     module_instance;
ALIGN_TYPE              return_value;
ALIGN_TYPE              previous_callback;
UINT                    kind;
UINT                    callback;
UINT                    user_mode;
char                    description[160];

    for (kind = ((UINT) 0); kind < TEST_MODULE_KIND_COUNT; kind++)
    {
        user_mode =  (UINT) ((test_module_flags[kind] & TXM_MODULE_USER_MODE) != ((ULONG) 0));

        for (callback = ((UINT) 0); callback < TEST_CALLBACK_COUNT; callback++)
        {
            memset((VOID *) &module_instance, 0, sizeof(module_instance));
            module_instance.txm_module_instance_property_flags =  test_module_flags[kind];

            /* Start each case from a registration the request must either replace or
               leave in place.  */
            previous_callback =         (ALIGN_TYPE) &test_registered_callback;
            test_registered_callback =  previous_callback;
            test_service_calls =        ((ULONG) 0);

            return_value =  _txm_module_manager_tx_trace_buffer_full_notify_dispatch(&module_instance, test_callbacks[callback]);

            if (user_mode != ((UINT) 0))
            {
                snprintf(description, sizeof(description), "a %s module's %s registration is refused",
                         test_module_names[kind], (callback == ((UINT) 0)) ? "callback" : "null");
                test_expect(description, (ULONG) return_value, (ULONG) TXM_MODULE_INVALID_PROPERTIES);

                snprintf(description, sizeof(description), "...without reaching the kernel service");
                test_expect(description, test_service_calls, ((ULONG) 0));

                snprintf(description, sizeof(description), "...and the existing registration is unchanged");
                test_expect(description, (ULONG) (test_registered_callback == previous_callback), (ULONG) TX_TRUE);
            }
            else
            {
                snprintf(description, sizeof(description), "a %s module's %s registration reaches the kernel service once",
                         test_module_names[kind], (callback == ((UINT) 0)) ? "callback" : "null");
                test_expect(description, test_service_calls, ((ULONG) 1));

                snprintf(description, sizeof(description), "...with the value the module passed");
                test_expect(description, (ULONG) (test_registered_callback == test_callbacks[callback]), (ULONG) TX_TRUE);

                snprintf(description, sizeof(description), "...and returns the service's status unchanged");
                test_expect(description, (ULONG) return_value, (ULONG) TEST_SERVICE_STATUS);
            }
        }
    }

    /* Nothing on this path disables interrupts, and the shim counts them.  */
    test_expect("the interrupt lock is balanced", (ULONG) test_interrupt_disable_depth, ((ULONG) 0));
    test_expect("the interrupt lock never underflowed", (ULONG) test_interrupt_restore_underflows, ((ULONG) 0));

    test_expect("every case ran", test_checks, ((ULONG) 26));

    if (test_failures == 0U)
    {
        printf("SUCCESS! %lu expectations\n", (unsigned long) test_checks);
        return(0);
    }

    printf("ERROR: %u expectation(s) failed of %lu\n", test_failures, (unsigned long) test_checks);
    return(1);
}
