/***************************************************************************
 * Copyright (c) 2026 Eclipse ThreadX contributors
 *
 * This program and the accompanying materials are made available under the
 * terms of the MIT License which is available at
 * https://opensource.org/licenses/MIT.
 *
 * AI Disclosure: This file was largely AI-generated by Claude Code (Opus 5).
 * The AI-generated portions may be considered public domain (CC0-1.0)
 * and not subject to the project's licence. The human contributor has
 * reviewed and verified that the code is correct.
 *
 * SPDX-License-Identifier: MIT and CC0-1.0
 **************************************************************************/

/* This test drives the four scheduler services that return to an idle system.

   Four services pick the thread to execute up into a local variable and check
   its stack before handing the processor back: the relinquish, the preemption
   check, the system resume and the system suspend. Each of them reaches that
   point through a test of the form "is the thread to execute a different one
   from the thread that is running", which an idle system satisfies with no
   thread to execute at all. The stack check then has nothing to check, and the
   kernel recognises that state explicitly -- three of the four count a return
   to idle where the fourth counts a preemption.

   Ordinary use never presents it. A system with no thread to execute is only
   produced by the last ready thread suspending itself, and that path returns to
   the scheduler from inside the suspend without reaching any of these four.

   The test constructs it directly instead: with interrupts held off it clears
   the thread to execute and drives one of the four services in the same locked
   region, so no interrupt can restore the pointer in between. The kernel state
   is not otherwise disturbed -- the ready list, the priority map and the highest
   ready priority are all left correct, so the first scheduler operation after
   the idle period recomputes the thread to execute from them and the system
   carries on.

   Getting out of the idle period is what the timer below is for. A thread that
   returns to an idle system blocks until something makes a thread ready again,
   and with every other thread suspended nothing would. A periodic timer running
   throughout means the tick has expiration work to do, so the timer thread is
   resumed, runs, and suspends itself, and that suspension recomputes the thread
   to execute. The wait is bounded by one tick rather than by winning a race.  */


#include   <stdio.h>
#include   "tx_api.h"
#define    TX_SOURCE_CODE
#include   "tx_thread.h"
#include   "tx_timer.h"


/* The priorities the test runs at. The helper sits below the test thread so
   that resuming it does not preempt, which is what leaves the resume on the
   path that ends in the check under test.  */

#define TEST_PRIORITY               16
#define HELPER_PRIORITY             20

#define SCRATCH_STACK_SIZE          TEST_STACK_SIZE_PRINTF


/* The four services, driven in this order. The resume has to run before the
   suspend, because the helper starts out suspended.  */

#define IDLE_STEP_RELINQUISH        0
#define IDLE_STEP_PREEMPT_CHECK     1
#define IDLE_STEP_RESUME_HELPER     2
#define IDLE_STEP_SUSPEND_HELPER    3
#define IDLE_STEPS                  4


static unsigned long   thread_0_counter =  0;
static TX_THREAD       thread_0;

static unsigned long   thread_1_counter =  0;
static TX_THREAD       thread_1;

static TX_TIMER        revive_timer;

static unsigned long   revive_timer_counter =  0;


/* Define thread prototypes.  */

static void    thread_0_entry(ULONG thread_input);
static void    thread_1_entry(ULONG thread_input);


/* Prototype for test control return.  */

void  test_control_return(UINT status);


/* Keep the tick doing expiration work, so that a thread which has returned to
   an idle system is scheduled again.  */

static void  revive_timer_entry(ULONG timer_input)
{

    revive_timer_counter++;
}


/* Drive one service with no thread to execute.

   The pointer is cleared and the service is entered inside one interrupt
   lockout. The services themselves restore interrupts on the way through, but
   the lockout the test holds is the outer one, so it stands until the service
   hands the processor back and the port drops it to let the scheduler run. The
   tick therefore cannot put a thread to execute back between the clear and the
   test the service makes of it.  */

static UINT  drive_idle_return(UINT step)
{

TX_INTERRUPT_SAVE_AREA

UINT    status =  TX_SUCCESS;
ULONG   run_count;


    run_count =  thread_0.tx_thread_run_count;

    TX_DISABLE

    _tx_thread_execute_ptr =  TX_NULL;

    switch (step)
    {

    case IDLE_STEP_RELINQUISH:

        /* The relinquish finds no other thread at its own priority and none
           higher ready, so it leaves the cleared pointer alone and then checks
           the thread it is handing over to. The published entry point refuses a
           caller that is not a thread, so the internal one is used.  */
        _tx_thread_relinquish();
        break;

    case IDLE_STEP_PREEMPT_CHECK:

        /* The preemption check compares the running thread against the thread
           to execute and checks the latter.  */
        _tx_thread_system_preempt_check();
        break;

    case IDLE_STEP_RESUME_HELPER:

        /* Resuming a thread below the running one does not preempt, so the
           resume leaves the cleared pointer alone and falls through to the
           check at the end of the service.  */
        status =  tx_thread_resume(&thread_1);
        break;

    default:

        /* Suspending a thread that is neither the running one nor the thread to
           execute leaves the cleared pointer alone in the same way. The test
           thread stays ready throughout, so the suspend does not take the
           "nothing else is ready" path, which returns to the scheduler without
           reaching the check.  */
        status =  tx_thread_suspend(&thread_1);
        break;
    }

    TX_RESTORE

    if (status != TX_SUCCESS)
    {
        return(status);
    }

    /* Each of the four hands the processor back, so the thread is scheduled
       again before it gets here. A run count that has not moved means the
       service returned without going through the scheduler and the arm under
       test was not reached.  */
    if (thread_0.tx_thread_run_count == run_count)
    {
        return(TX_NOT_DONE);
    }

    /* The ready list was left correct, so the scheduler has put the test thread
       back as the thread to execute.  */
    if (_tx_thread_execute_ptr != &thread_0)
    {
        return(TX_NOT_DONE);
    }

    return(TX_SUCCESS);
}


static void    thread_0_entry(ULONG thread_input)
{

UINT    status;
UINT    step;


    /* Increment thread 0 counter.  */
    thread_0_counter++;

    /* Inform user of success getting to this test.  */
    printf("Running Thread Idle Return Test.................................... ");

    /* Start the timer that gets the system out of each idle period.  */
    status =  tx_timer_activate(&revive_timer);

    if (status != TX_SUCCESS)
    {

        printf("ERROR #2\n");
        test_control_return(1);
    }

    for (step = 0; step < IDLE_STEPS; step++)
    {

        status =  drive_idle_return(step);

        if (status != TX_SUCCESS)
        {

            printf("ERROR #3\n");
            test_control_return(1);
        }
    }

    status =  tx_timer_deactivate(&revive_timer);

    if (status != TX_SUCCESS)
    {

        printf("ERROR #4\n");
        test_control_return(1);
    }

    /* The idle periods are only left by the tick, so the timer must have
       expired at least once for each of them.  */
    if (revive_timer_counter < IDLE_STEPS)
    {

        printf("ERROR #5\n");
        test_control_return(1);
    }

    /* Success!  */
    printf("SUCCESS!\n");
    test_control_return(0);
}


static void    thread_1_entry(ULONG thread_input)
{

    while (1)
    {

        thread_1_counter++;
        tx_thread_suspend(&thread_1);
    }
}


/* Define what the initial system looks like.  */

#ifdef CTEST
void test_application_define(void *first_unused_memory)
#else
void    threadx_thread_idle_return_application_define(void *first_unused_memory)
#endif
{

UINT    status;
CHAR    *pointer;


    /* Put first available memory address into a character pointer.  */
    pointer =  (CHAR *) first_unused_memory;

    status =  tx_thread_create(&thread_0, "thread 0", thread_0_entry, 0,
            pointer, TEST_STACK_SIZE_PRINTF,
            TEST_PRIORITY, TEST_PRIORITY, TX_NO_TIME_SLICE, TX_AUTO_START);
    pointer =  pointer + TEST_STACK_SIZE_PRINTF;

    /* Check for status.  */
    if (status != TX_SUCCESS)
    {

        printf("Running Thread Idle Return Test.................................... ERROR #1\n");
        test_control_return(1);
    }

    status =  tx_thread_create(&thread_1, "thread 1", thread_1_entry, 1,
            pointer, SCRATCH_STACK_SIZE,
            HELPER_PRIORITY, HELPER_PRIORITY, TX_NO_TIME_SLICE, TX_DONT_START);
    pointer =  pointer + SCRATCH_STACK_SIZE;

    /* Check for status.  */
    if (status != TX_SUCCESS)
    {

        printf("Running Thread Idle Return Test.................................... ERROR #1\n");
        test_control_return(1);
    }

    /* A tick's worth of expiration work, repeated, so that no idle period lasts
       longer than one tick.  */
    status =  tx_timer_create(&revive_timer, "revive timer", revive_timer_entry, 0,
            1, 1, TX_NO_ACTIVATE);

    /* Check for status.  */
    if (status != TX_SUCCESS)
    {

        printf("Running Thread Idle Return Test.................................... ERROR #1\n");
        test_control_return(1);
    }
}
