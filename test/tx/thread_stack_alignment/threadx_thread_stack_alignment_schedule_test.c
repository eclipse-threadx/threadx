/***************************************************************************
 * Copyright (c) 2026 Eclipse ThreadX contributors
 *
 * This program and the accompanying materials are made available under the
 * terms of the MIT License which is available at
 * https://opensource.org/licenses/MIT.
 *
 * AI Disclosure: This file was largely AI-generated by Codex (gpt-6.1-sol).
 * The AI-generated portions may be considered public domain (CC0-1.0)
 * and not subject to the project's licence. The human contributor has
 * reviewed and verified that the code is correct.
 *
 * SPDX-License-Identifier: MIT AND CC0-1.0
 **************************************************************************/

/* Exercise actual Linux thread creation and scheduling across sleep/wake.
   Check metadata before the real port builder can touch an invalid address. */
#include "tx_api.h"
#include <stdio.h>

#define STACK_BYTES     8192U
#define PADDING_BYTES   32U
#define SENTINEL        0xA5U

static TX_THREAD worker;
static TX_THREAD observer;
static ALIGN_TYPE worker_storage[(STACK_BYTES + 2U * PADDING_BYTES) / sizeof(ALIGN_TYPE)];
static ALIGN_TYPE observer_storage[(STACK_BYTES + 2U * PADDING_BYTES) / sizeof(ALIGN_TYPE)];
static UCHAR *worker_input;
static UCHAR *observer_input;
static UINT offset;
static volatile UINT visits;

VOID __real__tx_thread_stack_build(TX_THREAD *thread_ptr, VOID (*entry)(VOID));

/* An assertion exits cleanly on the original tree, before stack dereference or
   creation of either application pthread. The CTest timeout catches hangs. */
static VOID require(UINT condition, const CHAR *message)
{
    if (condition == 0U)
    {
        printf("FAIL: %s\n", message);
        exit(1);
    }
}

/* Validate full-width metadata before delegating to the genuine Linux builder. */
VOID __wrap__tx_thread_stack_build(TX_THREAD *thread_ptr, VOID (*entry)(VOID))
{
UCHAR *input =  (thread_ptr == &worker) ? worker_input : observer_input;
ULONG remainder =  (ULONG) ((ALIGN_TYPE) input % sizeof(ULONG));
ULONG adjustment =  (remainder == 0U) ? 0U : (ULONG) sizeof(ULONG) - remainder;
UCHAR *expected_start =  input + adjustment;
ULONG expected_size =  STACK_BYTES - (ULONG) sizeof(ULONG);

    require((thread_ptr == &worker) || (thread_ptr == &observer), "unexpected thread build");
    if (adjustment != 0U)
    {
        expected_size -=  (ULONG) sizeof(ULONG);
    }
    printf("port build: input=%p start=%p end=%p size=%u\n", (VOID *) input,
           thread_ptr -> tx_thread_stack_start, thread_ptr -> tx_thread_stack_end,
           (UINT) thread_ptr -> tx_thread_stack_size);
    require(thread_ptr -> tx_thread_stack_start == expected_start, "stack start retains high bits");
    require(thread_ptr -> tx_thread_stack_size == expected_size, "stack guard reservations");
    require(thread_ptr -> tx_thread_stack_end == expected_start + expected_size - 1U,
            "stack end remains in supplied storage");
    __real__tx_thread_stack_build(thread_ptr, entry);
    require((ALIGN_TYPE) thread_ptr -> tx_thread_stack_ptr >= (ALIGN_TYPE) expected_start,
            "initial stack pointer lower bound");
    require((ALIGN_TYPE) thread_ptr -> tx_thread_stack_ptr <= (ALIGN_TYPE) (expected_start + expected_size - 1U),
            "initial stack pointer upper bound");
}

/* Check padding after the real builder and after the worker has run. */
static VOID check_padding(UCHAR *bytes, UINT start_offset)
{
UINT i;

    for (i = 0U; i < sizeof(worker_storage); i++)
    {
        if ((i < PADDING_BYTES + start_offset) || (i >= PADDING_BYTES + start_offset + STACK_BYTES))
        {
            require(bytes[i] == SENTINEL, "caller padding survives creation/scheduling");
        }
    }
}

/* The worker must run twice, separated by an actual timer suspension. */
static VOID worker_entry(ULONG input)
{
    require(input == 17U, "scalar worker input");
    require(tx_thread_identify() == &worker, "worker was scheduled");
    visits++;
    require(tx_thread_sleep(1U) == TX_SUCCESS, "worker sleep/wake");
    visits++;
}

/* A lower-priority observer gives the worker time to complete after waking. */
static VOID observer_entry(ULONG input)
{
    require(input == 23U, "scalar observer input");
    require(tx_thread_sleep(3U) == TX_SUCCESS, "observer sleep/wake");
    require(visits == 2U, "worker ran across sleep/wake");
    require(worker.tx_thread_state == TX_COMPLETED, "worker completed");
    check_padding((UCHAR *) worker_storage, offset);
    check_padding((UCHAR *) observer_storage, 0U);
    puts("PASS: high-address stack survived real creation and scheduling");
    exit(0);
}

/* Timer processing in ISR mode avoids an unrelated timer-thread stack. */
VOID tx_application_define(VOID *unused)
{
UINT status;

    (void) unused;
    status =  tx_thread_create(&worker, "alignment worker", worker_entry, 17U,
                               worker_input, STACK_BYTES, 15U, 15U, TX_NO_TIME_SLICE, TX_DONT_START);
    require(status == TX_SUCCESS, "worker create");
    require(worker.tx_thread_stack_highest_ptr == worker.tx_thread_stack_ptr, "worker highest pointer");
    status =  tx_thread_create(&observer, "alignment observer", observer_entry, 23U,
                               observer_input, STACK_BYTES, 16U, 16U, TX_NO_TIME_SLICE, TX_DONT_START);
    require(status == TX_SUCCESS, "observer create");
    require(observer.tx_thread_stack_highest_ptr == observer.tx_thread_stack_ptr, "observer highest pointer");
    require((worker.tx_thread_state == TX_SUSPENDED) && (observer.tx_thread_state == TX_SUSPENDED),
            "created threads suspended before resume");
    check_padding((UCHAR *) worker_storage, offset);
    check_padding((UCHAR *) observer_storage, 0U);
    require(tx_thread_resume(&worker) == TX_SUCCESS, "worker resume");
    require(tx_thread_resume(&observer) == TX_SUCCESS, "observer resume");
}

/* Require the genuine 4/8/8 Linux mismatch and actual high-address storage. */
INT main(INT argc, CHAR **argv)
{
    setvbuf(stdout, TX_NULL, _IONBF, 0);
    require(argc == 2, "one alignment offset required");
    require((argv[1][0] >= '0') && (argv[1][0] <= '3') && (argv[1][1] == '\0'), "valid offset");
    offset =  (UINT) (argv[1][0] - '0');
    worker_input =  (UCHAR *) worker_storage + PADDING_BYTES + offset;
    observer_input =  (UCHAR *) observer_storage + PADDING_BYTES;
    printf("sizeof(ULONG)=%zu sizeof(ALIGN_TYPE)=%zu sizeof(void*)=%zu offset=%u\n",
           sizeof(ULONG), sizeof(ALIGN_TYPE), sizeof(VOID *), offset);
    require((sizeof(ULONG) == 4U) && (sizeof(ALIGN_TYPE) == 8U) && (sizeof(VOID *) == 8U),
            "native64 Linux port widths");
    require(((ALIGN_TYPE) worker_input > (ALIGN_TYPE) ((ULONG) ~0U)) &&
            ((ALIGN_TYPE) observer_input > (ALIGN_TYPE) ((ULONG) ~0U)), "high-address stacks");
    memset(worker_storage, SENTINEL, sizeof(worker_storage));
    memset(observer_storage, SENTINEL, sizeof(observer_storage));
    tx_kernel_enter();
    require(0U, "kernel unexpectedly returned");
    return(1);
}
