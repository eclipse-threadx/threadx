/***************************************************************************
 * Copyright (c) 2026 Eclipse ThreadX contributors
 *
 * This program and the accompanying materials are made available under the
 * terms of the MIT License which is available at
 * https://opensource.org/licenses/MIT.
 *
 * AI Disclosure: This file was largely AI-generated by Claude Code (Opus 5).
 * The AI-generated portions may be considered public domain (CC0-1.0)
 * and not subject to the project's licence. The human contributor has
 * reviewed and verified that the code is correct.
 *
 * SPDX-License-Identifier: MIT and CC0-1.0
 **************************************************************************/

/**************************************************************************/
/*                                                                        */
/*  MODULE MANAGER SAMPLE                                  RELEASE        */
/*                                                                        */
/*    sample_threadx_module_manager.c                  Cortex-R52/GNU     */
/*                                                           6.5.2        */
/*  AUTHOR                                                                */
/*                                                                        */
/*    Frédéric Desbiens, Eclipse Foundation                               */
/*                                                                        */
/*  DESCRIPTION                                                           */
/*                                                                        */
/*    Loads the sample module, lets it misbehave, and reports what the     */
/*    hardware did about it.                                              */
/*                                                                        */
/*    The result this example exists to produce is the fault.  A module    */
/*    that starts and runs proves the loader works; a module that is       */
/*    stopped by the memory protection unit when it reaches outside its    */
/*    own memory proves the port works.  So the fault notification is not  */
/*    an error path here, it is the expected outcome, and its absence is   */
/*    the failure.                                                        */
/*                                                                        */
/*    What the module image is and where it comes from: it is linked into  */
/*    this application as a separate section and loaded in place, so       */
/*    nothing is copied and no filesystem or download path is needed.     */
/*    The manager still maps it with its own MPU regions, which is what    */
/*    matters -- loading in place changes where the code lives, not        */
/*    whether it is protected.                                            */
/*                                                                        */
/**************************************************************************/

#include "tx_api.h"
#include "txm_module.h"
#include "linflexd.h"
#include "platform.h"
#include "thread_mpu.h"

/* The fault information the abort vector captured.  Declared here because the
   module manager expands it into the port's fault handler through the
   TXM_MODULE_MANAGER_FAULT_INFO macro rather than declaring it in a header, so an
   application that wants to read it has to say so itself.  */

extern TXM_MODULE_MANAGER_MEMORY_FAULT_INFO     _txm_module_manager_memory_fault_info;

/* Where the module image sits.  Provided by the linker script, which places the
   module's preamble first so this address is also the preamble address.  */

extern unsigned char    __module_image_start__;

/* Memory the manager hands out to modules: object memory, and the data region a
   module's own variables live in.  It has to be outside every region a module is
   given, or a module could reach another module's data.  */

#ifndef MODULE_POOL_SIZE
#define MODULE_POOL_SIZE    (16U * 1024U)
#endif

/* In the module area, not in .bss.  The manager carves a module's data out of
   this pool, and that data is handed to the module as an MPU region -- so if the
   pool lived in .bss it would sit inside the kernel's data region and the two
   would overlap, which PMSAv8-R does not allow.  Keeping the pool in the module
   area is what makes a module's data disjoint from every kernel region.  */

static unsigned char    module_pool[MODULE_POOL_SIZE]
                            __attribute__((aligned(64), section(".module_pool")));

/* The object pool, which is a separate allocation from the module pool above and
   is not optional here.  A module that runs in User mode needs a kernel stack
   for the privileged side of each system call, and the manager allocates that
   from this pool -- txm_module_manager_initialize deliberately leaves the pool
   uncreated, so without this a User-mode module fails to start with
   TX_NOT_AVAILABLE from deep inside the thread create, which is not an obvious
   way to be told that a pool is missing.  */

#ifndef MODULE_OBJECT_POOL_SIZE
#define MODULE_OBJECT_POOL_SIZE     (8U * 1024U)
#endif

static unsigned char    module_object_pool[MODULE_OBJECT_POOL_SIZE]
                            __attribute__((aligned(64)));

static TXM_MODULE_INSTANCE  demo_module;

/* What the fault handler saw.  Read by the reporting thread after the module has
   been terminated.  */

static volatile ULONG   fault_count;
static volatile ULONG   fault_dfsr;
static volatile ULONG   fault_dfar;
static volatile ULONG   fault_spsr;
static volatile ULONG   fault_code_location;

static TX_THREAD        report_thread;
static unsigned char    report_stack[2048] __attribute__((aligned(8)));


/**************************************************************************/
/*  Fault notification.                                                   */
/*                                                                        */
/*  Called by the module manager after it has terminated the offending     */
/*  thread.  Records rather than prints: this runs in the fault path, and  */
/*  the console is a polled driver that spins waiting for a transmit to    */
/*  complete.                                                            */
/**************************************************************************/

static void module_fault_notify(TX_THREAD *thread_ptr, TXM_MODULE_INSTANCE *module_instance)
{
    (void) thread_ptr;
    (void) module_instance;

    fault_count++;
    fault_dfsr          = _txm_module_manager_memory_fault_info.txm_module_manager_memory_fault_info_dfsr;
    fault_dfar          = _txm_module_manager_memory_fault_info.txm_module_manager_memory_fault_info_dfar;
    fault_spsr          = _txm_module_manager_memory_fault_info.txm_module_manager_memory_fault_info_spsr;
    fault_code_location = (ULONG) _txm_module_manager_memory_fault_info.txm_module_manager_memory_fault_info_code_location;
}


static void put_hex(unsigned long value)
{
    linflexd_put_hex32((unsigned int) value);
}


/**************************************************************************/
/*  Reporting.                                                            */
/**************************************************************************/

static void manager_entry(ULONG input)
{
    UINT    status;

    (void) input;

    /* Every manager call happens here, in a thread, and not in
       tx_application_define.  Loading a module takes the manager's mutex, and a
       service that can block cannot be called before the scheduler runs: the
       first version of this drove the manager from tx_application_define,
       printed its way as far as the load, and stopped there for ever.  The
       Armv8-M sample does all of this from a thread for the same reason.  */

    linflexd_puts("M1 initialize\n");
    status = txm_module_manager_initialize((VOID *) module_pool, MODULE_POOL_SIZE);

    linflexd_puts("initialize         = ");
    put_hex(status);
    linflexd_puts("  ready = ");
    put_hex((ULONG) _txm_module_manager_ready);
    linflexd_puts("\n");

    /* The pool the module's kernel stacks come from.  See module_object_pool.  */

    status = txm_module_manager_object_pool_create((VOID *) module_object_pool,
                                                  MODULE_OBJECT_POOL_SIZE);

    linflexd_puts("object pool create = ");
    put_hex(status);
    linflexd_puts("\n");

    /* Registered before anything is loaded, so there is no window in which a
       module could fault with nobody listening.  */

    linflexd_puts("M2 fault notify\n");
    txm_module_manager_memory_fault_notify(module_fault_notify);

    /* Nothing to bracket here.  No kernel region covers the module area, but the
       window that reaches it is owned by the scheduler, which enables it for
       every thread that does not own a module and disables it for every thread
       that does -- so it is already open on this thread and cannot be open at
       the same time as a module's own regions.  */

    linflexd_puts("M3 in_place_load\n");
    status = txm_module_manager_in_place_load(&demo_module, "demo module",
                                             (VOID *) &__module_image_start__);

    linflexd_puts("in_place_load      = ");
    put_hex(status);
    linflexd_puts("  ready = ");
    put_hex((ULONG) _txm_module_manager_ready);
    linflexd_puts("\n");

    if (status == TX_SUCCESS)
    {
        status = txm_module_manager_start(&demo_module);
        linflexd_puts("module start       = ");
        put_hex(status);
        linflexd_puts("\n");
    }

    /* Give the module time to run its three steps and be terminated by the
       third.  Bounded: if the fault never arrives, that is the result to
       report, not a reason to wait for ever.  */

    {
        unsigned int waited = 0U;

        while ((fault_count == 0UL) && (waited < 50U))
        {
            tx_thread_sleep(2UL);
            waited++;
        }
    }

    linflexd_puts("\n=== ThreadX modules on S32Z280: protection boundary ===\n");

    linflexd_puts("module faults      = ");
    put_hex(fault_count);
    linflexd_puts("\n");

    if (fault_count == 0UL)
    {
        linflexd_puts("FAIL the module reached outside its memory and was not stopped\n");
    }
    else
    {
        linflexd_puts("DFSR               = ");
        put_hex(fault_dfsr);
        linflexd_puts("\nDFAR               = ");
        put_hex(fault_dfar);
        linflexd_puts("\nSPSR               = ");
        put_hex(fault_spsr);
        linflexd_puts("\nfaulting pc        = ");
        put_hex(fault_code_location);
        linflexd_puts("\n");

        /* SPSR's mode field says who faulted.  0x10 is User mode, which is where
           a protected module runs; anything else means the fault came from
           privileged code and this is not the test passing.  */

        if ((fault_spsr & 0x1FUL) == 0x10UL)
        {
            linflexd_puts("PASS the module faulted in User mode and was terminated\n");
        }
        else
        {
            linflexd_puts("FAIL a fault was taken, but not from User mode\n");
        }
    }

    linflexd_puts("=== end ===\n");

    while (1)
    {
        tx_thread_sleep(100UL);
    }
}


/**************************************************************************/
/*  Application definition.                                               */
/**************************************************************************/

/**************************************************************************/
/*  Board entry.                                                          */
/*                                                                        */
/*  entry.S calls this once the core is at EL1 with the MPU and caches     */
/*  configured.  Same shape as the other examples on this board: bring the */
/*  console up, say so, and enter the kernel.                              */
/**************************************************************************/

void bsp_main(void)
{
    (void) linflexd_init();

    linflexd_puts("\n=== ThreadX modules :: S32Z280-594EVB ===\n");
    linflexd_puts("entering kernel\n");

    tx_kernel_enter();

    /* Not reached.  */

    linflexd_puts("FAIL tx_kernel_enter returned\n");

    for (;;)
    {
        __asm__ volatile("nop");
    }
}


void tx_application_define(void *first_unused_memory)
{
    UINT    status;

    (void) first_unused_memory;

    linflexd_puts("\n=== module manager starting ===\n");

    /* Nothing but the thread.  See manager_entry for why the manager cannot be
       driven from here.  */

    status = tx_thread_create(&report_thread, "module manager", manager_entry, 0UL,
                              report_stack, sizeof(report_stack),
                              20U, 20U, TX_NO_TIME_SLICE, TX_AUTO_START);

    /* Reported rather than discarded.  A thread that was never created and a
       thread that was created but never scheduled produce exactly the same
       silence on the console, and telling those two apart is most of the work
       when the port itself is what is under test.  */

    if (status == TX_SUCCESS)
    {
        linflexd_puts("M0 thread created\n");
    }
    else
    {
        linflexd_puts("FAIL tx_thread_create status 0x");
        put_hex((ULONG) status);
        linflexd_puts("\n");
    }
}
